VERSION ""

NS_ :

BS_:

BU_:

BO_ 2024 OBD_RX: 8 Vector__XXX
 SG_ SUP_S01PID5F_EmissionReq m64 : 49|1@0+ (1,0) [0|1] "" Vector__XXX
 SG_ SUP_S01PID3F_CatTempBank2Sens2 m32 : 49|1@0+ (1,0) [0|1] "" Vector__XXX
 SG_ SUP_S01PID1F_TimeSinceEngStart m0 : 49|1@0+ (1,0) [0|1] "" Vector__XXX
 SG_ SUP_S01PID5E_EngineFuelRate m64 : 50|1@0+ (1,0) [0|1] "" Vector__XXX
 SG_ SUP_S01PID3E_CatTempBank1Sens2 m32 : 50|1@0+ (1,0) [0|1] "" Vector__XXX
 SG_ SUP_S01PID5D_FuelInjectionTiming m64 : 51|1@0+ (1,0) [0|1] "" Vector__XXX
 SG_ SUP_S01PID3D_CatTempBank2Sens1 m32 : 51|1@0+ (1,0) [0|1] "" Vector__XXX
 SG_ SUP_S01PID5C_EngineOilTemp m64 : 52|1@0+ (1,0) [0|1] "" Vector__XXX
 SG_ SUP_S01PID3C_CatTempBank1Sens1 m32 : 52|1@0+ (1,0) [0|1] "" Vector__XXX
 SG_ SUP_S01PID1C_OBDStandard m0 : 52|1@0+ (1,0) [0|1] "" Vector__XXX
 SG_ SUP_S01PID5B_HybrBatPackRemLife m64 : 53|1@0+ (1,0) [0|1] "" Vector__XXX
 SG_ SUP_S01PID3B_OxySensor8_FAER m32 : 53|1@0+ (1,0) [0|1] "" Vector__XXX
 SG_ SUP_S01PID1B_OxySensor8_Volt m0 : 53|1@0+ (1,0) [0|1] "" Vector__XXX
 SG_ SUP_S01PID5A_RelAccelPedalPos m64 : 54|1@0+ (1,0) [0|1] "" Vector__XXX
 SG_ SUP_S01PID3A_OxySensor7_FAER m32 : 54|1@0+ (1,0) [0|1] "" Vector__XXX
 SG_ SUP_S01PID1A_OxySensor7_Volt m0 : 54|1@0+ (1,0) [0|1] "" Vector__XXX
 SG_ SUP_S01PID79_Bank2EGT1 m96 : 55|1@0+ (1,0) [0|1] "" Vector__XXX
 SG_ SUP_S01PID59_FuelRailAbsPres m64 : 55|1@0+ (1,0) [0|1] "" Vector__XXX
 SG_ SUP_S01PID39_OxySensor6_FAER m32 : 55|1@0+ (1,0) [0|1] "" Vector__XXX
 SG_ SUP_S01PID19_OxySensor6_Volt m0 : 55|1@0+ (1,0) [0|1] "" Vector__XXX
 SG_ S01PID4F_Max_IntManiAbsPres m79 : 55|8@0+ (10,0) [0|2550] "kPa" Vector__XXX
 SG_ SUP_S01PID78_Bank1EGT1 m96 : 40|1@0+ (1,0) [0|1] "" Vector__XXX
 SG_ SUP_S01PID58_LongSecOxyTrimBank2 m64 : 40|1@0+ (1,0) [0|1] "" Vector__XXX
 SG_ SUP_S01PID38_OxySensor5_FAER m32 : 40|1@0+ (1,0) [0|1] "" Vector__XXX
 SG_ SUP_S01PID18_OxySensor5_Volt m0 : 40|1@0+ (1,0) [0|1] "" Vector__XXX
 SG_ SUP_S01PID57_ShortSecOxyTrimBank m64 : 41|1@0+ (1,0) [0|1] "" Vector__XXX
 SG_ SUP_S01PID37_OxySensor4_FAER m32 : 41|1@0+ (1,0) [0|1] "" Vector__XXX
 SG_ SUP_S01PID17_OxySensor4_Volt m0 : 41|1@0+ (1,0) [0|1] "" Vector__XXX
 SG_ SUP_S01PID56_LongSecOxyTrimBank1 m64 : 42|1@0+ (1,0) [0|1] "" Vector__XXX
 SG_ SUP_S01PID36_OxySensor3_FAER m32 : 42|1@0+ (1,0) [0|1] "" Vector__XXX
 SG_ SUP_S01PID16_OxySensor3_Volt m0 : 42|1@0+ (1,0) [0|1] "" Vector__XXX
 SG_ SUP_S01PID55_ShortSecOxyTrimBank m64 : 43|1@0+ (1,0) [0|1] "" Vector__XXX
 SG_ SUP_S01PID35_OxySensor2_FAER m32 : 43|1@0+ (1,0) [0|1] "" Vector__XXX
 SG_ SUP_S01PID15_OxySensor2_Volt m0 : 43|1@0+ (1,0) [0|1] "" Vector__XXX
 SG_ SUP_S01PID54_EvapSysVapPres m64 : 44|1@0+ (1,0) [0|1] "" Vector__XXX
 SG_ SUP_S01PID34_OxySensor1_FAER m32 : 44|1@0+ (1,0) [0|1] "" Vector__XXX
 SG_ SUP_S01PID14_OxySensor1_Volt m0 : 44|1@0+ (1,0) [0|1] "" Vector__XXX
 SG_ SUP_S01PID53_AbsEvapSysVapPres m64 : 45|1@0+ (1,0) [0|1] "" Vector__XXX
 SG_ SUP_S01PID33_AbsBaroPres m32 : 45|1@0+ (1,0) [0|1] "" Vector__XXX
 SG_ SUP_S01PID52_EthanolFuelPct m64 : 46|1@0+ (1,0) [0|1] "" Vector__XXX
 SG_ SUP_S01PID32_EvapSysVaporPres m32 : 46|1@0+ (1,0) [0|1] "" Vector__XXX
 SG_ SUP_S01PID12_CmdSecAirStatus m0 : 46|1@0+ (1,0) [0|1] "" Vector__XXX
 SG_ SUP_S01PID51_FuelType m64 : 47|1@0+ (1,0) [0|1] "" Vector__XXX
 SG_ SUP_S01PID31_DistSinceCodeClear m32 : 47|1@0+ (1,0) [0|1] "" Vector__XXX
 SG_ SUP_S01PID11_ThrottlePosition m0 : 47|1@0+ (1,0) [0|1] "" Vector__XXX
 SG_ S01PID4F_Max_OxySensCrnt m79 : 47|8@0+ (1,0) [0|255] "mA" Vector__XXX
 SG_ S01PID3B_OxySensor8_Crnt m59 : 47|16@0+ (0.00390625,-128) [-128|128] "mA" Vector__XXX
 SG_ S01PID3A_OxySensor7_Crnt m58 : 47|16@0+ (0.00390625,-128) [-128|128] "mA" Vector__XXX
 SG_ S01PID39_OxySensor6_Crnt m57 : 47|16@0+ (0.00390625,-128) [-128|128] "mA" Vector__XXX
 SG_ S01PID38_OxySensor5_Crnt m56 : 47|16@0+ (0.00390625,-128) [-128|128] "mA" Vector__XXX
 SG_ S01PID37_OxySensor4_Crnt m55 : 47|16@0+ (0.00390625,-128) [-128|128] "mA" Vector__XXX
 SG_ S01PID36_OxySensor3_Crnt m54 : 47|16@0+ (0.00390625,-128) [-128|128] "mA" Vector__XXX
 SG_ S01PID35_OxySensor2_Crnt m53 : 47|16@0+ (0.00390625,-128) [-128|128] "mA" Vector__XXX
 SG_ S01PID34_OxySensor1_Crnt m52 : 47|16@0+ (0.00390625,-128) [-128|128] "mA" Vector__XXX
 SG_ S01PID2B_OxySensor8_Volt m43 : 47|16@0+ (0.0001220703125,0) [0|8] "volts" Vector__XXX
 SG_ S01PID2A_OxySensor7_Volt m42 : 47|16@0+ (0.0001220703125,0) [0|8] "volts" Vector__XXX
 SG_ S01PID29_OxySensor6_Volt m41 : 47|16@0+ (0.0001220703125,0) [0|8] "volts" Vector__XXX
 SG_ S01PID28_OxySensor5_Volt m40 : 47|16@0+ (0.0001220703125,0) [0|8] "volts" Vector__XXX
 SG_ S01PID27_OxySensor4_Volt m39 : 47|16@0+ (0.0001220703125,0) [0|8] "volts" Vector__XXX
 SG_ S01PID26_OxySensor3_Volt m38 : 47|16@0+ (0.0001220703125,0) [0|8] "volts" Vector__XXX
 SG_ S01PID25_OxySensor2_Volt m37 : 47|16@0+ (0.0001220703125,0) [0|8] "volts" Vector__XXX
 SG_ S01PID24_OxySensor1_Volt m36 : 47|16@0+ (0.0001220703125,0) [0|2] "volts" Vector__XXX
 SG_ SUP_S01PID70_BoostPresCntrl m96 : 32|1@0+ (1,0) [0|1] "" Vector__XXX
 SG_ SUP_S01PID50_Max_AirFlowMAF m64 : 32|1@0+ (1,0) [0|1] "" Vector__XXX
 SG_ SUP_S01PID30_WaUpsSinceCodeClear m32 : 32|1@0+ (1,0) [0|1] "" Vector__XXX
 SG_ SUP_S01PID10_MAFAirFlowRate m0 : 32|1@0+ (1,0) [0|1] "" Vector__XXX
 SG_ SUP_S01PID6F_TurboComprPres m96 : 33|1@0+ (1,0) [0|1] "" Vector__XXX
 SG_ SUP_S01PID4F_Max_FAER m64 : 33|1@0+ (1,0) [0|1] "" Vector__XXX
 SG_ SUP_S01PID2F_FuelTankLevel m32 : 33|1@0+ (1,0) [0|1] "" Vector__XXX
 SG_ SUP_S01PID0F_IntakeAirTemperatur m0 : 33|1@0+ (1,0) [0|1] "" Vector__XXX
 SG_ SUP_S01PID8E_EngFrictionPctTorq m128 : 34|1@0+ (1,0) [0|1] "" Vector__XXX
 SG_ SUP_S01PID6E_InjPresContrSys m96 : 34|1@0+ (1,0) [0|1] "" Vector__XXX
 SG_ SUP_S01PID4E_TimeSinceCodeClear m64 : 34|1@0+ (1,0) [0|1] "" Vector__XXX
 SG_ SUP_S01PID2E_CmdEvapPurge m32 : 34|1@0+ (1,0) [0|1] "" Vector__XXX
 SG_ SUP_S01PID0E_TimingAdvance m0 : 34|1@0+ (1,0) [0|1] "" Vector__XXX
 SG_ SUP_S01PID6D_FuelPresContrSys m96 : 35|1@0+ (1,0) [0|1] "" Vector__XXX
 SG_ SUP_S01PID4D_TimeRunMILOn m64 : 35|1@0+ (1,0) [0|1] "" Vector__XXX
 SG_ SUP_S01PID2D_EGRError m32 : 35|1@0+ (1,0) [0|1] "" Vector__XXX
 SG_ SUP_S01PID0D_VehicleSpeed m0 : 35|1@0+ (1,0) [0|1] "" Vector__XXX
 SG_ SUP_S01PID6C_CmdThrottleActRel m96 : 36|1@0+ (1,0) [0|1] "" Vector__XXX
 SG_ SUP_S01PID4C_CmdThrottleAct m64 : 36|1@0+ (1,0) [0|1] "" Vector__XXX
 SG_ SUP_S01PID2C_CmdEGR m32 : 36|1@0+ (1,0) [0|1] "" Vector__XXX
 SG_ SUP_S01PID0C_EngineRPM m0 : 36|1@0+ (1,0) [0|1] "" Vector__XXX
 SG_ SUP_S01PID6B_ExhaustGasTemp m96 : 37|1@0+ (1,0) [0|1] "" Vector__XXX
 SG_ SUP_S01PID4B_AbsThrottlePosF m64 : 37|1@0+ (1,0) [0|1] "" Vector__XXX
 SG_ SUP_S01PID2B_OxySensor8_FAER m32 : 37|1@0+ (1,0) [0|1] "" Vector__XXX
 SG_ SUP_S01PID0B_IntakeManiAbsPress m0 : 37|1@0+ (1,0) [0|1] "" Vector__XXX
 SG_ SUP_S01PID6A_CmdDieselIntAir m96 : 38|1@0+ (1,0) [0|1] "" Vector__XXX
 SG_ SUP_S01PID4A_AbsThrottlePosE m64 : 38|1@0+ (1,0) [0|1] "" Vector__XXX
 SG_ SUP_S01PID2A_OxySensor7_FAER m32 : 38|1@0+ (1,0) [0|1] "" Vector__XXX
 SG_ SUP_S01PID0A_FuelPressure m0 : 38|1@0+ (1,0) [0|1] "" Vector__XXX
 SG_ SUP_S01PID69_CmdEGR_EGRError m96 : 39|1@0+ (1,0) [0|1] "" Vector__XXX
 SG_ SUP_S01PID49_AbsThrottlePosD m64 : 39|1@0+ (1,0) [0|1] "" Vector__XXX
 SG_ SUP_S01PID29_OxySensor6_FAER m32 : 39|1@0+ (1,0) [0|1] "" Vector__XXX
 SG_ SUP_S01PID09_LongFuelTrimBank2 m0 : 39|1@0+ (1,0) [0|1] "" Vector__XXX
 SG_ S01PID58_LongSecOxyTrimBank4 m88 : 39|8@0+ (0.78125,-100) [-100|99.21875] "%" Vector__XXX
 SG_ S01PID57_ShortSecOxyTrimBank4 m87 : 39|8@0+ (0.78125,-100) [-100|99.21875] "%" Vector__XXX
 SG_ S01PID56_LongSecOxyTrimBank3 m86 : 39|8@0+ (0.78125,-100) [-100|99.21875] "%" Vector__XXX
 SG_ S01PID55_ShortSecOxyTrimBank3 m85 : 39|8@0+ (0.78125,-100) [-100|99.21875] "%" Vector__XXX
 SG_ S01PID4F_Max_OxySensVol m79 : 39|8@0+ (1,0) [0|255] "V" Vector__XXX
 SG_ S01PID1B_OxySensor8_STFT m27 : 39|8@0+ (0.78125,-100) [-100|99.21875] "%" Vector__XXX
 SG_ S01PID1A_OxySensor7_STFT m26 : 39|8@0+ (0.78125,-100) [-100|99.21875] "%" Vector__XXX
 SG_ S01PID19_OxySensor6_STFT m25 : 39|8@0+ (0.78125,-100) [-100|99.21875] "%" Vector__XXX
 SG_ S01PID18_OxySensor5_STFT m24 : 39|8@0+ (0.78125,-100) [-100|99.21875] "%" Vector__XXX
 SG_ S01PID17_OxySensor4_STFT m23 : 39|8@0+ (0.78125,-100) [-100|99.21875] "%" Vector__XXX
 SG_ S01PID16_OxySensor3_STFT m22 : 39|8@0+ (0.78125,-100) [-100|99.21875] "%" Vector__XXX
 SG_ S01PID15_OxySensor2_STFT m21 : 39|8@0+ (0.78125,-100) [-100|99.21875] "%" Vector__XXX
 SG_ S01PID14_OxySensor1_STFT m20 : 39|8@0+ (0.78125,-100) [-100|99.21875] "%" Vector__XXX
 SG_ SUP_S01PID68_IntakeAirTempSens m96 : 24|1@0+ (1,0) [0|1] "" Vector__XXX
 SG_ SUP_S01PID48_AbsThrottlePosC m64 : 24|1@0+ (1,0) [0|1] "" Vector__XXX
 SG_ SUP_S01PID28_OxySensor5_FAER m32 : 24|1@0+ (1,0) [0|1] "" Vector__XXX
 SG_ SUP_S01PID08_ShortFuelTrimBank2 m0 : 24|1@0+ (1,0) [0|1] "" Vector__XXX
 SG_ SUP_S01PID67_EngineCoolantTemp m96 : 25|1@0+ (1,0) [0|1] "" Vector__XXX
 SG_ SUP_S01PID47_AbsThrottlePosB m64 : 25|1@0+ (1,0) [0|1] "" Vector__XXX
 SG_ SUP_S01PID27_OxySensor4_FAER m32 : 25|1@0+ (1,0) [0|1] "" Vector__XXX
 SG_ SUP_S01PID07_LongFuelTrimBank1 m0 : 25|1@0+ (1,0) [0|1] "" Vector__XXX
 SG_ SUP_S01PIDA6_Odometer m160 : 26|1@0+ (1,0) [0|1] "" Vector__XXX
 SG_ SUP_S01PID66_MAFSensor m96 : 26|1@0+ (1,0) [0|1] "" Vector__XXX
 SG_ SUP_S01PID46_AmbientAirTemp m64 : 26|1@0+ (1,0) [0|1] "" Vector__XXX
 SG_ SUP_S01PID26_OxySensor3_FAER m32 : 26|1@0+ (1,0) [0|1] "" Vector__XXX
 SG_ SUP_S01PID06_ShortFuelTrimBank1 m0 : 26|1@0+ (1,0) [0|1] "" Vector__XXX
 SG_ SUP_S01PID65_AuxInputOutput m96 : 27|1@0+ (1,0) [0|1] "" Vector__XXX
 SG_ SUP_S01PID45_RelThrottlePos m64 : 27|1@0+ (1,0) [0|1] "" Vector__XXX
 SG_ SUP_S01PID25_OxySensor2_FAER m32 : 27|1@0+ (1,0) [0|1] "" Vector__XXX
 SG_ SUP_S01PID05_EngineCoolantTemp m0 : 27|1@0+ (1,0) [0|1] "" Vector__XXX
 SG_ SUP_S01PID64_EngPctTorq_Idle m96 : 28|1@0+ (1,0) [0|1] "" Vector__XXX
 SG_ SUP_S01PID44_FuelAirCmdEquiv m64 : 28|1@0+ (1,0) [0|1] "" Vector__XXX
 SG_ SUP_S01PID24_OxySensor1_FAER m32 : 28|1@0+ (1,0) [0|1] "" Vector__XXX
 SG_ SUP_S01PID04_CalcEngineLoad m0 : 28|1@0+ (1,0) [0|1] "" Vector__XXX
 SG_ SUP_S01PID63_EngRefTorq m96 : 29|1@0+ (1,0) [0|1] "" Vector__XXX
 SG_ SUP_S01PID43_AbsLoadValue m64 : 29|1@0+ (1,0) [0|1] "" Vector__XXX
 SG_ SUP_S01PID23_FuelRailGaug m32 : 29|1@0+ (1,0) [0|1] "" Vector__XXX
 SG_ SUP_S01PID03_FuelSystemStatus m0 : 29|1@0+ (1,0) [0|1] "" Vector__XXX
 SG_ SUP_S01PID62_ActualEngTorqPct m96 : 30|1@0+ (1,0) [0|1] "" Vector__XXX
 SG_ SUP_S01PID42_ControlModuleVolt m64 : 30|1@0+ (1,0) [0|1] "" Vector__XXX
 SG_ SUP_S01PID22_FuelRailPres m32 : 30|1@0+ (1,0) [0|1] "" Vector__XXX
 SG_ SUP_S01PID02_FreezeDTC m0 : 30|1@0+ (1,0) [0|1] "" Vector__XXX
 SG_ SUP_S01PID61_DemandEngTorqPct m96 : 31|1@0+ (1,0) [0|1] "" Vector__XXX
 SG_ SUP_S01PID41_MonStatusDriveCycle m64 : 31|1@0+ (1,0) [0|1] "" Vector__XXX
 SG_ SUP_S01PID21_DistanceMILOn m32 : 31|1@0+ (1,0) [0|1] "" Vector__XXX
 SG_ SUP_S01PID01_MonitorStatus m0 : 31|1@0+ (1,0) [0|1] "" Vector__XXX
 SG_ S02PID02_FreezeDTC m2 : 31|16@0+ (1,0) [0|65535] "" Vector__XXX
 SG_ S01PIDA6_Odometer m166 : 31|32@0+ (0.1,0) [0|429496729.5] "km" Vector__XXX
 SG_ S01PID8E_EngFrictionPctTorq m142 : 31|8@0+ (1,-125) [-125|130] "%" Vector__XXX
 SG_ S01PID70_BoostPresCntrl m112 : 31|8@0+ (1,0) [0|255] "" Vector__XXX
 SG_ S01PID6F_TurboComprPres m111 : 31|8@0+ (1,0) [0|255] "" Vector__XXX
 SG_ S01PID6E_InjPresContrSys m110 : 31|8@0+ (1,0) [0|255] "" Vector__XXX
 SG_ S01PID6D_FuelPresContrSys m109 : 31|8@0+ (1,0) [0|255] "" Vector__XXX
 SG_ S01PID6C_CmdThrottleActRel m108 : 31|8@0+ (1,0) [0|255] "" Vector__XXX
 SG_ S01PID6B_ExhaustGasTemp m107 : 31|8@0+ (1,0) [0|255] "" Vector__XXX
 SG_ S01PID6A_CmdDieselIntAir m106 : 31|8@0+ (1,0) [0|255] "" Vector__XXX
 SG_ S01PID69_CmdEGR_EGRError m105 : 31|8@0+ (1,0) [0|255] "" Vector__XXX
 SG_ S01PID68_IntakeAirTempSens m104 : 31|8@0+ (1,0) [0|255] "" Vector__XXX
 SG_ S01PID67_EngineCoolantTemp m103 : 31|8@0+ (1,0) [0|255] "" Vector__XXX
 SG_ S01PID66_MAFSensor m102 : 31|8@0+ (1,0) [0|255] "" Vector__XXX
 SG_ S01PID65_AuxInputOutput m101 : 31|8@0+ (1,0) [0|255] "" Vector__XXX
 SG_ S01PID63_EngRefTorq m99 : 31|16@0+ (1,0) [0|65535] "Nm" Vector__XXX
 SG_ S01PID62_ActualEngTorqPct m98 : 31|8@0+ (1,-125) [-125|130] "%" Vector__XXX
 SG_ S01PID61_DemandEngTorqPct m97 : 31|8@0+ (1,-125) [-125|130] "%" Vector__XXX
 SG_ S01PID5F_EmissionReq m95 : 31|8@0+ (1,0) [0|255] "" Vector__XXX
 SG_ S01PID5E_EngineFuelRate m94 : 31|16@0+ (0.05,0) [0|3276.75] "L/h" Vector__XXX
 SG_ S01PID5D_FuelInjectionTiming m93 : 31|16@0+ (0.0078125,-210) [-210|301.9921875] "deg" Vector__XXX
 SG_ S01PID5C_EngineOilTemp m92 : 31|8@0+ (1,-40) [-40|215] "degC" Vector__XXX
 SG_ S01PID5B_HybrBatPackRemLife m91 : 31|8@0+ (0.392156862745098,0) [0|100] "%" Vector__XXX
 SG_ S01PID5A_RelAccelPedalPos m90 : 31|8@0+ (0.392156862745098,0) [0|100] "%" Vector__XXX
 SG_ S01PID59_FuelRailAbsPres m89 : 31|16@0+ (10,0) [0|655350] "kPa" Vector__XXX
 SG_ S01PID58_LongSecOxyTrimBank2 m88 : 31|8@0+ (0.78125,-100) [-100|99.21875] "%" Vector__XXX
 SG_ S01PID57_ShortSecOxyTrimBank2 m87 : 31|8@0+ (0.78125,-100) [-100|99.21875] "%" Vector__XXX
 SG_ S01PID56_LongSecOxyTrimBank1 m86 : 31|8@0+ (0.78125,-100) [-100|99.21875] "%" Vector__XXX
 SG_ S01PID55_ShortSecOxyTrimBank1 m85 : 31|8@0+ (0.78125,-100) [-100|99.21875] "%" Vector__XXX
 SG_ S01PID54_EvapSysVapPres m84 : 31|16@0+ (1,-32767) [-32767|32768] "Pa" Vector__XXX
 SG_ S01PID53_AbsEvapSysVapPres m83 : 31|16@0+ (0.005,0) [0|327.675] "kPa" Vector__XXX
 SG_ S01PID52_EthanolFuelPct m82 : 31|8@0+ (0.392156862745098,0) [0|100] "%" Vector__XXX
 SG_ S01PID51_FuelType m81 : 31|8@0+ (1,0) [0|255] "" Vector__XXX
 SG_ S01PID50_Max_AirFlowMAF m80 : 31|8@0+ (10,0) [0|2550] "g/s" Vector__XXX
 SG_ S01PID4F_Max_FAER m79 : 31|8@0+ (1,0) [0|255] "ratio" Vector__XXX
 SG_ S01PID4E_TimeSinceCodeClear m78 : 31|16@0+ (1,0) [0|65535] "minutes" Vector__XXX
 SG_ S01PID4D_TimeRunMILOn m77 : 31|16@0+ (1,0) [0|65535] "minutes" Vector__XXX
 SG_ S01PID4C_CmdThrottleAct m76 : 31|8@0+ (0.392156862745098,0) [0|100] "%" Vector__XXX
 SG_ S01PID4B_AbsThrottlePosF m75 : 31|8@0+ (0.392156862745098,0) [0|100] "%" Vector__XXX
 SG_ S01PID4A_AbsThrottlePosE m74 : 31|8@0+ (0.392156862745098,0) [0|100] "%" Vector__XXX
 SG_ S01PID49_AbsThrottlePosD m73 : 31|8@0+ (0.392156862745098,0) [0|100] "%" Vector__XXX
 SG_ S01PID48_AbsThrottlePosC m72 : 31|8@0+ (0.392156862745098,0) [0|100] "%" Vector__XXX
 SG_ S01PID47_AbsThrottlePosB m71 : 31|8@0+ (0.392156862745098,0) [0|100] "%" Vector__XXX
 SG_ S01PID46_AmbientAirTemp m70 : 31|8@0+ (1,-40) [-40|215] "degC" Vector__XXX
 SG_ S01PID45_RelThrottlePos m69 : 31|8@0+ (0.392156862745098,0) [0|100] "%" Vector__XXX
 SG_ S01PID44_FuelAirCmdEquiv m68 : 31|16@0+ (3.0517578125e-05,0) [0|2] "ratio" Vector__XXX
 SG_ S01PID43_AbsLoadValue m67 : 31|16@0+ (0.392156862745098,0) [0|25700] "%" Vector__XXX
 SG_ S01PID42_ControlModuleVolt m66 : 31|16@0+ (0.001,0) [0|65.535] "V" Vector__XXX
 SG_ S01PID41_MonStatusDriveCycle m65 : 31|32@0+ (1,0) [0|4294967295] "" Vector__XXX
 SG_ S01PID3F_CatTempBank2Sens2 m63 : 31|16@0+ (0.1,-40) [-40|6513.5] "degC" Vector__XXX
 SG_ S01PID3E_CatTempBank1Sens2 m62 : 31|16@0+ (0.1,-40) [-40|6513.5] "degC" Vector__XXX
 SG_ S01PID3D_CatTempBank2Sens1 m61 : 31|16@0+ (0.1,-40) [-40|6513.5] "degC" Vector__XXX
 SG_ S01PID3C_CatTempBank1Sens1 m60 : 31|16@0+ (0.1,-40) [-40|6513.5] "degC" Vector__XXX
 SG_ S01PID3B_OxySensor8_FAER m59 : 31|16@0+ (3.0517578125e-05,0) [0|2] "ratio" Vector__XXX
 SG_ S01PID3A_OxySensor7_FAER m58 : 31|16@0+ (3.0517578125e-05,0) [0|2] "ratio" Vector__XXX
 SG_ S01PID39_OxySensor6_FAER m57 : 31|16@0+ (3.0517578125e-05,0) [0|2] "ratio" Vector__XXX
 SG_ S01PID38_OxySensor5_FAER m56 : 31|16@0+ (3.0517578125e-05,0) [0|2] "ratio" Vector__XXX
 SG_ S01PID37_OxySensor4_FAER m55 : 31|16@0+ (3.0517578125e-05,0) [0|2] "ratio" Vector__XXX
 SG_ S01PID36_OxySensor3_FAER m54 : 31|16@0+ (3.0517578125e-05,0) [0|2] "ratio" Vector__XXX
 SG_ S01PID35_OxySensor2_FAER m53 : 31|16@0+ (3.0517578125e-05,0) [0|2] "ratio" Vector__XXX
 SG_ S01PID34_OxySensor1_FAER m52 : 31|16@0+ (3.0517578125e-05,0) [0|2] "ratio" Vector__XXX
 SG_ S01PID33_AbsBaroPres m51 : 31|8@0+ (1,0) [0|255] "kPa" Vector__XXX
 SG_ S01PID32_EvapSysVaporPres m50 : 31|16@0+ (0.25,0) [-8192|8191.75] "Pa" Vector__XXX
 SG_ S01PID31_DistSinceCodeClear m49 : 31|16@0+ (1,0) [0|65535] "km" Vector__XXX
 SG_ S01PID30_WaUpsSinceCodeClear m48 : 31|8@0+ (1,0) [0|255] "count" Vector__XXX
 SG_ S01PID2F_FuelTankLevel m47 : 31|8@0+ (0.392156862745098,0) [0|100] "%" Vector__XXX
 SG_ S01PID2E_CmdEvapPurge m46 : 31|8@0+ (0.392156862745098,0) [0|100] "%" Vector__XXX
 SG_ S01PID2D_EGRError m45 : 31|8@0+ (0.78125,-100) [-100|99.21875] "%" Vector__XXX
 SG_ S01PID2C_CmdEGR m44 : 31|8@0+ (0.392156862745098,0) [0|100] "%" Vector__XXX
 SG_ S01PID2B_OxySensor8_FAER m43 : 31|16@0+ (3.0517578125e-05,0) [0|2] "ratio" Vector__XXX
 SG_ S01PID2A_OxySensor7_FAER m42 : 31|16@0+ (3.0517578125e-05,0) [0|2] "ratio" Vector__XXX
 SG_ S01PID29_OxySensor6_FAER m41 : 31|16@0+ (3.0517578125e-05,0) [0|2] "ratio" Vector__XXX
 SG_ S01PID28_OxySensor5_FAER m40 : 31|16@0+ (3.0517578125e-05,0) [0|2] "ratio" Vector__XXX
 SG_ S01PID27_OxySensor4_FAER m39 : 31|16@0+ (3.0517578125e-05,0) [0|2] "ratio" Vector__XXX
 SG_ S01PID26_OxySensor3_FAER m38 : 31|16@0+ (3.0517578125e-05,0) [0|2] "ratio" Vector__XXX
 SG_ S01PID25_OxySensor2_FAER m37 : 31|16@0+ (3.0517578125e-05,0) [0|2] "ratio" Vector__XXX
 SG_ S01PID24_OxySensor1_FAER m36 : 31|16@0+ (3.0517578125e-05,0) [0|2] "ratio" Vector__XXX
 SG_ S01PID23_FuelRailGaug m35 : 31|16@0+ (10,0) [0|655350] "kPa" Vector__XXX
 SG_ S01PID22_FuelRailPres m34 : 31|16@0+ (0.079,0) [0|5177.265] "kPa" Vector__XXX
 SG_ S01PID21_DistanceMILOn m33 : 31|16@0+ (1,0) [0|65535] "km" Vector__XXX
 SG_ S01PID1F_TimeSinceEngStart m31 : 31|16@0+ (1,0) [0|65535] "seconds" Vector__XXX
 SG_ S01PID1C_OBDStandard m28 : 31|8@0+ (1,0) [0|255] "" Vector__XXX
 SG_ S01PID1B_OxySensor8_Volt m27 : 31|8@0+ (0.005,0) [0|1.275] "volts" Vector__XXX
 SG_ S01PID1A_OxySensor7_Volt m26 : 31|8@0+ (0.005,0) [0|1.275] "volts" Vector__XXX
 SG_ S01PID19_OxySensor6_Volt m25 : 31|8@0+ (0.005,0) [0|1.275] "volts" Vector__XXX
 SG_ S01PID18_OxySensor5_Volt m24 : 31|8@0+ (0.005,0) [0|1.275] "volts" Vector__XXX
 SG_ S01PID17_OxySensor4_Volt m23 : 31|8@0+ (0.005,0) [0|1.275] "volts" Vector__XXX
 SG_ S01PID16_OxySensor3_Volt m22 : 31|8@0+ (0.005,0) [0|1.275] "volts" Vector__XXX
 SG_ S01PID15_OxySensor2_Volt m21 : 31|8@0+ (0.005,0) [0|1.275] "volts" Vector__XXX
 SG_ S01PID14_OxySensor1_Volt m20 : 31|8@0+ (0.005,0) [0|1.275] "volts" Vector__XXX
 SG_ S01PID12_CmdSecAirStatus m18 : 31|8@0+ (1,0) [0|255] "" Vector__XXX
 SG_ S01PID11_ThrottlePosition m17 : 31|8@0+ (0.39216,0) [0|100] "%" Vector__XXX
 SG_ S01PID10_MAFAirFlowRate m16 : 31|16@0+ (0.01,0) [0|655.35] "grams/sec" Vector__XXX
 SG_ S01PID0F_IntakeAirTemperature m15 : 31|8@0+ (1,-40) [-40|215] "degC" Vector__XXX
 SG_ S01PID0E_TimingAdvance m14 : 31|8@0+ (0.5,-64) [-64|63.5] "deg before TDC" Vector__XXX
 SG_ S01PID0D_VehicleSpeed m13 : 31|8@0+ (1,0) [0|255] "km/h" Vector__XXX
 SG_ S01PID0C_EngineRPM m12 : 31|16@0+ (0.25,0) [0|16383.75] "rpm" Vector__XXX
 SG_ S01PID0B_IntakeManiAbsPress m11 : 31|8@0+ (1,0) [0|255] "kPa" Vector__XXX
 SG_ S01PID0A_FuelPressure m10 : 31|8@0+ (3,0) [0|765] "kPa" Vector__XXX
 SG_ S01PID09_LongFuelTrimBank2 m9 : 31|8@0+ (0.78125,-100) [-100|99.21875] "%" Vector__XXX
 SG_ S01PID08_ShortFuelTrimBank2 m8 : 31|8@0+ (0.78125,-100) [-100|99.21875] "%" Vector__XXX
 SG_ S01PID07_LongFuelTrimBank1 m7 : 31|8@0+ (0.78125,-100) [-100|99.21875] "%" Vector__XXX
 SG_ S01PID06_ShortFuelTrimBank1 m6 : 31|8@0+ (0.78125,-100) [-100|99.21875] "%" Vector__XXX
 SG_ S01PID05_EngineCoolantTemp m5 : 31|8@0+ (1,-40) [-40|215] "degC" Vector__XXX
 SG_ S01PID04_CalcEngineLoad m4 : 31|8@0+ (0.39216,0) [0|100] "%" Vector__XXX
 SG_ S01PID03_FuelSystemStatus m3 : 31|16@0+ (1,0) [0|65535] "" Vector__XXX
 SG_ S01PID02_FreezeDTC m2 : 31|16@0+ (1,0) [0|65535] "" Vector__XXX
 SG_ S01PID01_MonitorStatus m1 : 31|32@0+ (1,0) [0|4294967295] "" Vector__XXX
 SG_ S02PID m2M : 23|8@0+ (1,0) [0|255] "" Vector__XXX
 SG_ S01PID m1M : 23|8@0+ (1,0) [0|255] "" Vector__XXX
 SG_ S M : 13|6@0+ (1,0) [1|63] "" Vector__XXX
 SG_ Length : 7|8@0+ (1,0) [0|8] "" Vector__XXX

BO_ 2015 OBD_TX: 8 Vector__XXX
 SG_ S01PID4F_Max_IntManiAbsPres m79 : 55|8@0+ (10,0) [2550|2550] "kPa" Vector__XXX
 SG_ S01PID4F_Max_OxySensCrnt m79 : 47|8@0+ (1,0) [255|255] "mA" Vector__XXX
 SG_ S01PID3B_OxySensor8_Crnt m59 : 47|16@0+ (0.00390625,-128) [127.99609375|127.99609375] "mA" Vector__XXX
 SG_ S01PID3A_OxySensor7_Crnt m58 : 47|16@0+ (0.00390625,-128) [127.99609375|127.99609375] "mA" Vector__XXX
 SG_ S01PID39_OxySensor6_Crnt m57 : 47|16@0+ (0.00390625,-128) [127.99609375|127.99609375] "mA" Vector__XXX
 SG_ S01PID38_OxySensor5_Crnt m56 : 47|16@0+ (0.00390625,-128) [127.99609375|127.99609375] "mA" Vector__XXX
 SG_ S01PID37_OxySensor4_Crnt m55 : 47|16@0+ (0.00390625,-128) [127.99609375|127.99609375] "mA" Vector__XXX
 SG_ S01PID36_OxySensor3_Crnt m54 : 47|16@0+ (0.00390625,-128) [127.99609375|127.99609375] "mA" Vector__XXX
 SG_ S01PID35_OxySensor2_Crnt m53 : 47|16@0+ (0.00390625,-128) [127.99609375|127.99609375] "mA" Vector__XXX
 SG_ S01PID34_OxySensor1_Crnt m52 : 47|16@0+ (0.00390625,-128) [127.99609375|127.99609375] "mA" Vector__XXX
 SG_ S01PID2B_OxySensor8_Volt m43 : 47|16@0+ (0.0001220703125,0) [7.9998779296875|7.9998779296875] "volts" Vector__XXX
 SG_ S01PID2A_OxySensor7_Volt m42 : 47|16@0+ (0.0001220703125,0) [7.9998779296875|7.9998779296875] "volts" Vector__XXX
 SG_ S01PID29_OxySensor6_Volt m41 : 47|16@0+ (0.0001220703125,0) [7.9998779296875|7.9998779296875] "volts" Vector__XXX
 SG_ S01PID28_OxySensor5_Volt m40 : 47|16@0+ (0.0001220703125,0) [7.9998779296875|7.9998779296875] "volts" Vector__XXX
 SG_ S01PID27_OxySensor4_Volt m39 : 47|16@0+ (0.0001220703125,0) [7.9998779296875|7.9998779296875] "volts" Vector__XXX
 SG_ S01PID26_OxySensor3_Volt m38 : 47|16@0+ (0.0001220703125,0) [7.9998779296875|7.9998779296875] "volts" Vector__XXX
 SG_ S01PID25_OxySensor2_Volt m37 : 47|16@0+ (0.0001220703125,0) [7.9998779296875|7.9998779296875] "volts" Vector__XXX
 SG_ S01PID24_OxySensor1_Volt m36 : 47|16@0+ (0.0001220703125,0) [7.9998779296875|7.9998779296875] "volts" Vector__XXX
 SG_ S01PID58_LongSecOxyTrimBank4 m88 : 39|8@0+ (0.78125,-100) [99.21875|99.21875] "%" Vector__XXX
 SG_ S01PID57_ShortSecOxyTrimBank4 m87 : 39|8@0+ (0.78125,-100) [99.21875|99.21875] "%" Vector__XXX
 SG_ S01PID56_LongSecOxyTrimBank3 m86 : 39|8@0+ (0.78125,-100) [99.21875|99.21875] "%" Vector__XXX
 SG_ S01PID55_ShortSecOxyTrimBank3 m85 : 39|8@0+ (0.78125,-100) [99.21875|99.21875] "%" Vector__XXX
 SG_ S01PID4F_Max_OxySensVol m79 : 39|8@0+ (1,0) [255|255] "V" Vector__XXX
 SG_ S01PID1B_OxySensor8_STFT m27 : 39|8@0+ (0.78125,-100) [99.21875|99.21875] "%" Vector__XXX
 SG_ S01PID1A_OxySensor7_STFT m26 : 39|8@0+ (0.78125,-100) [99.21875|99.21875] "%" Vector__XXX
 SG_ S01PID19_OxySensor6_STFT m25 : 39|8@0+ (0.78125,-100) [99.21875|99.21875] "%" Vector__XXX
 SG_ S01PID18_OxySensor5_STFT m24 : 39|8@0+ (0.78125,-100) [99.21875|99.21875] "%" Vector__XXX
 SG_ S01PID17_OxySensor4_STFT m23 : 39|8@0+ (0.78125,-100) [99.21875|99.21875] "%" Vector__XXX
 SG_ S01PID16_OxySensor3_STFT m22 : 39|8@0+ (0.78125,-100) [99.21875|99.21875] "%" Vector__XXX
 SG_ S01PID15_OxySensor2_STFT m21 : 39|8@0+ (0.78125,-100) [99.21875|99.21875] "%" Vector__XXX
 SG_ S01PID14_OxySensor1_STFT m20 : 39|8@0+ (0.78125,-100) [99.21875|99.21875] "%" Vector__XXX
 SG_ S01PIDA6_Odometer m166 : 31|32@0+ (0.1,0) [429496729.5|429496729.5] "km" Vector__XXX
 SG_ S01PID8E_EngFrictionPctTorq m142 : 31|8@0+ (1,-125) [130|130] "%" Vector__XXX
 SG_ S01PID70_BoostPresCntrl m112 : 31|8@0+ (1,0) [255|255] "" Vector__XXX
 SG_ S01PID6F_TurboComprPres m111 : 31|8@0+ (1,0) [255|255] "" Vector__XXX
 SG_ S01PID6E_InjPresContrSys m110 : 31|8@0+ (1,0) [255|255] "" Vector__XXX
 SG_ S01PID6D_FuelPresContrSys m109 : 31|8@0+ (1,0) [255|255] "" Vector__XXX
 SG_ S01PID6C_CmdThrottleActRel m108 : 31|8@0+ (1,0) [255|255] "" Vector__XXX
 SG_ S01PID6B_ExhaustGasTemp m107 : 31|8@0+ (1,0) [255|255] "" Vector__XXX
 SG_ S01PID6A_CmdDieselIntAir m106 : 31|8@0+ (1,0) [255|255] "" Vector__XXX
 SG_ S01PID69_CmdEGR_EGRError m105 : 31|8@0+ (1,0) [255|255] "" Vector__XXX
 SG_ S01PID68_IntakeAirTempSens m104 : 31|8@0+ (1,0) [255|255] "" Vector__XXX
 SG_ S01PID67_EngineCoolantTemp m103 : 31|8@0+ (1,0) [255|255] "" Vector__XXX
 SG_ S01PID66_MAFSensor m102 : 31|8@0+ (1,0) [255|255] "" Vector__XXX
 SG_ S01PID65_AuxInputOutput m101 : 31|8@0+ (1,0) [255|255] "" Vector__XXX
 SG_ S01PID63_EngRefTorq m99 : 31|16@0+ (1,0) [65535|65535] "Nm" Vector__XXX
 SG_ S01PID62_ActualEngTorqPct m98 : 31|8@0+ (1,-125) [130|130] "%" Vector__XXX
 SG_ S01PID61_DemandEngTorqPct m97 : 31|8@0+ (1,-125) [130|130] "%" Vector__XXX
 SG_ S01PID5F_EmissionReq m95 : 31|8@0+ (1,0) [255|255] "" Vector__XXX
 SG_ S01PID5E_EngineFuelRate m94 : 31|16@0+ (0.05,0) [3276.75|3276.75] "L/h" Vector__XXX
 SG_ S01PID5D_FuelInjectionTiming m93 : 31|16@0+ (0.0078125,-210) [301.9921875|301.9921875] "deg" Vector__XXX
 SG_ S01PID5C_EngineOilTemp m92 : 31|8@0+ (1,-40) [215|215] "degC" Vector__XXX
 SG_ S01PID5B_HybrBatPackRemLife m91 : 31|8@0+ (0.392156862745098,0) [99.99999999999999|99.99999999999999] "%" Vector__XXX
 SG_ S01PID5A_RelAccelPedalPos m90 : 31|8@0+ (0.392156862745098,0) [99.99999999999999|99.99999999999999] "%" Vector__XXX
 SG_ S01PID59_FuelRailAbsPres m89 : 31|16@0+ (10,0) [655350|655350] "kPa" Vector__XXX
 SG_ S01PID58_LongSecOxyTrimBank2 m88 : 31|8@0+ (0.78125,-100) [99.21875|99.21875] "%" Vector__XXX
 SG_ S01PID57_ShortSecOxyTrimBank2 m87 : 31|8@0+ (0.78125,-100) [99.21875|99.21875] "%" Vector__XXX
 SG_ S01PID56_LongSecOxyTrimBank1 m86 : 31|8@0+ (0.78125,-100) [99.21875|99.21875] "%" Vector__XXX
 SG_ S01PID55_ShortSecOxyTrimBank1 m85 : 31|8@0+ (0.78125,-100) [99.21875|99.21875] "%" Vector__XXX
 SG_ S01PID54_EvapSysVapPres m84 : 31|16@0+ (1,-32767) [32768|32768] "Pa" Vector__XXX
 SG_ S01PID53_AbsEvapSysVapPres m83 : 31|16@0+ (0.005,0) [327.675|327.675] "kPa" Vector__XXX
 SG_ S01PID52_EthanolFuelPct m82 : 31|8@0+ (0.392156862745098,0) [99.99999999999999|99.99999999999999] "%" Vector__XXX
 SG_ S01PID51_FuelType m81 : 31|8@0+ (1,0) [255|255] "" Vector__XXX
 SG_ S01PID50_Max_AirFlowMAF m80 : 31|8@0+ (10,0) [2550|2550] "g/s" Vector__XXX
 SG_ S01PID4F_Max_FAER m79 : 31|8@0+ (1,0) [255|255] "ratio" Vector__XXX
 SG_ S01PID4E_TimeSinceCodeClear m78 : 31|16@0+ (1,0) [65535|65535] "minutes" Vector__XXX
 SG_ S01PID4D_TimeRunMILOn m77 : 31|16@0+ (1,0) [65535|65535] "minutes" Vector__XXX
 SG_ S01PID4C_CmdThrottleAct m76 : 31|8@0+ (0.392156862745098,0) [99.99999999999999|99.99999999999999] "%" Vector__XXX
 SG_ S01PID4B_AbsThrottlePosF m75 : 31|8@0+ (0.392156862745098,0) [99.99999999999999|99.99999999999999] "%" Vector__XXX
 SG_ S01PID4A_AbsThrottlePosE m74 : 31|8@0+ (0.392156862745098,0) [99.99999999999999|99.99999999999999] "%" Vector__XXX
 SG_ S01PID49_AbsThrottlePosD m73 : 31|8@0+ (0.392156862745098,0) [99.99999999999999|99.99999999999999] "%" Vector__XXX
 SG_ S01PID48_AbsThrottlePosC m72 : 31|8@0+ (0.392156862745098,0) [99.99999999999999|99.99999999999999] "%" Vector__XXX
 SG_ S01PID47_AbsThrottlePosB m71 : 31|8@0+ (0.392156862745098,0) [99.99999999999999|99.99999999999999] "%" Vector__XXX
 SG_ S01PID46_AmbientAirTemp m70 : 31|8@0+ (1,-40) [215|215] "degC" Vector__XXX
 SG_ S01PID45_RelThrottlePos m69 : 31|8@0+ (0.392156862745098,0) [99.99999999999999|99.99999999999999] "%" Vector__XXX
 SG_ S01PID44_FuelAirCmdEquiv m68 : 31|16@0+ (3.0517578125e-05,0) [1.999969482421875|1.999969482421875] "ratio" Vector__XXX
 SG_ S01PID43_AbsLoadValue m67 : 31|16@0+ (0.392156862745098,0) [25699.999999999996|25699.999999999996] "%" Vector__XXX
 SG_ S01PID42_ControlModuleVolt m66 : 31|16@0+ (0.001,0) [65.535|65.535] "V" Vector__XXX
 SG_ S01PID41_MonStatusDriveCycle m65 : 31|32@0+ (1,0) [4294967295|4294967295] "" Vector__XXX
 SG_ S01PID3F_CatTempBank2Sens2 m63 : 31|16@0+ (0.1,-40) [6513.5|6513.5] "degC" Vector__XXX
 SG_ S01PID3E_CatTempBank1Sens2 m62 : 31|16@0+ (0.1,-40) [6513.5|6513.5] "degC" Vector__XXX
 SG_ S01PID3D_CatTempBank2Sens1 m61 : 31|16@0+ (0.1,-40) [6513.5|6513.5] "degC" Vector__XXX
 SG_ S01PID3C_CatTempBank1Sens1 m60 : 31|16@0+ (0.1,-40) [6513.5|6513.5] "degC" Vector__XXX
 SG_ S01PID3B_OxySensor8_FAER m59 : 31|16@0+ (3.0517578125e-05,0) [1.999969482421875|1.999969482421875] "ratio" Vector__XXX
 SG_ S01PID3A_OxySensor7_FAER m58 : 31|16@0+ (3.0517578125e-05,0) [1.999969482421875|1.999969482421875] "ratio" Vector__XXX
 SG_ S01PID39_OxySensor6_FAER m57 : 31|16@0+ (3.0517578125e-05,0) [1.999969482421875|1.999969482421875] "ratio" Vector__XXX
 SG_ S01PID38_OxySensor5_FAER m56 : 31|16@0+ (3.0517578125e-05,0) [1.999969482421875|1.999969482421875] "ratio" Vector__XXX
 SG_ S01PID37_OxySensor4_FAER m55 : 31|16@0+ (3.0517578125e-05,0) [1.999969482421875|1.999969482421875] "ratio" Vector__XXX
 SG_ S01PID36_OxySensor3_FAER m54 : 31|16@0+ (3.0517578125e-05,0) [1.999969482421875|1.999969482421875] "ratio" Vector__XXX
 SG_ S01PID35_OxySensor2_FAER m53 : 31|16@0+ (3.0517578125e-05,0) [1.999969482421875|1.999969482421875] "ratio" Vector__XXX
 SG_ S01PID34_OxySensor1_FAER m52 : 31|16@0+ (3.0517578125e-05,0) [1.999969482421875|1.999969482421875] "ratio" Vector__XXX
 SG_ S01PID33_AbsBaroPres m51 : 31|8@0+ (1,0) [255|255] "kPa" Vector__XXX
 SG_ S01PID32_EvapSysVaporPres m50 : 31|16@0+ (0.25,0) [16383.75|16383.75] "Pa" Vector__XXX
 SG_ S01PID31_DistSinceCodeClear m49 : 31|16@0+ (1,0) [65535|65535] "km" Vector__XXX
 SG_ S01PID30_WaUpsSinceCodeClear m48 : 31|8@0+ (1,0) [255|255] "count" Vector__XXX
 SG_ S01PID2F_FuelTankLevel m47 : 31|8@0+ (0.392156862745098,0) [99.99999999999999|99.99999999999999] "%" Vector__XXX
 SG_ S01PID2E_CmdEvapPurge m46 : 31|8@0+ (0.392156862745098,0) [99.99999999999999|99.99999999999999] "%" Vector__XXX
 SG_ S01PID2D_EGRError m45 : 31|8@0+ (0.78125,-100) [99.21875|99.21875] "%" Vector__XXX
 SG_ S01PID2C_CmdEGR m44 : 31|8@0+ (0.392156862745098,0) [99.99999999999999|99.99999999999999] "%" Vector__XXX
 SG_ S01PID2B_OxySensor8_FAER m43 : 31|16@0+ (3.0517578125e-05,0) [1.999969482421875|1.999969482421875] "ratio" Vector__XXX
 SG_ S01PID2A_OxySensor7_FAER m42 : 31|16@0+ (3.0517578125e-05,0) [1.999969482421875|1.999969482421875] "ratio" Vector__XXX
 SG_ S01PID29_OxySensor6_FAER m41 : 31|16@0+ (3.0517578125e-05,0) [1.999969482421875|1.999969482421875] "ratio" Vector__XXX
 SG_ S01PID28_OxySensor5_FAER m40 : 31|16@0+ (3.0517578125e-05,0) [1.999969482421875|1.999969482421875] "ratio" Vector__XXX
 SG_ S01PID27_OxySensor4_FAER m39 : 31|16@0+ (3.0517578125e-05,0) [1.999969482421875|1.999969482421875] "ratio" Vector__XXX
 SG_ S01PID26_OxySensor3_FAER m38 : 31|16@0+ (3.0517578125e-05,0) [1.999969482421875|1.999969482421875] "ratio" Vector__XXX
 SG_ S01PID25_OxySensor2_FAER m37 : 31|16@0+ (3.0517578125e-05,0) [1.999969482421875|1.999969482421875] "ratio" Vector__XXX
 SG_ S01PID24_OxySensor1_FAER m36 : 31|16@0+ (3.0517578125e-05,0) [1.999969482421875|1.999969482421875] "ratio" Vector__XXX
 SG_ S01PID23_FuelRailGaug m35 : 31|16@0+ (10,0) [655350|655350] "kPa" Vector__XXX
 SG_ S01PID22_FuelRailPres m34 : 31|16@0+ (0.079,0) [5177.265|5177.265] "kPa" Vector__XXX
 SG_ S01PID21_DistanceMILOn m33 : 31|16@0+ (1,0) [65535|65535] "km" Vector__XXX
 SG_ S01PID1F_TimeSinceEngStart m31 : 31|16@0+ (1,0) [65535|65535] "seconds" Vector__XXX
 SG_ S01PID1C_OBDStandard m28 : 31|8@0+ (1,0) [255|255] "" Vector__XXX
 SG_ S01PID1B_OxySensor8_Volt m27 : 31|8@0+ (0.005,0) [1.2750000000000001|1.2750000000000001] "volts" Vector__XXX
 SG_ S01PID1A_OxySensor7_Volt m26 : 31|8@0+ (0.005,0) [1.2750000000000001|1.2750000000000001] "volts" Vector__XXX
 SG_ S01PID19_OxySensor6_Volt m25 : 31|8@0+ (0.005,0) [1.2750000000000001|1.2750000000000001] "volts" Vector__XXX
 SG_ S01PID18_OxySensor5_Volt m24 : 31|8@0+ (0.005,0) [1.2750000000000001|1.2750000000000001] "volts" Vector__XXX
 SG_ S01PID17_OxySensor4_Volt m23 : 31|8@0+ (0.005,0) [1.2750000000000001|1.2750000000000001] "volts" Vector__XXX
 SG_ S01PID16_OxySensor3_Volt m22 : 31|8@0+ (0.005,0) [1.2750000000000001|1.2750000000000001] "volts" Vector__XXX
 SG_ S01PID15_OxySensor2_Volt m21 : 31|8@0+ (0.005,0) [1.2750000000000001|1.2750000000000001] "volts" Vector__XXX
 SG_ S01PID14_OxySensor1_Volt m20 : 31|8@0+ (0.005,0) [1.2750000000000001|1.2750000000000001] "volts" Vector__XXX
 SG_ S01PID12_CmdSecAirStatus m18 : 31|8@0+ (1,0) [255|255] "" Vector__XXX
 SG_ S01PID11_ThrottlePosition m17 : 31|8@0+ (0.39216,0) [100.0008|100.0008] "%" Vector__XXX
 SG_ S01PID10_MAFAirFlowRate m16 : 31|16@0+ (0.01,0) [655.35|655.35] "grams/sec" Vector__XXX
 SG_ S01PID0F_IntakeAirTemperature m15 : 31|8@0+ (1,-40) [215|215] "degC" Vector__XXX
 SG_ S01PID0E_TimingAdvance m14 : 31|8@0+ (0.5,-64) [63.5|63.5] "deg before TDC" Vector__XXX
 SG_ S01PID0D_VehicleSpeed m13 : 31|8@0+ (1,0) [255|255] "km/h" Vector__XXX
 SG_ S01PID0C_EngineRPM m12 : 31|16@0+ (0.25,0) [16383.75|16383.75] "rpm" Vector__XXX
 SG_ S01PID0B_IntakeManiAbsPress m11 : 31|8@0+ (1,0) [255|255] "kPa" Vector__XXX
 SG_ S01PID0A_FuelPressure m10 : 31|8@0+ (3,0) [765|765] "kPa" Vector__XXX
 SG_ S01PID09_LongFuelTrimBank2 m9 : 31|8@0+ (0.78125,-100) [99.21875|99.21875] "%" Vector__XXX
 SG_ S01PID08_ShortFuelTrimBank2 m8 : 31|8@0+ (0.78125,-100) [99.21875|99.21875] "%" Vector__XXX
 SG_ S01PID07_LongFuelTrimBank1 m7 : 31|8@0+ (0.78125,-100) [99.21875|99.21875] "%" Vector__XXX
 SG_ S01PID06_ShortFuelTrimBank1 m6 : 31|8@0+ (0.78125,-100) [99.21875|99.21875] "%" Vector__XXX
 SG_ S01PID05_EngineCoolantTemp m5 : 31|8@0+ (1,-40) [215|215] "degC" Vector__XXX
 SG_ S01PID04_CalcEngineLoad m4 : 31|8@0+ (0.39216,0) [100.0008|100.0008] "%" Vector__XXX
 SG_ S01PID03_FuelSystemStatus m3 : 31|16@0+ (1,0) [65535|65535] "" Vector__XXX
 SG_ S01PID02_FreezeDTC m2 : 31|16@0+ (1,0) [65535|65535] "" Vector__XXX
 SG_ S01PID01_MonitorStatus m1 : 31|32@0+ (1,0) [4294967295|4294967295] "" Vector__XXX
 SG_ S01PID m1M : 23|8@0+ (1,0) [0|255] "" Vector__XXX
 SG_ S M : 13|6@0+ (1,0) [1|63] "" Vector__XXX
 SG_ S_Flags : 15|2@0+ (1,0) [0|0] "" Vector__XXX
 SG_ Length : 7|8@0+ (1,0) [2|7] "" Vector__XXX

BO_ 2564485397 OBD_RX_EXT: 8 Vector__XXX
 SG_ S22F4PID4F_Max_IntManiAbsPres m79 : 63|8@0+ (10,0) [0|2550] "kPa" Vector__XXX
 SG_ SUP_S01PID5F_EmissionReq m64 : 49|1@0+ (1,0) [0|1] "" Vector__XXX
 SG_ SUP_S01PID3F_CatTempBank2Sens2 m32 : 49|1@0+ (1,0) [0|1] "" Vector__XXX
 SG_ SUP_S01PID1F_TimeSinceEngStart m0 : 49|1@0+ (1,0) [0|1] "" Vector__XXX
 SG_ SUP_S01PID5E_EngineFuelRate m64 : 50|1@0+ (1,0) [0|1] "" Vector__XXX
 SG_ SUP_S01PID3E_CatTempBank1Sens2 m32 : 50|1@0+ (1,0) [0|1] "" Vector__XXX
 SG_ SUP_S01PID5D_FuelInjectionTiming m64 : 51|1@0+ (1,0) [0|1] "" Vector__XXX
 SG_ SUP_S01PID3D_CatTempBank2Sens1 m32 : 51|1@0+ (1,0) [0|1] "" Vector__XXX
 SG_ SUP_S01PID5C_EngineOilTemp m64 : 52|1@0+ (1,0) [0|1] "" Vector__XXX
 SG_ SUP_S01PID3C_CatTempBank1Sens1 m32 : 52|1@0+ (1,0) [0|1] "" Vector__XXX
 SG_ SUP_S01PID1C_OBDStandard m0 : 52|1@0+ (1,0) [0|1] "" Vector__XXX
 SG_ SUP_S01PID5B_HybrBatPackRemLife m64 : 53|1@0+ (1,0) [0|1] "" Vector__XXX
 SG_ SUP_S01PID3B_OxySensor8_FAER m32 : 53|1@0+ (1,0) [0|1] "" Vector__XXX
 SG_ SUP_S01PID1B_OxySensor8_Volt m0 : 53|1@0+ (1,0) [0|1] "" Vector__XXX
 SG_ SUP_S01PID5A_RelAccelPedalPos m64 : 54|1@0+ (1,0) [0|1] "" Vector__XXX
 SG_ SUP_S01PID3A_OxySensor7_FAER m32 : 54|1@0+ (1,0) [0|1] "" Vector__XXX
 SG_ SUP_S01PID1A_OxySensor7_Volt m0 : 54|1@0+ (1,0) [0|1] "" Vector__XXX
 SG_ S22F4PID4F_Max_OxySensCrnt m79 : 55|8@0+ (1,0) [0|255] "mA" Vector__XXX
 SG_ S22F4PID3B_OxySensor8_Crnt m59 : 55|16@0+ (0.00390625,-128) [-128|128] "mA" Vector__XXX
 SG_ S22F4PID3A_OxySensor7_Crnt m58 : 55|16@0+ (0.00390625,-128) [-128|128] "mA" Vector__XXX
 SG_ S22F4PID39_OxySensor6_Crnt m57 : 55|16@0+ (0.00390625,-128) [-128|128] "mA" Vector__XXX
 SG_ S22F4PID38_OxySensor5_Crnt m56 : 55|16@0+ (0.00390625,-128) [-128|128] "mA" Vector__XXX
 SG_ S22F4PID37_OxySensor4_Crnt m55 : 55|16@0+ (0.00390625,-128) [-128|128] "mA" Vector__XXX
 SG_ S22F4PID36_OxySensor3_Crnt m54 : 55|16@0+ (0.00390625,-128) [-128|128] "mA" Vector__XXX
 SG_ S22F4PID35_OxySensor2_Crnt m53 : 55|16@0+ (0.00390625,-128) [-128|128] "mA" Vector__XXX
 SG_ S22F4PID34_OxySensor1_Crnt m52 : 55|16@0+ (0.00390625,-128) [-128|128] "mA" Vector__XXX
 SG_ S22F4PID2B_OxySensor8_Volt m43 : 55|16@0+ (0.0001220703125,0) [0|8] "volts" Vector__XXX
 SG_ S22F4PID2A_OxySensor7_Volt m42 : 55|16@0+ (0.0001220703125,0) [0|8] "volts" Vector__XXX
 SG_ S22F4PID29_OxySensor6_Volt m41 : 55|16@0+ (0.0001220703125,0) [0|8] "volts" Vector__XXX
 SG_ S22F4PID28_OxySensor5_Volt m40 : 55|16@0+ (0.0001220703125,0) [0|8] "volts" Vector__XXX
 SG_ S22F4PID27_OxySensor4_Volt m39 : 55|16@0+ (0.0001220703125,0) [0|8] "volts" Vector__XXX
 SG_ S22F4PID26_OxySensor3_Volt m38 : 55|16@0+ (0.0001220703125,0) [0|8] "volts" Vector__XXX
 SG_ S22F4PID25_OxySensor2_Volt m37 : 55|16@0+ (0.0001220703125,0) [0|8] "volts" Vector__XXX
 SG_ S22F4PID24_OxySensor1_Volt m36 : 55|16@0+ (0.0001220703125,0) [0|2] "volts" Vector__XXX
 SG_ SUP_S01PID79_Bank2EGT1 m96 : 55|1@0+ (1,0) [0|1] "" Vector__XXX
 SG_ SUP_S01PID59_FuelRailAbsPres m64 : 55|1@0+ (1,0) [0|1] "" Vector__XXX
 SG_ SUP_S01PID39_OxySensor6_FAER m32 : 55|1@0+ (1,0) [0|1] "" Vector__XXX
 SG_ SUP_S01PID19_OxySensor6_Volt m0 : 55|1@0+ (1,0) [0|1] "" Vector__XXX
 SG_ S01PID4F_Max_IntManiAbsPres m79 : 55|8@0+ (10,0) [0|2550] "kPa" Vector__XXX
 SG_ SUP_S01PID78_Bank1EGT1 m96 : 40|1@0+ (1,0) [0|1] "" Vector__XXX
 SG_ SUP_S01PID58_LongSecOxyTrimBank2 m64 : 40|1@0+ (1,0) [0|1] "" Vector__XXX
 SG_ SUP_S01PID38_OxySensor5_FAER m32 : 40|1@0+ (1,0) [0|1] "" Vector__XXX
 SG_ SUP_S01PID18_OxySensor5_Volt m0 : 40|1@0+ (1,0) [0|1] "" Vector__XXX
 SG_ SUP_S01PID57_ShortSecOxyTrimBank m64 : 41|1@0+ (1,0) [0|1] "" Vector__XXX
 SG_ SUP_S01PID37_OxySensor4_FAER m32 : 41|1@0+ (1,0) [0|1] "" Vector__XXX
 SG_ SUP_S01PID17_OxySensor4_Volt m0 : 41|1@0+ (1,0) [0|1] "" Vector__XXX
 SG_ SUP_S01PID56_LongSecOxyTrimBank1 m64 : 42|1@0+ (1,0) [0|1] "" Vector__XXX
 SG_ SUP_S01PID36_OxySensor3_FAER m32 : 42|1@0+ (1,0) [0|1] "" Vector__XXX
 SG_ SUP_S01PID16_OxySensor3_Volt m0 : 42|1@0+ (1,0) [0|1] "" Vector__XXX
 SG_ SUP_S01PID55_ShortSecOxyTrimBank m64 : 43|1@0+ (1,0) [0|1] "" Vector__XXX
 SG_ SUP_S01PID35_OxySensor2_FAER m32 : 43|1@0+ (1,0) [0|1] "" Vector__XXX
 SG_ SUP_S01PID15_OxySensor2_Volt m0 : 43|1@0+ (1,0) [0|1] "" Vector__XXX
 SG_ SUP_S01PID54_EvapSysVapPres m64 : 44|1@0+ (1,0) [0|1] "" Vector__XXX
 SG_ SUP_S01PID34_OxySensor1_FAER m32 : 44|1@0+ (1,0) [0|1] "" Vector__XXX
 SG_ SUP_S01PID14_OxySensor1_Volt m0 : 44|1@0+ (1,0) [0|1] "" Vector__XXX
 SG_ SUP_S01PID53_AbsEvapSysVapPres m64 : 45|1@0+ (1,0) [0|1] "" Vector__XXX
 SG_ SUP_S01PID33_AbsBaroPres m32 : 45|1@0+ (1,0) [0|1] "" Vector__XXX
 SG_ SUP_S01PID52_EthanolFuelPct m64 : 46|1@0+ (1,0) [0|1] "" Vector__XXX
 SG_ SUP_S01PID32_EvapSysVaporPres m32 : 46|1@0+ (1,0) [0|1] "" Vector__XXX
 SG_ SUP_S01PID12_CmdSecAirStatus m0 : 46|1@0+ (1,0) [0|1] "" Vector__XXX
 SG_ S22F4PID58_LongSecOxyTrimBank4 m88 : 47|8@0+ (0.78125,-100) [-100|99.21875] "%" Vector__XXX
 SG_ S22F4PID57_ShortSecOxyTrimBank4 m87 : 47|8@0+ (0.78125,-100) [-100|99.21875] "%" Vector__XXX
 SG_ S22F4PID56_LongSecOxyTrimBank3 m86 : 47|8@0+ (0.78125,-100) [-100|99.21875] "%" Vector__XXX
 SG_ S22F4PID55_ShortSecOxyTrimBank3 m85 : 47|8@0+ (0.78125,-100) [-100|99.21875] "%" Vector__XXX
 SG_ S22F4PID4F_Max_OxySensVol m79 : 47|8@0+ (1,0) [0|255] "V" Vector__XXX
 SG_ S22F4PID1B_OxySensor8_STFT m27 : 47|8@0+ (0.78125,-100) [-100|99.21875] "%" Vector__XXX
 SG_ S22F4PID1A_OxySensor7_STFT m26 : 47|8@0+ (0.78125,-100) [-100|99.21875] "%" Vector__XXX
 SG_ S22F4PID19_OxySensor6_STFT m25 : 47|8@0+ (0.78125,-100) [-100|99.21875] "%" Vector__XXX
 SG_ S22F4PID18_OxySensor5_STFT m24 : 47|8@0+ (0.78125,-100) [-100|99.21875] "%" Vector__XXX
 SG_ S22F4PID17_OxySensor4_STFT m23 : 47|8@0+ (0.78125,-100) [-100|99.21875] "%" Vector__XXX
 SG_ S22F4PID16_OxySensor3_STFT m22 : 47|8@0+ (0.78125,-100) [-100|99.21875] "%" Vector__XXX
 SG_ S22F4PID15_OxySensor2_STFT m21 : 47|8@0+ (0.78125,-100) [-100|99.21875] "%" Vector__XXX
 SG_ S22F4PID14_OxySensor1_STFT m20 : 47|8@0+ (0.78125,-100) [-100|99.21875] "%" Vector__XXX
 SG_ SUP_S01PID51_FuelType m64 : 47|1@0+ (1,0) [0|1] "" Vector__XXX
 SG_ SUP_S01PID31_DistSinceCodeClear m32 : 47|1@0+ (1,0) [0|1] "" Vector__XXX
 SG_ SUP_S01PID11_ThrottlePosition m0 : 47|1@0+ (1,0) [0|1] "" Vector__XXX
 SG_ S01PID4F_Max_OxySensCrnt m79 : 47|8@0+ (1,0) [0|255] "mA" Vector__XXX
 SG_ S01PID3B_OxySensor8_Crnt m59 : 47|16@0+ (0.00390625,-128) [-128|128] "mA" Vector__XXX
 SG_ S01PID3A_OxySensor7_Crnt m58 : 47|16@0+ (0.00390625,-128) [-128|128] "mA" Vector__XXX
 SG_ S01PID39_OxySensor6_Crnt m57 : 47|16@0+ (0.00390625,-128) [-128|128] "mA" Vector__XXX
 SG_ S01PID38_OxySensor5_Crnt m56 : 47|16@0+ (0.00390625,-128) [-128|128] "mA" Vector__XXX
 SG_ S01PID37_OxySensor4_Crnt m55 : 47|16@0+ (0.00390625,-128) [-128|128] "mA" Vector__XXX
 SG_ S01PID36_OxySensor3_Crnt m54 : 47|16@0+ (0.00390625,-128) [-128|128] "mA" Vector__XXX
 SG_ S01PID35_OxySensor2_Crnt m53 : 47|16@0+ (0.00390625,-128) [-128|128] "mA" Vector__XXX
 SG_ S01PID34_OxySensor1_Crnt m52 : 47|16@0+ (0.00390625,-128) [-128|128] "mA" Vector__XXX
 SG_ S01PID2B_OxySensor8_Volt m43 : 47|16@0+ (0.0001220703125,0) [0|8] "volts" Vector__XXX
 SG_ S01PID2A_OxySensor7_Volt m42 : 47|16@0+ (0.0001220703125,0) [0|8] "volts" Vector__XXX
 SG_ S01PID29_OxySensor6_Volt m41 : 47|16@0+ (0.0001220703125,0) [0|8] "volts" Vector__XXX
 SG_ S01PID28_OxySensor5_Volt m40 : 47|16@0+ (0.0001220703125,0) [0|8] "volts" Vector__XXX
 SG_ S01PID27_OxySensor4_Volt m39 : 47|16@0+ (0.0001220703125,0) [0|8] "volts" Vector__XXX
 SG_ S01PID26_OxySensor3_Volt m38 : 47|16@0+ (0.0001220703125,0) [0|8] "volts" Vector__XXX
 SG_ S01PID25_OxySensor2_Volt m37 : 47|16@0+ (0.0001220703125,0) [0|8] "volts" Vector__XXX
 SG_ S01PID24_OxySensor1_Volt m36 : 47|16@0+ (0.0001220703125,0) [0|2] "volts" Vector__XXX
 SG_ SUP_S01PID70_BoostPresCntrl m96 : 32|1@0+ (1,0) [0|1] "" Vector__XXX
 SG_ SUP_S01PID50_Max_AirFlowMAF m64 : 32|1@0+ (1,0) [0|1] "" Vector__XXX
 SG_ SUP_S01PID30_WaUpsSinceCodeClear m32 : 32|1@0+ (1,0) [0|1] "" Vector__XXX
 SG_ SUP_S01PID10_MAFAirFlowRate m0 : 32|1@0+ (1,0) [0|1] "" Vector__XXX
 SG_ SUP_S01PID6F_TurboComprPres m96 : 33|1@0+ (1,0) [0|1] "" Vector__XXX
 SG_ SUP_S01PID4F_Max_FAER m64 : 33|1@0+ (1,0) [0|1] "" Vector__XXX
 SG_ SUP_S01PID2F_FuelTankLevel m32 : 33|1@0+ (1,0) [0|1] "" Vector__XXX
 SG_ SUP_S01PID0F_IntakeAirTemperatur m0 : 33|1@0+ (1,0) [0|1] "" Vector__XXX
 SG_ SUP_S01PID8E_EngFrictionPctTorq m128 : 34|1@0+ (1,0) [0|1] "" Vector__XXX
 SG_ SUP_S01PID6E_InjPresContrSys m96 : 34|1@0+ (1,0) [0|1] "" Vector__XXX
 SG_ SUP_S01PID4E_TimeSinceCodeClear m64 : 34|1@0+ (1,0) [0|1] "" Vector__XXX
 SG_ SUP_S01PID2E_CmdEvapPurge m32 : 34|1@0+ (1,0) [0|1] "" Vector__XXX
 SG_ SUP_S01PID0E_TimingAdvance m0 : 34|1@0+ (1,0) [0|1] "" Vector__XXX
 SG_ SUP_S01PID6D_FuelPresContrSys m96 : 35|1@0+ (1,0) [0|1] "" Vector__XXX
 SG_ SUP_S01PID4D_TimeRunMILOn m64 : 35|1@0+ (1,0) [0|1] "" Vector__XXX
 SG_ SUP_S01PID2D_EGRError m32 : 35|1@0+ (1,0) [0|1] "" Vector__XXX
 SG_ SUP_S01PID0D_VehicleSpeed m0 : 35|1@0+ (1,0) [0|1] "" Vector__XXX
 SG_ SUP_S01PID6C_CmdThrottleActRel m96 : 36|1@0+ (1,0) [0|1] "" Vector__XXX
 SG_ SUP_S01PID4C_CmdThrottleAct m64 : 36|1@0+ (1,0) [0|1] "" Vector__XXX
 SG_ SUP_S01PID2C_CmdEGR m32 : 36|1@0+ (1,0) [0|1] "" Vector__XXX
 SG_ SUP_S01PID0C_EngineRPM m0 : 36|1@0+ (1,0) [0|1] "" Vector__XXX
 SG_ SUP_S01PID6B_ExhaustGasTemp m96 : 37|1@0+ (1,0) [0|1] "" Vector__XXX
 SG_ SUP_S01PID4B_AbsThrottlePosF m64 : 37|1@0+ (1,0) [0|1] "" Vector__XXX
 SG_ SUP_S01PID2B_OxySensor8_FAER m32 : 37|1@0+ (1,0) [0|1] "" Vector__XXX
 SG_ SUP_S01PID0B_IntakeManiAbsPress m0 : 37|1@0+ (1,0) [0|1] "" Vector__XXX
 SG_ SUP_S01PID6A_CmdDieselIntAir m96 : 38|1@0+ (1,0) [0|1] "" Vector__XXX
 SG_ SUP_S01PID4A_AbsThrottlePosE m64 : 38|1@0+ (1,0) [0|1] "" Vector__XXX
 SG_ SUP_S01PID2A_OxySensor7_FAER m32 : 38|1@0+ (1,0) [0|1] "" Vector__XXX
 SG_ SUP_S01PID0A_FuelPressure m0 : 38|1@0+ (1,0) [0|1] "" Vector__XXX
 SG_ S22F4PIDA6_Odometer m166 : 39|32@0+ (0.1,0) [0|429496729.5] "km" Vector__XXX
 SG_ S22F4PID8E_EngFrictionPctTorq m142 : 39|8@0+ (1,-125) [-125|130] "%" Vector__XXX
 SG_ S22F4PID70_BoostPresCntrl m112 : 39|8@0+ (1,0) [0|255] "" Vector__XXX
 SG_ S22F4PID6F_TurboComprPres m111 : 39|8@0+ (1,0) [0|255] "" Vector__XXX
 SG_ S22F4PID6E_InjPresContrSys m110 : 39|8@0+ (1,0) [0|255] "" Vector__XXX
 SG_ S22F4PID6D_FuelPresContrSys m109 : 39|8@0+ (1,0) [0|255] "" Vector__XXX
 SG_ S22F4PID6C_CmdThrottleActRel m108 : 39|8@0+ (1,0) [0|255] "" Vector__XXX
 SG_ S22F4PID6B_ExhaustGasTemp m107 : 39|8@0+ (1,0) [0|255] "" Vector__XXX
 SG_ S22F4PID6A_CmdDieselIntAir m106 : 39|8@0+ (1,0) [0|255] "" Vector__XXX
 SG_ S22F4PID69_CmdEGR_EGRError m105 : 39|8@0+ (1,0) [0|255] "" Vector__XXX
 SG_ S22F4PID68_IntakeAirTempSens m104 : 39|8@0+ (1,0) [0|255] "" Vector__XXX
 SG_ S22F4PID67_EngineCoolantTemp m103 : 39|8@0+ (1,0) [0|255] "" Vector__XXX
 SG_ S22F4PID66_MAFSensor m102 : 39|8@0+ (1,0) [0|255] "" Vector__XXX
 SG_ S22F4PID65_AuxInputOutput m101 : 39|8@0+ (1,0) [0|255] "" Vector__XXX
 SG_ S22F4PID63_EngRefTorq m99 : 39|16@0+ (1,0) [0|65535] "Nm" Vector__XXX
 SG_ S22F4PID62_ActualEngTorqPct m98 : 39|8@0+ (1,-125) [-125|130] "%" Vector__XXX
 SG_ S22F4PID61_DemandEngTorqPct m97 : 39|8@0+ (1,-125) [-125|130] "%" Vector__XXX
 SG_ S22F4PID5F_EmissionReq m95 : 39|8@0+ (1,0) [0|255] "" Vector__XXX
 SG_ S22F4PID5E_EngineFuelRate m94 : 39|16@0+ (0.05,0) [0|3276.75] "L/h" Vector__XXX
 SG_ S22F4PID5D_FuelInjectionTiming m93 : 39|16@0+ (0.0078125,-210) [-210|301.9921875] "deg" Vector__XXX
 SG_ S22F4PID5C_EngineOilTemp m92 : 39|8@0+ (1,-40) [-40|215] "degC" Vector__XXX
 SG_ S22F4PID5B_HybrBatPackRemLife m91 : 39|8@0+ (0.392156862745098,0) [0|100] "%" Vector__XXX
 SG_ S22F4PID5A_RelAccelPedalPos m90 : 39|8@0+ (0.392156862745098,0) [0|100] "%" Vector__XXX
 SG_ S22F4PID59_FuelRailAbsPres m89 : 39|16@0+ (10,0) [0|655350] "kPa" Vector__XXX
 SG_ S22F4PID58_LongSecOxyTrimBank2 m88 : 39|8@0+ (0.78125,-100) [-100|99.21875] "%" Vector__XXX
 SG_ S22F4PID57_ShortSecOxyTrimBank2 m87 : 39|8@0+ (0.78125,-100) [-100|99.21875] "%" Vector__XXX
 SG_ S22F4PID56_LongSecOxyTrimBank1 m86 : 39|8@0+ (0.78125,-100) [-100|99.21875] "%" Vector__XXX
 SG_ S22F4PID55_ShortSecOxyTrimBank1 m85 : 39|8@0+ (0.78125,-100) [-100|99.21875] "%" Vector__XXX
 SG_ S22F4PID54_EvapSysVapPres m84 : 39|16@0+ (1,-32767) [-32767|32768] "Pa" Vector__XXX
 SG_ S22F4PID53_AbsEvapSysVapPres m83 : 39|16@0+ (0.005,0) [0|327.675] "kPa" Vector__XXX
 SG_ S22F4PID52_EthanolFuelPct m82 : 39|8@0+ (0.392156862745098,0) [0|100] "%" Vector__XXX
 SG_ S22F4PID51_FuelType m81 : 39|8@0+ (1,0) [0|255] "" Vector__XXX
 SG_ S22F4PID50_Max_AirFlowMAF m80 : 39|8@0+ (10,0) [0|2550] "g/s" Vector__XXX
 SG_ S22F4PID4F_Max_FAER m79 : 39|8@0+ (1,0) [0|255] "ratio" Vector__XXX
 SG_ S22F4PID4E_TimeSinceCodeClear m78 : 39|16@0+ (1,0) [0|65535] "minutes" Vector__XXX
 SG_ S22F4PID4D_TimeRunMILOn m77 : 39|16@0+ (1,0) [0|65535] "minutes" Vector__XXX
 SG_ S22F4PID4C_CmdThrottleAct m76 : 39|8@0+ (0.392156862745098,0) [0|100] "%" Vector__XXX
 SG_ S22F4PID4B_AbsThrottlePosF m75 : 39|8@0+ (0.392156862745098,0) [0|100] "%" Vector__XXX
 SG_ S22F4PID4A_AbsThrottlePosE m74 : 39|8@0+ (0.392156862745098,0) [0|100] "%" Vector__XXX
 SG_ S22F4PID49_AbsThrottlePosD m73 : 39|8@0+ (0.392156862745098,0) [0|100] "%" Vector__XXX
 SG_ S22F4PID48_AbsThrottlePosC m72 : 39|8@0+ (0.392156862745098,0) [0|100] "%" Vector__XXX
 SG_ S22F4PID47_AbsThrottlePosB m71 : 39|8@0+ (0.392156862745098,0) [0|100] "%" Vector__XXX
 SG_ S22F4PID46_AmbientAirTemp m70 : 39|8@0+ (1,-40) [-40|215] "degC" Vector__XXX
 SG_ S22F4PID45_RelThrottlePos m69 : 39|8@0+ (0.392156862745098,0) [0|100] "%" Vector__XXX
 SG_ S22F4PID44_FuelAirCmdEquiv m68 : 39|16@0+ (3.0517578125e-05,0) [0|2] "ratio" Vector__XXX
 SG_ S22F4PID43_AbsLoadValue m67 : 39|16@0+ (0.392156862745098,0) [0|25700] "%" Vector__XXX
 SG_ S22F4PID42_ControlModuleVolt m66 : 39|16@0+ (0.001,0) [0|65.535] "V" Vector__XXX
 SG_ S22F4PID41_MonStatusDriveCycle m65 : 39|32@0+ (1,0) [0|4294967295] "" Vector__XXX
 SG_ S22F4PID3F_CatTempBank2Sens2 m63 : 39|16@0+ (0.1,-40) [-40|6513.5] "degC" Vector__XXX
 SG_ S22F4PID3E_CatTempBank1Sens2 m62 : 39|16@0+ (0.1,-40) [-40|6513.5] "degC" Vector__XXX
 SG_ S22F4PID3D_CatTempBank2Sens1 m61 : 39|16@0+ (0.1,-40) [-40|6513.5] "degC" Vector__XXX
 SG_ S22F4PID3C_CatTempBank1Sens1 m60 : 39|16@0+ (0.1,-40) [-40|6513.5] "degC" Vector__XXX
 SG_ S22F4PID3B_OxySensor8_FAER m59 : 39|16@0+ (3.0517578125e-05,0) [0|2] "ratio" Vector__XXX
 SG_ S22F4PID3A_OxySensor7_FAER m58 : 39|16@0+ (3.0517578125e-05,0) [0|2] "ratio" Vector__XXX
 SG_ S22F4PID39_OxySensor6_FAER m57 : 39|16@0+ (3.0517578125e-05,0) [0|2] "ratio" Vector__XXX
 SG_ S22F4PID38_OxySensor5_FAER m56 : 39|16@0+ (3.0517578125e-05,0) [0|2] "ratio" Vector__XXX
 SG_ S22F4PID37_OxySensor4_FAER m55 : 39|16@0+ (3.0517578125e-05,0) [0|2] "ratio" Vector__XXX
 SG_ S22F4PID36_OxySensor3_FAER m54 : 39|16@0+ (3.0517578125e-05,0) [0|2] "ratio" Vector__XXX
 SG_ S22F4PID35_OxySensor2_FAER m53 : 39|16@0+ (3.0517578125e-05,0) [0|2] "ratio" Vector__XXX
 SG_ S22F4PID34_OxySensor1_FAER m52 : 39|16@0+ (3.0517578125e-05,0) [0|2] "ratio" Vector__XXX
 SG_ S22F4PID33_AbsBaroPres m51 : 39|8@0+ (1,0) [0|255] "kPa" Vector__XXX
 SG_ S22F4PID32_EvapSysVaporPres m50 : 39|16@0+ (0.25,0) [-8192|8191.75] "Pa" Vector__XXX
 SG_ S22F4PID31_DistSinceCodeClear m49 : 39|16@0+ (1,0) [0|65535] "km" Vector__XXX
 SG_ S22F4PID30_WaUpsSinceCodeClear m48 : 39|8@0+ (1,0) [0|255] "count" Vector__XXX
 SG_ S22F4PID2F_FuelTankLevel m47 : 39|8@0+ (0.392156862745098,0) [0|100] "%" Vector__XXX
 SG_ S22F4PID2E_CmdEvapPurge m46 : 39|8@0+ (0.392156862745098,0) [0|100] "%" Vector__XXX
 SG_ S22F4PID2D_EGRError m45 : 39|8@0+ (0.78125,-100) [-100|99.21875] "%" Vector__XXX
 SG_ S22F4PID2C_CmdEGR m44 : 39|8@0+ (0.392156862745098,0) [0|100] "%" Vector__XXX
 SG_ S22F4PID2B_OxySensor8_FAER m43 : 39|16@0+ (3.0517578125e-05,0) [0|2] "ratio" Vector__XXX
 SG_ S22F4PID2A_OxySensor7_FAER m42 : 39|16@0+ (3.0517578125e-05,0) [0|2] "ratio" Vector__XXX
 SG_ S22F4PID29_OxySensor6_FAER m41 : 39|16@0+ (3.0517578125e-05,0) [0|2] "ratio" Vector__XXX
 SG_ S22F4PID28_OxySensor5_FAER m40 : 39|16@0+ (3.0517578125e-05,0) [0|2] "ratio" Vector__XXX
 SG_ S22F4PID27_OxySensor4_FAER m39 : 39|16@0+ (3.0517578125e-05,0) [0|2] "ratio" Vector__XXX
 SG_ S22F4PID26_OxySensor3_FAER m38 : 39|16@0+ (3.0517578125e-05,0) [0|2] "ratio" Vector__XXX
 SG_ S22F4PID25_OxySensor2_FAER m37 : 39|16@0+ (3.0517578125e-05,0) [0|2] "ratio" Vector__XXX
 SG_ S22F4PID24_OxySensor1_FAER m36 : 39|16@0+ (3.0517578125e-05,0) [0|2] "ratio" Vector__XXX
 SG_ S22F4PID23_FuelRailGaug m35 : 39|16@0+ (10,0) [0|655350] "kPa" Vector__XXX
 SG_ S22F4PID22_FuelRailPres m34 : 39|16@0+ (0.079,0) [0|5177.265] "kPa" Vector__XXX
 SG_ S22F4PID21_DistanceMILOn m33 : 39|16@0+ (1,0) [0|65535] "km" Vector__XXX
 SG_ S22F4PID1F_TimeSinceEngStart m31 : 39|16@0+ (1,0) [0|65535] "seconds" Vector__XXX
 SG_ S22F4PID1C_OBDStandard m28 : 39|8@0+ (1,0) [0|255] "" Vector__XXX
 SG_ S22F4PID1B_OxySensor8_Volt m27 : 39|8@0+ (0.005,0) [0|1.275] "volts" Vector__XXX
 SG_ S22F4PID1A_OxySensor7_Volt m26 : 39|8@0+ (0.005,0) [0|1.275] "volts" Vector__XXX
 SG_ S22F4PID19_OxySensor6_Volt m25 : 39|8@0+ (0.005,0) [0|1.275] "volts" Vector__XXX
 SG_ S22F4PID18_OxySensor5_Volt m24 : 39|8@0+ (0.005,0) [0|1.275] "volts" Vector__XXX
 SG_ S22F4PID17_OxySensor4_Volt m23 : 39|8@0+ (0.005,0) [0|1.275] "volts" Vector__XXX
 SG_ S22F4PID16_OxySensor3_Volt m22 : 39|8@0+ (0.005,0) [0|1.275] "volts" Vector__XXX
 SG_ S22F4PID15_OxySensor2_Volt m21 : 39|8@0+ (0.005,0) [0|1.275] "volts" Vector__XXX
 SG_ S22F4PID14_OxySensor1_Volt m20 : 39|8@0+ (0.005,0) [0|1.275] "volts" Vector__XXX
 SG_ S22F4PID12_CmdSecAirStatus m18 : 39|8@0+ (1,0) [0|255] "" Vector__XXX
 SG_ S22F4PID11_ThrottlePosition m17 : 39|8@0+ (0.39216,0) [0|100] "%" Vector__XXX
 SG_ S22F4PID10_MAFAirFlowRate m16 : 39|16@0+ (0.01,0) [0|655.35] "grams/sec" Vector__XXX
 SG_ S22F4PID0F_IntakeAirTemperature m15 : 39|8@0+ (1,-40) [-40|215] "degC" Vector__XXX
 SG_ S22F4PID0E_TimingAdvance m14 : 39|8@0+ (0.5,-64) [-64|63.5] "deg before TDC" Vector__XXX
 SG_ S22F4PID0D_VehicleSpeed m13 : 39|8@0+ (1,0) [0|255] "km/h" Vector__XXX
 SG_ S22F4PID0C_EngineRPM m12 : 39|16@0+ (0.25,0) [0|16383.75] "rpm" Vector__XXX
 SG_ S22F4PID0B_IntakeManiAbsPress m11 : 39|8@0+ (1,0) [0|255] "kPa" Vector__XXX
 SG_ S22F4PID0A_FuelPressure m10 : 39|8@0+ (3,0) [0|765] "kPa" Vector__XXX
 SG_ S22F4PID09_LongFuelTrimBank2 m9 : 39|8@0+ (0.78125,-100) [-100|99.21875] "%" Vector__XXX
 SG_ S22F4PID08_ShortFuelTrimBank2 m8 : 39|8@0+ (0.78125,-100) [-100|99.21875] "%" Vector__XXX
 SG_ S22F4PID07_LongFuelTrimBank1 m7 : 39|8@0+ (0.78125,-100) [-100|99.21875] "%" Vector__XXX
 SG_ S22F4PID06_ShortFuelTrimBank1 m6 : 39|8@0+ (0.78125,-100) [-100|99.21875] "%" Vector__XXX
 SG_ S22F4PID05_EngineCoolantTemp m5 : 39|8@0+ (1,-40) [-40|215] "degC" Vector__XXX
 SG_ S22F4PID04_CalcEngineLoad m4 : 39|8@0+ (0.39216,0) [0|100] "%" Vector__XXX
 SG_ S22F4PID03_FuelSystemStatus m3 : 39|16@0+ (1,0) [0|65535] "" Vector__XXX
 SG_ S22F4PID01_MonitorStatus m1 : 39|32@0+ (1,0) [0|4294967295] "" Vector__XXX
 SG_ SUP_S01PID69_CmdEGR_EGRError m96 : 39|1@0+ (1,0) [0|1] "" Vector__XXX
 SG_ SUP_S01PID49_AbsThrottlePosD m64 : 39|1@0+ (1,0) [0|1] "" Vector__XXX
 SG_ SUP_S01PID29_OxySensor6_FAER m32 : 39|1@0+ (1,0) [0|1] "" Vector__XXX
 SG_ SUP_S01PID09_LongFuelTrimBank2 m0 : 39|1@0+ (1,0) [0|1] "" Vector__XXX
 SG_ S01PID58_LongSecOxyTrimBank4 m88 : 39|8@0+ (0.78125,-100) [-100|99.21875] "%" Vector__XXX
 SG_ S01PID57_ShortSecOxyTrimBank4 m87 : 39|8@0+ (0.78125,-100) [-100|99.21875] "%" Vector__XXX
 SG_ S01PID56_LongSecOxyTrimBank3 m86 : 39|8@0+ (0.78125,-100) [-100|99.21875] "%" Vector__XXX
 SG_ S01PID55_ShortSecOxyTrimBank3 m85 : 39|8@0+ (0.78125,-100) [-100|99.21875] "%" Vector__XXX
 SG_ S01PID4F_Max_OxySensVol m79 : 39|8@0+ (1,0) [0|255] "V" Vector__XXX
 SG_ S01PID1B_OxySensor8_STFT m27 : 39|8@0+ (0.78125,-100) [-100|99.21875] "%" Vector__XXX
 SG_ S01PID1A_OxySensor7_STFT m26 : 39|8@0+ (0.78125,-100) [-100|99.21875] "%" Vector__XXX
 SG_ S01PID19_OxySensor6_STFT m25 : 39|8@0+ (0.78125,-100) [-100|99.21875] "%" Vector__XXX
 SG_ S01PID18_OxySensor5_STFT m24 : 39|8@0+ (0.78125,-100) [-100|99.21875] "%" Vector__XXX
 SG_ S01PID17_OxySensor4_STFT m23 : 39|8@0+ (0.78125,-100) [-100|99.21875] "%" Vector__XXX
 SG_ S01PID16_OxySensor3_STFT m22 : 39|8@0+ (0.78125,-100) [-100|99.21875] "%" Vector__XXX
 SG_ S01PID15_OxySensor2_STFT m21 : 39|8@0+ (0.78125,-100) [-100|99.21875] "%" Vector__XXX
 SG_ S01PID14_OxySensor1_STFT m20 : 39|8@0+ (0.78125,-100) [-100|99.21875] "%" Vector__XXX
 SG_ SUP_S01PID68_IntakeAirTempSens m96 : 24|1@0+ (1,0) [0|1] "" Vector__XXX
 SG_ SUP_S01PID48_AbsThrottlePosC m64 : 24|1@0+ (1,0) [0|1] "" Vector__XXX
 SG_ SUP_S01PID28_OxySensor5_FAER m32 : 24|1@0+ (1,0) [0|1] "" Vector__XXX
 SG_ SUP_S01PID08_ShortFuelTrimBank2 m0 : 24|1@0+ (1,0) [0|1] "" Vector__XXX
 SG_ SUP_S01PID67_EngineCoolantTemp m96 : 25|1@0+ (1,0) [0|1] "" Vector__XXX
 SG_ SUP_S01PID47_AbsThrottlePosB m64 : 25|1@0+ (1,0) [0|1] "" Vector__XXX
 SG_ SUP_S01PID27_OxySensor4_FAER m32 : 25|1@0+ (1,0) [0|1] "" Vector__XXX
 SG_ SUP_S01PID07_LongFuelTrimBank1 m0 : 25|1@0+ (1,0) [0|1] "" Vector__XXX
 SG_ SUP_S01PIDA6_Odometer m160 : 26|1@0+ (1,0) [0|1] "" Vector__XXX
 SG_ SUP_S01PID66_MAFSensor m96 : 26|1@0+ (1,0) [0|1] "" Vector__XXX
 SG_ SUP_S01PID46_AmbientAirTemp m64 : 26|1@0+ (1,0) [0|1] "" Vector__XXX
 SG_ SUP_S01PID26_OxySensor3_FAER m32 : 26|1@0+ (1,0) [0|1] "" Vector__XXX
 SG_ SUP_S01PID06_ShortFuelTrimBank1 m0 : 26|1@0+ (1,0) [0|1] "" Vector__XXX
 SG_ SUP_S01PID65_AuxInputOutput m96 : 27|1@0+ (1,0) [0|1] "" Vector__XXX
 SG_ SUP_S01PID45_RelThrottlePos m64 : 27|1@0+ (1,0) [0|1] "" Vector__XXX
 SG_ SUP_S01PID25_OxySensor2_FAER m32 : 27|1@0+ (1,0) [0|1] "" Vector__XXX
 SG_ SUP_S01PID05_EngineCoolantTemp m0 : 27|1@0+ (1,0) [0|1] "" Vector__XXX
 SG_ SUP_S01PID64_EngPctTorq_Idle m96 : 28|1@0+ (1,0) [0|1] "" Vector__XXX
 SG_ SUP_S01PID44_FuelAirCmdEquiv m64 : 28|1@0+ (1,0) [0|1] "" Vector__XXX
 SG_ SUP_S01PID24_OxySensor1_FAER m32 : 28|1@0+ (1,0) [0|1] "" Vector__XXX
 SG_ SUP_S01PID04_CalcEngineLoad m0 : 28|1@0+ (1,0) [0|1] "" Vector__XXX
 SG_ SUP_S01PID63_EngRefTorq m96 : 29|1@0+ (1,0) [0|1] "" Vector__XXX
 SG_ SUP_S01PID43_AbsLoadValue m64 : 29|1@0+ (1,0) [0|1] "" Vector__XXX
 SG_ SUP_S01PID23_FuelRailGaug m32 : 29|1@0+ (1,0) [0|1] "" Vector__XXX
 SG_ SUP_S01PID03_FuelSystemStatus m0 : 29|1@0+ (1,0) [0|1] "" Vector__XXX
 SG_ SUP_S01PID62_ActualEngTorqPct m96 : 30|1@0+ (1,0) [0|1] "" Vector__XXX
 SG_ SUP_S01PID42_ControlModuleVolt m64 : 30|1@0+ (1,0) [0|1] "" Vector__XXX
 SG_ SUP_S01PID22_FuelRailPres m32 : 30|1@0+ (1,0) [0|1] "" Vector__XXX
 SG_ SUP_S01PID02_FreezeDTC m0 : 30|1@0+ (1,0) [0|1] "" Vector__XXX
 SG_ S22F8PID m248M : 31|8@0+ (1,0) [0|255] "" Vector__XXX
 SG_ S22F4PID m244M : 31|8@0+ (1,0) [0|255] "" Vector__XXX
 SG_ SUP_S01PID61_DemandEngTorqPct m96 : 31|1@0+ (1,0) [0|1] "" Vector__XXX
 SG_ SUP_S01PID41_MonStatusDriveCycle m64 : 31|1@0+ (1,0) [0|1] "" Vector__XXX
 SG_ SUP_S01PID21_DistanceMILOn m32 : 31|1@0+ (1,0) [0|1] "" Vector__XXX
 SG_ SUP_S01PID01_MonitorStatus m0 : 31|1@0+ (1,0) [0|1] "" Vector__XXX
 SG_ S02PID02_FreezeDTC m2 : 31|16@0+ (1,0) [0|65535] "" Vector__XXX
 SG_ S01PIDA6_Odometer m166 : 31|32@0+ (0.1,0) [0|429496729.5] "km" Vector__XXX
 SG_ S01PID8E_EngFrictionPctTorq m142 : 31|8@0+ (1,-125) [-125|130] "%" Vector__XXX
 SG_ S01PID70_BoostPresCntrl m112 : 31|8@0+ (1,0) [0|255] "" Vector__XXX
 SG_ S01PID6F_TurboComprPres m111 : 31|8@0+ (1,0) [0|255] "" Vector__XXX
 SG_ S01PID6E_InjPresContrSys m110 : 31|8@0+ (1,0) [0|255] "" Vector__XXX
 SG_ S01PID6D_FuelPresContrSys m109 : 31|8@0+ (1,0) [0|255] "" Vector__XXX
 SG_ S01PID6C_CmdThrottleActRel m108 : 31|8@0+ (1,0) [0|255] "" Vector__XXX
 SG_ S01PID6B_ExhaustGasTemp m107 : 31|8@0+ (1,0) [0|255] "" Vector__XXX
 SG_ S01PID6A_CmdDieselIntAir m106 : 31|8@0+ (1,0) [0|255] "" Vector__XXX
 SG_ S01PID69_CmdEGR_EGRError m105 : 31|8@0+ (1,0) [0|255] "" Vector__XXX
 SG_ S01PID68_IntakeAirTempSens m104 : 31|8@0+ (1,0) [0|255] "" Vector__XXX
 SG_ S01PID67_EngineCoolantTemp m103 : 31|8@0+ (1,0) [0|255] "" Vector__XXX
 SG_ S01PID66_MAFSensor m102 : 31|8@0+ (1,0) [0|255] "" Vector__XXX
 SG_ S01PID65_AuxInputOutput m101 : 31|8@0+ (1,0) [0|255] "" Vector__XXX
 SG_ S01PID63_EngRefTorq m99 : 31|16@0+ (1,0) [0|65535] "Nm" Vector__XXX
 SG_ S01PID62_ActualEngTorqPct m98 : 31|8@0+ (1,-125) [-125|130] "%" Vector__XXX
 SG_ S01PID61_DemandEngTorqPct m97 : 31|8@0+ (1,-125) [-125|130] "%" Vector__XXX
 SG_ S01PID5F_EmissionReq m95 : 31|8@0+ (1,0) [0|255] "" Vector__XXX
 SG_ S01PID5E_EngineFuelRate m94 : 31|16@0+ (0.05,0) [0|3276.75] "L/h" Vector__XXX
 SG_ S01PID5D_FuelInjectionTiming m93 : 31|16@0+ (0.0078125,-210) [-210|301.9921875] "deg" Vector__XXX
 SG_ S01PID5C_EngineOilTemp m92 : 31|8@0+ (1,-40) [-40|215] "degC" Vector__XXX
 SG_ S01PID5B_HybrBatPackRemLife m91 : 31|8@0+ (0.392156862745098,0) [0|100] "%" Vector__XXX
 SG_ S01PID5A_RelAccelPedalPos m90 : 31|8@0+ (0.392156862745098,0) [0|100] "%" Vector__XXX
 SG_ S01PID59_FuelRailAbsPres m89 : 31|16@0+ (10,0) [0|655350] "kPa" Vector__XXX
 SG_ S01PID58_LongSecOxyTrimBank2 m88 : 31|8@0+ (0.78125,-100) [-100|99.21875] "%" Vector__XXX
 SG_ S01PID57_ShortSecOxyTrimBank2 m87 : 31|8@0+ (0.78125,-100) [-100|99.21875] "%" Vector__XXX
 SG_ S01PID56_LongSecOxyTrimBank1 m86 : 31|8@0+ (0.78125,-100) [-100|99.21875] "%" Vector__XXX
 SG_ S01PID55_ShortSecOxyTrimBank1 m85 : 31|8@0+ (0.78125,-100) [-100|99.21875] "%" Vector__XXX
 SG_ S01PID54_EvapSysVapPres m84 : 31|16@0+ (1,-32767) [-32767|32768] "Pa" Vector__XXX
 SG_ S01PID53_AbsEvapSysVapPres m83 : 31|16@0+ (0.005,0) [0|327.675] "kPa" Vector__XXX
 SG_ S01PID52_EthanolFuelPct m82 : 31|8@0+ (0.392156862745098,0) [0|100] "%" Vector__XXX
 SG_ S01PID51_FuelType m81 : 31|8@0+ (1,0) [0|255] "" Vector__XXX
 SG_ S01PID50_Max_AirFlowMAF m80 : 31|8@0+ (10,0) [0|2550] "g/s" Vector__XXX
 SG_ S01PID4F_Max_FAER m79 : 31|8@0+ (1,0) [0|255] "ratio" Vector__XXX
 SG_ S01PID4E_TimeSinceCodeClear m78 : 31|16@0+ (1,0) [0|65535] "minutes" Vector__XXX
 SG_ S01PID4D_TimeRunMILOn m77 : 31|16@0+ (1,0) [0|65535] "minutes" Vector__XXX
 SG_ S01PID4C_CmdThrottleAct m76 : 31|8@0+ (0.392156862745098,0) [0|100] "%" Vector__XXX
 SG_ S01PID4B_AbsThrottlePosF m75 : 31|8@0+ (0.392156862745098,0) [0|100] "%" Vector__XXX
 SG_ S01PID4A_AbsThrottlePosE m74 : 31|8@0+ (0.392156862745098,0) [0|100] "%" Vector__XXX
 SG_ S01PID49_AbsThrottlePosD m73 : 31|8@0+ (0.392156862745098,0) [0|100] "%" Vector__XXX
 SG_ S01PID48_AbsThrottlePosC m72 : 31|8@0+ (0.392156862745098,0) [0|100] "%" Vector__XXX
 SG_ S01PID47_AbsThrottlePosB m71 : 31|8@0+ (0.392156862745098,0) [0|100] "%" Vector__XXX
 SG_ S01PID46_AmbientAirTemp m70 : 31|8@0+ (1,-40) [-40|215] "degC" Vector__XXX
 SG_ S01PID45_RelThrottlePos m69 : 31|8@0+ (0.392156862745098,0) [0|100] "%" Vector__XXX
 SG_ S01PID44_FuelAirCmdEquiv m68 : 31|16@0+ (3.0517578125e-05,0) [0|2] "ratio" Vector__XXX
 SG_ S01PID43_AbsLoadValue m67 : 31|16@0+ (0.392156862745098,0) [0|25700] "%" Vector__XXX
 SG_ S01PID42_ControlModuleVolt m66 : 31|16@0+ (0.001,0) [0|65.535] "V" Vector__XXX
 SG_ S01PID41_MonStatusDriveCycle m65 : 31|32@0+ (1,0) [0|4294967295] "" Vector__XXX
 SG_ S01PID3F_CatTempBank2Sens2 m63 : 31|16@0+ (0.1,-40) [-40|6513.5] "degC" Vector__XXX
 SG_ S01PID3E_CatTempBank1Sens2 m62 : 31|16@0+ (0.1,-40) [-40|6513.5] "degC" Vector__XXX
 SG_ S01PID3D_CatTempBank2Sens1 m61 : 31|16@0+ (0.1,-40) [-40|6513.5] "degC" Vector__XXX
 SG_ S01PID3C_CatTempBank1Sens1 m60 : 31|16@0+ (0.1,-40) [-40|6513.5] "degC" Vector__XXX
 SG_ S01PID3B_OxySensor8_FAER m59 : 31|16@0+ (3.0517578125e-05,0) [0|2] "ratio" Vector__XXX
 SG_ S01PID3A_OxySensor7_FAER m58 : 31|16@0+ (3.0517578125e-05,0) [0|2] "ratio" Vector__XXX
 SG_ S01PID39_OxySensor6_FAER m57 : 31|16@0+ (3.0517578125e-05,0) [0|2] "ratio" Vector__XXX
 SG_ S01PID38_OxySensor5_FAER m56 : 31|16@0+ (3.0517578125e-05,0) [0|2] "ratio" Vector__XXX
 SG_ S01PID37_OxySensor4_FAER m55 : 31|16@0+ (3.0517578125e-05,0) [0|2] "ratio" Vector__XXX
 SG_ S01PID36_OxySensor3_FAER m54 : 31|16@0+ (3.0517578125e-05,0) [0|2] "ratio" Vector__XXX
 SG_ S01PID35_OxySensor2_FAER m53 : 31|16@0+ (3.0517578125e-05,0) [0|2] "ratio" Vector__XXX
 SG_ S01PID34_OxySensor1_FAER m52 : 31|16@0+ (3.0517578125e-05,0) [0|2] "ratio" Vector__XXX
 SG_ S01PID33_AbsBaroPres m51 : 31|8@0+ (1,0) [0|255] "kPa" Vector__XXX
 SG_ S01PID32_EvapSysVaporPres m50 : 31|16@0+ (0.25,0) [-8192|8191.75] "Pa" Vector__XXX
 SG_ S01PID31_DistSinceCodeClear m49 : 31|16@0+ (1,0) [0|65535] "km" Vector__XXX
 SG_ S01PID30_WaUpsSinceCodeClear m48 : 31|8@0+ (1,0) [0|255] "count" Vector__XXX
 SG_ S01PID2F_FuelTankLevel m47 : 31|8@0+ (0.392156862745098,0) [0|100] "%" Vector__XXX
 SG_ S01PID2E_CmdEvapPurge m46 : 31|8@0+ (0.392156862745098,0) [0|100] "%" Vector__XXX
 SG_ S01PID2D_EGRError m45 : 31|8@0+ (0.78125,-100) [-100|99.21875] "%" Vector__XXX
 SG_ S01PID2C_CmdEGR m44 : 31|8@0+ (0.392156862745098,0) [0|100] "%" Vector__XXX
 SG_ S01PID2B_OxySensor8_FAER m43 : 31|16@0+ (3.0517578125e-05,0) [0|2] "ratio" Vector__XXX
 SG_ S01PID2A_OxySensor7_FAER m42 : 31|16@0+ (3.0517578125e-05,0) [0|2] "ratio" Vector__XXX
 SG_ S01PID29_OxySensor6_FAER m41 : 31|16@0+ (3.0517578125e-05,0) [0|2] "ratio" Vector__XXX
 SG_ S01PID28_OxySensor5_FAER m40 : 31|16@0+ (3.0517578125e-05,0) [0|2] "ratio" Vector__XXX
 SG_ S01PID27_OxySensor4_FAER m39 : 31|16@0+ (3.0517578125e-05,0) [0|2] "ratio" Vector__XXX
 SG_ S01PID26_OxySensor3_FAER m38 : 31|16@0+ (3.0517578125e-05,0) [0|2] "ratio" Vector__XXX
 SG_ S01PID25_OxySensor2_FAER m37 : 31|16@0+ (3.0517578125e-05,0) [0|2] "ratio" Vector__XXX
 SG_ S01PID24_OxySensor1_FAER m36 : 31|16@0+ (3.0517578125e-05,0) [0|2] "ratio" Vector__XXX
 SG_ S01PID23_FuelRailGaug m35 : 31|16@0+ (10,0) [0|655350] "kPa" Vector__XXX
 SG_ S01PID22_FuelRailPres m34 : 31|16@0+ (0.079,0) [0|5177.265] "kPa" Vector__XXX
 SG_ S01PID21_DistanceMILOn m33 : 31|16@0+ (1,0) [0|65535] "km" Vector__XXX
 SG_ S01PID1F_TimeSinceEngStart m31 : 31|16@0+ (1,0) [0|65535] "seconds" Vector__XXX
 SG_ S01PID1C_OBDStandard m28 : 31|8@0+ (1,0) [0|255] "" Vector__XXX
 SG_ S01PID1B_OxySensor8_Volt m27 : 31|8@0+ (0.005,0) [0|1.275] "volts" Vector__XXX
 SG_ S01PID1A_OxySensor7_Volt m26 : 31|8@0+ (0.005,0) [0|1.275] "volts" Vector__XXX
 SG_ S01PID19_OxySensor6_Volt m25 : 31|8@0+ (0.005,0) [0|1.275] "volts" Vector__XXX
 SG_ S01PID18_OxySensor5_Volt m24 : 31|8@0+ (0.005,0) [0|1.275] "volts" Vector__XXX
 SG_ S01PID17_OxySensor4_Volt m23 : 31|8@0+ (0.005,0) [0|1.275] "volts" Vector__XXX
 SG_ S01PID16_OxySensor3_Volt m22 : 31|8@0+ (0.005,0) [0|1.275] "volts" Vector__XXX
 SG_ S01PID15_OxySensor2_Volt m21 : 31|8@0+ (0.005,0) [0|1.275] "volts" Vector__XXX
 SG_ S01PID14_OxySensor1_Volt m20 : 31|8@0+ (0.005,0) [0|1.275] "volts" Vector__XXX
 SG_ S01PID12_CmdSecAirStatus m18 : 31|8@0+ (1,0) [0|255] "" Vector__XXX
 SG_ S01PID11_ThrottlePosition m17 : 31|8@0+ (0.39216,0) [0|100] "%" Vector__XXX
 SG_ S01PID10_MAFAirFlowRate m16 : 31|16@0+ (0.01,0) [0|655.35] "grams/sec" Vector__XXX
 SG_ S01PID0F_IntakeAirTemperature m15 : 31|8@0+ (1,-40) [-40|215] "degC" Vector__XXX
 SG_ S01PID0E_TimingAdvance m14 : 31|8@0+ (0.5,-64) [-64|63.5] "deg before TDC" Vector__XXX
 SG_ S01PID0D_VehicleSpeed m13 : 31|8@0+ (1,0) [0|255] "km/h" Vector__XXX
 SG_ S01PID0C_EngineRPM m12 : 31|16@0+ (0.25,0) [0|16383.75] "rpm" Vector__XXX
 SG_ S01PID0B_IntakeManiAbsPress m11 : 31|8@0+ (1,0) [0|255] "kPa" Vector__XXX
 SG_ S01PID0A_FuelPressure m10 : 31|8@0+ (3,0) [0|765] "kPa" Vector__XXX
 SG_ S01PID09_LongFuelTrimBank2 m9 : 31|8@0+ (0.78125,-100) [-100|99.21875] "%" Vector__XXX
 SG_ S01PID08_ShortFuelTrimBank2 m8 : 31|8@0+ (0.78125,-100) [-100|99.21875] "%" Vector__XXX
 SG_ S01PID07_LongFuelTrimBank1 m7 : 31|8@0+ (0.78125,-100) [-100|99.21875] "%" Vector__XXX
 SG_ S01PID06_ShortFuelTrimBank1 m6 : 31|8@0+ (0.78125,-100) [-100|99.21875] "%" Vector__XXX
 SG_ S01PID05_EngineCoolantTemp m5 : 31|8@0+ (1,-40) [-40|215] "degC" Vector__XXX
 SG_ S01PID04_CalcEngineLoad m4 : 31|8@0+ (0.39216,0) [0|100] "%" Vector__XXX
 SG_ S01PID03_FuelSystemStatus m3 : 31|16@0+ (1,0) [0|65535] "" Vector__XXX
 SG_ S01PID02_FreezeDTC m2 : 31|16@0+ (1,0) [0|65535] "" Vector__XXX
 SG_ S01PID01_MonitorStatus m1 : 31|32@0+ (1,0) [0|4294967295] "" Vector__XXX
 SG_ SubFct m34M : 23|8@0+ (1,0) [0|255] "" Vector__XXX
 SG_ S02PID m2M : 23|8@0+ (1,0) [0|255] "" Vector__XXX
 SG_ S01PID m1M : 23|8@0+ (1,0) [0|255] "" Vector__XXX
 SG_ S M : 13|6@0+ (1,0) [1|63] "" Vector__XXX
 SG_ Length : 7|8@0+ (1,0) [0|8] "" Vector__XXX

BO_ 2564502513 OBD_TX_EXT: 8 Vector__XXX
 SG_ S22F4PID4F_Max_IntManiAbsPres m79 : 63|8@0+ (10,0) [2550|2550] "kPa" Vector__XXX
 SG_ S22F4PID4F_Max_OxySensCrnt m79 : 55|8@0+ (1,0) [255|255] "mA" Vector__XXX
 SG_ S22F4PID3B_OxySensor8_Crnt m59 : 55|16@0+ (0.00390625,-128) [127.99609375|127.99609375] "mA" Vector__XXX
 SG_ S22F4PID3A_OxySensor7_Crnt m58 : 55|16@0+ (0.00390625,-128) [127.99609375|127.99609375] "mA" Vector__XXX
 SG_ S22F4PID39_OxySensor6_Crnt m57 : 55|16@0+ (0.00390625,-128) [127.99609375|127.99609375] "mA" Vector__XXX
 SG_ S22F4PID38_OxySensor5_Crnt m56 : 55|16@0+ (0.00390625,-128) [127.99609375|127.99609375] "mA" Vector__XXX
 SG_ S22F4PID37_OxySensor4_Crnt m55 : 55|16@0+ (0.00390625,-128) [127.99609375|127.99609375] "mA" Vector__XXX
 SG_ S22F4PID36_OxySensor3_Crnt m54 : 55|16@0+ (0.00390625,-128) [127.99609375|127.99609375] "mA" Vector__XXX
 SG_ S22F4PID35_OxySensor2_Crnt m53 : 55|16@0+ (0.00390625,-128) [127.99609375|127.99609375] "mA" Vector__XXX
 SG_ S22F4PID34_OxySensor1_Crnt m52 : 55|16@0+ (0.00390625,-128) [127.99609375|127.99609375] "mA" Vector__XXX
 SG_ S22F4PID2B_OxySensor8_Volt m43 : 55|16@0+ (0.0001220703125,0) [7.9998779296875|7.9998779296875] "volts" Vector__XXX
 SG_ S22F4PID2A_OxySensor7_Volt m42 : 55|16@0+ (0.0001220703125,0) [7.9998779296875|7.9998779296875] "volts" Vector__XXX
 SG_ S22F4PID29_OxySensor6_Volt m41 : 55|16@0+ (0.0001220703125,0) [7.9998779296875|7.9998779296875] "volts" Vector__XXX
 SG_ S22F4PID28_OxySensor5_Volt m40 : 55|16@0+ (0.0001220703125,0) [7.9998779296875|7.9998779296875] "volts" Vector__XXX
 SG_ S22F4PID27_OxySensor4_Volt m39 : 55|16@0+ (0.0001220703125,0) [7.9998779296875|7.9998779296875] "volts" Vector__XXX
 SG_ S22F4PID26_OxySensor3_Volt m38 : 55|16@0+ (0.0001220703125,0) [7.9998779296875|7.9998779296875] "volts" Vector__XXX
 SG_ S22F4PID25_OxySensor2_Volt m37 : 55|16@0+ (0.0001220703125,0) [7.9998779296875|7.9998779296875] "volts" Vector__XXX
 SG_ S22F4PID24_OxySensor1_Volt m36 : 55|16@0+ (0.0001220703125,0) [7.9998779296875|7.9998779296875] "volts" Vector__XXX
 SG_ S01PID4F_Max_IntManiAbsPres m79 : 55|8@0+ (10,0) [2550|2550] "kPa" Vector__XXX
 SG_ S22F4PID58_LongSecOxyTrimBank4 m88 : 47|8@0+ (0.78125,-100) [99.21875|99.21875] "%" Vector__XXX
 SG_ S22F4PID57_ShortSecOxyTrimBank4 m87 : 47|8@0+ (0.78125,-100) [99.21875|99.21875] "%" Vector__XXX
 SG_ S22F4PID56_LongSecOxyTrimBank3 m86 : 47|8@0+ (0.78125,-100) [99.21875|99.21875] "%" Vector__XXX
 SG_ S22F4PID55_ShortSecOxyTrimBank3 m85 : 47|8@0+ (0.78125,-100) [99.21875|99.21875] "%" Vector__XXX
 SG_ S22F4PID4F_Max_OxySensVol m79 : 47|8@0+ (1,0) [255|255] "V" Vector__XXX
 SG_ S22F4PID1B_OxySensor8_STFT m27 : 47|8@0+ (0.78125,-100) [99.21875|99.21875] "%" Vector__XXX
 SG_ S22F4PID1A_OxySensor7_STFT m26 : 47|8@0+ (0.78125,-100) [99.21875|99.21875] "%" Vector__XXX
 SG_ S22F4PID19_OxySensor6_STFT m25 : 47|8@0+ (0.78125,-100) [99.21875|99.21875] "%" Vector__XXX
 SG_ S22F4PID18_OxySensor5_STFT m24 : 47|8@0+ (0.78125,-100) [99.21875|99.21875] "%" Vector__XXX
 SG_ S22F4PID17_OxySensor4_STFT m23 : 47|8@0+ (0.78125,-100) [99.21875|99.21875] "%" Vector__XXX
 SG_ S22F4PID16_OxySensor3_STFT m22 : 47|8@0+ (0.78125,-100) [99.21875|99.21875] "%" Vector__XXX
 SG_ S22F4PID15_OxySensor2_STFT m21 : 47|8@0+ (0.78125,-100) [99.21875|99.21875] "%" Vector__XXX
 SG_ S22F4PID14_OxySensor1_STFT m20 : 47|8@0+ (0.78125,-100) [99.21875|99.21875] "%" Vector__XXX
 SG_ S01PID4F_Max_OxySensCrnt m79 : 47|8@0+ (1,0) [255|255] "mA" Vector__XXX
 SG_ S01PID3B_OxySensor8_Crnt m59 : 47|16@0+ (0.00390625,-128) [127.99609375|127.99609375] "mA" Vector__XXX
 SG_ S01PID3A_OxySensor7_Crnt m58 : 47|16@0+ (0.00390625,-128) [127.99609375|127.99609375] "mA" Vector__XXX
 SG_ S01PID39_OxySensor6_Crnt m57 : 47|16@0+ (0.00390625,-128) [127.99609375|127.99609375] "mA" Vector__XXX
 SG_ S01PID38_OxySensor5_Crnt m56 : 47|16@0+ (0.00390625,-128) [127.99609375|127.99609375] "mA" Vector__XXX
 SG_ S01PID37_OxySensor4_Crnt m55 : 47|16@0+ (0.00390625,-128) [127.99609375|127.99609375] "mA" Vector__XXX
 SG_ S01PID36_OxySensor3_Crnt m54 : 47|16@0+ (0.00390625,-128) [127.99609375|127.99609375] "mA" Vector__XXX
 SG_ S01PID35_OxySensor2_Crnt m53 : 47|16@0+ (0.00390625,-128) [127.99609375|127.99609375] "mA" Vector__XXX
 SG_ S01PID34_OxySensor1_Crnt m52 : 47|16@0+ (0.00390625,-128) [127.99609375|127.99609375] "mA" Vector__XXX
 SG_ S01PID2B_OxySensor8_Volt m43 : 47|16@0+ (0.0001220703125,0) [7.9998779296875|7.9998779296875] "volts" Vector__XXX
 SG_ S01PID2A_OxySensor7_Volt m42 : 47|16@0+ (0.0001220703125,0) [7.9998779296875|7.9998779296875] "volts" Vector__XXX
 SG_ S01PID29_OxySensor6_Volt m41 : 47|16@0+ (0.0001220703125,0) [7.9998779296875|7.9998779296875] "volts" Vector__XXX
 SG_ S01PID28_OxySensor5_Volt m40 : 47|16@0+ (0.0001220703125,0) [7.9998779296875|7.9998779296875] "volts" Vector__XXX
 SG_ S01PID27_OxySensor4_Volt m39 : 47|16@0+ (0.0001220703125,0) [7.9998779296875|7.9998779296875] "volts" Vector__XXX
 SG_ S01PID26_OxySensor3_Volt m38 : 47|16@0+ (0.0001220703125,0) [7.9998779296875|7.9998779296875] "volts" Vector__XXX
 SG_ S01PID25_OxySensor2_Volt m37 : 47|16@0+ (0.0001220703125,0) [7.9998779296875|7.9998779296875] "volts" Vector__XXX
 SG_ S01PID24_OxySensor1_Volt m36 : 47|16@0+ (0.0001220703125,0) [7.9998779296875|7.9998779296875] "volts" Vector__XXX
 SG_ S22F4PIDA6_Odometer m166 : 39|32@0+ (0.1,0) [429496729.5|429496729.5] "km" Vector__XXX
 SG_ S22F4PID8E_EngFrictionPctTorq m142 : 39|8@0+ (1,-125) [130|130] "%" Vector__XXX
 SG_ S22F4PID70_BoostPresCntrl m112 : 39|8@0+ (1,0) [255|255] "" Vector__XXX
 SG_ S22F4PID6F_TurboComprPres m111 : 39|8@0+ (1,0) [255|255] "" Vector__XXX
 SG_ S22F4PID6E_InjPresContrSys m110 : 39|8@0+ (1,0) [255|255] "" Vector__XXX
 SG_ S22F4PID6D_FuelPresContrSys m109 : 39|8@0+ (1,0) [255|255] "" Vector__XXX
 SG_ S22F4PID6C_CmdThrottleActRel m108 : 39|8@0+ (1,0) [255|255] "" Vector__XXX
 SG_ S22F4PID6B_ExhaustGasTemp m107 : 39|8@0+ (1,0) [255|255] "" Vector__XXX
 SG_ S22F4PID6A_CmdDieselIntAir m106 : 39|8@0+ (1,0) [255|255] "" Vector__XXX
 SG_ S22F4PID69_CmdEGR_EGRError m105 : 39|8@0+ (1,0) [255|255] "" Vector__XXX
 SG_ S22F4PID68_IntakeAirTempSens m104 : 39|8@0+ (1,0) [255|255] "" Vector__XXX
 SG_ S22F4PID67_EngineCoolantTemp m103 : 39|8@0+ (1,0) [255|255] "" Vector__XXX
 SG_ S22F4PID66_MAFSensor m102 : 39|8@0+ (1,0) [255|255] "" Vector__XXX
 SG_ S22F4PID65_AuxInputOutput m101 : 39|8@0+ (1,0) [255|255] "" Vector__XXX
 SG_ S22F4PID63_EngRefTorq m99 : 39|16@0+ (1,0) [65535|65535] "Nm" Vector__XXX
 SG_ S22F4PID62_ActualEngTorqPct m98 : 39|8@0+ (1,-125) [130|130] "%" Vector__XXX
 SG_ S22F4PID61_DemandEngTorqPct m97 : 39|8@0+ (1,-125) [130|130] "%" Vector__XXX
 SG_ S22F4PID5F_EmissionReq m95 : 39|8@0+ (1,0) [255|255] "" Vector__XXX
 SG_ S22F4PID5E_EngineFuelRate m94 : 39|16@0+ (0.05,0) [3276.75|3276.75] "L/h" Vector__XXX
 SG_ S22F4PID5D_FuelInjectionTiming m93 : 39|16@0+ (0.0078125,-210) [301.9921875|301.9921875] "deg" Vector__XXX
 SG_ S22F4PID5C_EngineOilTemp m92 : 39|8@0+ (1,-40) [215|215] "degC" Vector__XXX
 SG_ S22F4PID5B_HybrBatPackRemLife m91 : 39|8@0+ (0.392156862745098,0) [99.99999999999999|99.99999999999999] "%" Vector__XXX
 SG_ S22F4PID5A_RelAccelPedalPos m90 : 39|8@0+ (0.392156862745098,0) [99.99999999999999|99.99999999999999] "%" Vector__XXX
 SG_ S22F4PID59_FuelRailAbsPres m89 : 39|16@0+ (10,0) [655350|655350] "kPa" Vector__XXX
 SG_ S22F4PID58_LongSecOxyTrimBank2 m88 : 39|8@0+ (0.78125,-100) [99.21875|99.21875] "%" Vector__XXX
 SG_ S22F4PID57_ShortSecOxyTrimBank2 m87 : 39|8@0+ (0.78125,-100) [99.21875|99.21875] "%" Vector__XXX
 SG_ S22F4PID56_LongSecOxyTrimBank1 m86 : 39|8@0+ (0.78125,-100) [99.21875|99.21875] "%" Vector__XXX
 SG_ S22F4PID55_ShortSecOxyTrimBank1 m85 : 39|8@0+ (0.78125,-100) [99.21875|99.21875] "%" Vector__XXX
 SG_ S22F4PID54_EvapSysVapPres m84 : 39|16@0+ (1,-32767) [32768|32768] "Pa" Vector__XXX
 SG_ S22F4PID53_AbsEvapSysVapPres m83 : 39|16@0+ (0.005,0) [327.675|327.675] "kPa" Vector__XXX
 SG_ S22F4PID52_EthanolFuelPct m82 : 39|8@0+ (0.392156862745098,0) [99.99999999999999|99.99999999999999] "%" Vector__XXX
 SG_ S22F4PID51_FuelType m81 : 39|8@0+ (1,0) [255|255] "" Vector__XXX
 SG_ S22F4PID50_Max_AirFlowMAF m80 : 39|8@0+ (10,0) [2550|2550] "g/s" Vector__XXX
 SG_ S22F4PID4F_Max_FAER m79 : 39|8@0+ (1,0) [255|255] "ratio" Vector__XXX
 SG_ S22F4PID4E_TimeSinceCodeClear m78 : 39|16@0+ (1,0) [65535|65535] "minutes" Vector__XXX
 SG_ S22F4PID4D_TimeRunMILOn m77 : 39|16@0+ (1,0) [65535|65535] "minutes" Vector__XXX
 SG_ S22F4PID4C_CmdThrottleAct m76 : 39|8@0+ (0.392156862745098,0) [99.99999999999999|99.99999999999999] "%" Vector__XXX
 SG_ S22F4PID4B_AbsThrottlePosF m75 : 39|8@0+ (0.392156862745098,0) [99.99999999999999|99.99999999999999] "%" Vector__XXX
 SG_ S22F4PID4A_AbsThrottlePosE m74 : 39|8@0+ (0.392156862745098,0) [99.99999999999999|99.99999999999999] "%" Vector__XXX
 SG_ S22F4PID49_AbsThrottlePosD m73 : 39|8@0+ (0.392156862745098,0) [99.99999999999999|99.99999999999999] "%" Vector__XXX
 SG_ S22F4PID48_AbsThrottlePosC m72 : 39|8@0+ (0.392156862745098,0) [99.99999999999999|99.99999999999999] "%" Vector__XXX
 SG_ S22F4PID47_AbsThrottlePosB m71 : 39|8@0+ (0.392156862745098,0) [99.99999999999999|99.99999999999999] "%" Vector__XXX
 SG_ S22F4PID46_AmbientAirTemp m70 : 39|8@0+ (1,-40) [215|215] "degC" Vector__XXX
 SG_ S22F4PID45_RelThrottlePos m69 : 39|8@0+ (0.392156862745098,0) [99.99999999999999|99.99999999999999] "%" Vector__XXX
 SG_ S22F4PID44_FuelAirCmdEquiv m68 : 39|16@0+ (3.0517578125e-05,0) [1.999969482421875|1.999969482421875] "ratio" Vector__XXX
 SG_ S22F4PID43_AbsLoadValue m67 : 39|16@0+ (0.392156862745098,0) [25699.999999999996|25699.999999999996] "%" Vector__XXX
 SG_ S22F4PID42_ControlModuleVolt m66 : 39|16@0+ (0.001,0) [65.535|65.535] "V" Vector__XXX
 SG_ S22F4PID41_MonStatusDriveCycle m65 : 39|32@0+ (1,0) [4294967295|4294967295] "" Vector__XXX
 SG_ S22F4PID3F_CatTempBank2Sens2 m63 : 39|16@0+ (0.1,-40) [6513.5|6513.5] "degC" Vector__XXX
 SG_ S22F4PID3E_CatTempBank1Sens2 m62 : 39|16@0+ (0.1,-40) [6513.5|6513.5] "degC" Vector__XXX
 SG_ S22F4PID3D_CatTempBank2Sens1 m61 : 39|16@0+ (0.1,-40) [6513.5|6513.5] "degC" Vector__XXX
 SG_ S22F4PID3C_CatTempBank1Sens1 m60 : 39|16@0+ (0.1,-40) [6513.5|6513.5] "degC" Vector__XXX
 SG_ S22F4PID3B_OxySensor8_FAER m59 : 39|16@0+ (3.0517578125e-05,0) [1.999969482421875|1.999969482421875] "ratio" Vector__XXX
 SG_ S22F4PID3A_OxySensor7_FAER m58 : 39|16@0+ (3.0517578125e-05,0) [1.999969482421875|1.999969482421875] "ratio" Vector__XXX
 SG_ S22F4PID39_OxySensor6_FAER m57 : 39|16@0+ (3.0517578125e-05,0) [1.999969482421875|1.999969482421875] "ratio" Vector__XXX
 SG_ S22F4PID38_OxySensor5_FAER m56 : 39|16@0+ (3.0517578125e-05,0) [1.999969482421875|1.999969482421875] "ratio" Vector__XXX
 SG_ S22F4PID37_OxySensor4_FAER m55 : 39|16@0+ (3.0517578125e-05,0) [1.999969482421875|1.999969482421875] "ratio" Vector__XXX
 SG_ S22F4PID36_OxySensor3_FAER m54 : 39|16@0+ (3.0517578125e-05,0) [1.999969482421875|1.999969482421875] "ratio" Vector__XXX
 SG_ S22F4PID35_OxySensor2_FAER m53 : 39|16@0+ (3.0517578125e-05,0) [1.999969482421875|1.999969482421875] "ratio" Vector__XXX
 SG_ S22F4PID34_OxySensor1_FAER m52 : 39|16@0+ (3.0517578125e-05,0) [1.999969482421875|1.999969482421875] "ratio" Vector__XXX
 SG_ S22F4PID33_AbsBaroPres m51 : 39|8@0+ (1,0) [255|255] "kPa" Vector__XXX
 SG_ S22F4PID32_EvapSysVaporPres m50 : 39|16@0+ (0.25,0) [16383.75|16383.75] "Pa" Vector__XXX
 SG_ S22F4PID31_DistSinceCodeClear m49 : 39|16@0+ (1,0) [65535|65535] "km" Vector__XXX
 SG_ S22F4PID30_WaUpsSinceCodeClear m48 : 39|8@0+ (1,0) [255|255] "count" Vector__XXX
 SG_ S22F4PID2F_FuelTankLevel m47 : 39|8@0+ (0.392156862745098,0) [99.99999999999999|99.99999999999999] "%" Vector__XXX
 SG_ S22F4PID2E_CmdEvapPurge m46 : 39|8@0+ (0.392156862745098,0) [99.99999999999999|99.99999999999999] "%" Vector__XXX
 SG_ S22F4PID2D_EGRError m45 : 39|8@0+ (0.78125,-100) [99.21875|99.21875] "%" Vector__XXX
 SG_ S22F4PID2C_CmdEGR m44 : 39|8@0+ (0.392156862745098,0) [99.99999999999999|99.99999999999999] "%" Vector__XXX
 SG_ S22F4PID2B_OxySensor8_FAER m43 : 39|16@0+ (3.0517578125e-05,0) [1.999969482421875|1.999969482421875] "ratio" Vector__XXX
 SG_ S22F4PID2A_OxySensor7_FAER m42 : 39|16@0+ (3.0517578125e-05,0) [1.999969482421875|1.999969482421875] "ratio" Vector__XXX
 SG_ S22F4PID29_OxySensor6_FAER m41 : 39|16@0+ (3.0517578125e-05,0) [1.999969482421875|1.999969482421875] "ratio" Vector__XXX
 SG_ S22F4PID28_OxySensor5_FAER m40 : 39|16@0+ (3.0517578125e-05,0) [1.999969482421875|1.999969482421875] "ratio" Vector__XXX
 SG_ S22F4PID27_OxySensor4_FAER m39 : 39|16@0+ (3.0517578125e-05,0) [1.999969482421875|1.999969482421875] "ratio" Vector__XXX
 SG_ S22F4PID26_OxySensor3_FAER m38 : 39|16@0+ (3.0517578125e-05,0) [1.999969482421875|1.999969482421875] "ratio" Vector__XXX
 SG_ S22F4PID25_OxySensor2_FAER m37 : 39|16@0+ (3.0517578125e-05,0) [1.999969482421875|1.999969482421875] "ratio" Vector__XXX
 SG_ S22F4PID24_OxySensor1_FAER m36 : 39|16@0+ (3.0517578125e-05,0) [1.999969482421875|1.999969482421875] "ratio" Vector__XXX
 SG_ S22F4PID23_FuelRailGaug m35 : 39|16@0+ (10,0) [655350|655350] "kPa" Vector__XXX
 SG_ S22F4PID22_FuelRailPres m34 : 39|16@0+ (0.079,0) [5177.265|5177.265] "kPa" Vector__XXX
 SG_ S22F4PID21_DistanceMILOn m33 : 39|16@0+ (1,0) [65535|65535] "km" Vector__XXX
 SG_ S22F4PID1F_TimeSinceEngStart m31 : 39|16@0+ (1,0) [65535|65535] "seconds" Vector__XXX
 SG_ S22F4PID1C_OBDStandard m28 : 39|8@0+ (1,0) [255|255] "" Vector__XXX
 SG_ S22F4PID1B_OxySensor8_Volt m27 : 39|8@0+ (0.005,0) [1.2750000000000001|1.2750000000000001] "volts" Vector__XXX
 SG_ S22F4PID1A_OxySensor7_Volt m26 : 39|8@0+ (0.005,0) [1.2750000000000001|1.2750000000000001] "volts" Vector__XXX
 SG_ S22F4PID19_OxySensor6_Volt m25 : 39|8@0+ (0.005,0) [1.2750000000000001|1.2750000000000001] "volts" Vector__XXX
 SG_ S22F4PID18_OxySensor5_Volt m24 : 39|8@0+ (0.005,0) [1.2750000000000001|1.2750000000000001] "volts" Vector__XXX
 SG_ S22F4PID17_OxySensor4_Volt m23 : 39|8@0+ (0.005,0) [1.2750000000000001|1.2750000000000001] "volts" Vector__XXX
 SG_ S22F4PID16_OxySensor3_Volt m22 : 39|8@0+ (0.005,0) [1.2750000000000001|1.2750000000000001] "volts" Vector__XXX
 SG_ S22F4PID15_OxySensor2_Volt m21 : 39|8@0+ (0.005,0) [1.2750000000000001|1.2750000000000001] "volts" Vector__XXX
 SG_ S22F4PID14_OxySensor1_Volt m20 : 39|8@0+ (0.005,0) [1.2750000000000001|1.2750000000000001] "volts" Vector__XXX
 SG_ S22F4PID12_CmdSecAirStatus m18 : 39|8@0+ (1,0) [255|255] "" Vector__XXX
 SG_ S22F4PID11_ThrottlePosition m17 : 39|8@0+ (0.39216,0) [100.0008|100.0008] "%" Vector__XXX
 SG_ S22F4PID10_MAFAirFlowRate m16 : 39|16@0+ (0.01,0) [655.35|655.35] "grams/sec" Vector__XXX
 SG_ S22F4PID0F_IntakeAirTemperature m15 : 39|8@0+ (1,-40) [215|215] "degC" Vector__XXX
 SG_ S22F4PID0E_TimingAdvance m14 : 39|8@0+ (0.5,-64) [63.5|63.5] "deg before TDC" Vector__XXX
 SG_ S22F4PID0D_VehicleSpeed m13 : 39|8@0+ (1,0) [255|255] "km/h" Vector__XXX
 SG_ S22F4PID0C_EngineRPM m12 : 39|16@0+ (0.25,0) [16383.75|16383.75] "rpm" Vector__XXX
 SG_ S22F4PID0B_IntakeManiAbsPress m11 : 39|8@0+ (1,0) [255|255] "kPa" Vector__XXX
 SG_ S22F4PID0A_FuelPressure m10 : 39|8@0+ (3,0) [765|765] "kPa" Vector__XXX
 SG_ S22F4PID09_LongFuelTrimBank2 m9 : 39|8@0+ (0.78125,-100) [99.21875|99.21875] "%" Vector__XXX
 SG_ S22F4PID08_ShortFuelTrimBank2 m8 : 39|8@0+ (0.78125,-100) [99.21875|99.21875] "%" Vector__XXX
 SG_ S22F4PID07_LongFuelTrimBank1 m7 : 39|8@0+ (0.78125,-100) [99.21875|99.21875] "%" Vector__XXX
 SG_ S22F4PID06_ShortFuelTrimBank1 m6 : 39|8@0+ (0.78125,-100) [99.21875|99.21875] "%" Vector__XXX
 SG_ S22F4PID05_EngineCoolantTemp m5 : 39|8@0+ (1,-40) [215|215] "degC" Vector__XXX
 SG_ S22F4PID04_CalcEngineLoad m4 : 39|8@0+ (0.39216,0) [100.0008|100.0008] "%" Vector__XXX
 SG_ S22F4PID03_FuelSystemStatus m3 : 39|16@0+ (1,0) [65535|65535] "" Vector__XXX
 SG_ S22F4PID01_MonitorStatus m1 : 39|32@0+ (1,0) [4294967295|4294967295] "" Vector__XXX
 SG_ S01PID58_LongSecOxyTrimBank4 m88 : 39|8@0+ (0.78125,-100) [99.21875|99.21875] "%" Vector__XXX
 SG_ S01PID57_ShortSecOxyTrimBank4 m87 : 39|8@0+ (0.78125,-100) [99.21875|99.21875] "%" Vector__XXX
 SG_ S01PID56_LongSecOxyTrimBank3 m86 : 39|8@0+ (0.78125,-100) [99.21875|99.21875] "%" Vector__XXX
 SG_ S01PID55_ShortSecOxyTrimBank3 m85 : 39|8@0+ (0.78125,-100) [99.21875|99.21875] "%" Vector__XXX
 SG_ S01PID4F_Max_OxySensVol m79 : 39|8@0+ (1,0) [255|255] "V" Vector__XXX
 SG_ S01PID1B_OxySensor8_STFT m27 : 39|8@0+ (0.78125,-100) [99.21875|99.21875] "%" Vector__XXX
 SG_ S01PID1A_OxySensor7_STFT m26 : 39|8@0+ (0.78125,-100) [99.21875|99.21875] "%" Vector__XXX
 SG_ S01PID19_OxySensor6_STFT m25 : 39|8@0+ (0.78125,-100) [99.21875|99.21875] "%" Vector__XXX
 SG_ S01PID18_OxySensor5_STFT m24 : 39|8@0+ (0.78125,-100) [99.21875|99.21875] "%" Vector__XXX
 SG_ S01PID17_OxySensor4_STFT m23 : 39|8@0+ (0.78125,-100) [99.21875|99.21875] "%" Vector__XXX
 SG_ S01PID16_OxySensor3_STFT m22 : 39|8@0+ (0.78125,-100) [99.21875|99.21875] "%" Vector__XXX
 SG_ S01PID15_OxySensor2_STFT m21 : 39|8@0+ (0.78125,-100) [99.21875|99.21875] "%" Vector__XXX
 SG_ S01PID14_OxySensor1_STFT m20 : 39|8@0+ (0.78125,-100) [99.21875|99.21875] "%" Vector__XXX
 SG_ S22F4PID m244M : 31|8@0+ (1,0) [0|255] "" Vector__XXX
 SG_ S01PIDA6_Odometer m166 : 31|32@0+ (0.1,0) [429496729.5|429496729.5] "km" Vector__XXX
 SG_ S01PID8E_EngFrictionPctTorq m142 : 31|8@0+ (1,-125) [130|130] "%" Vector__XXX
 SG_ S01PID70_BoostPresCntrl m112 : 31|8@0+ (1,0) [255|255] "" Vector__XXX
 SG_ S01PID6F_TurboComprPres m111 : 31|8@0+ (1,0) [255|255] "" Vector__XXX
 SG_ S01PID6E_InjPresContrSys m110 : 31|8@0+ (1,0) [255|255] "" Vector__XXX
 SG_ S01PID6D_FuelPresContrSys m109 : 31|8@0+ (1,0) [255|255] "" Vector__XXX
 SG_ S01PID6C_CmdThrottleActRel m108 : 31|8@0+ (1,0) [255|255] "" Vector__XXX
 SG_ S01PID6B_ExhaustGasTemp m107 : 31|8@0+ (1,0) [255|255] "" Vector__XXX
 SG_ S01PID6A_CmdDieselIntAir m106 : 31|8@0+ (1,0) [255|255] "" Vector__XXX
 SG_ S01PID69_CmdEGR_EGRError m105 : 31|8@0+ (1,0) [255|255] "" Vector__XXX
 SG_ S01PID68_IntakeAirTempSens m104 : 31|8@0+ (1,0) [255|255] "" Vector__XXX
 SG_ S01PID67_EngineCoolantTemp m103 : 31|8@0+ (1,0) [255|255] "" Vector__XXX
 SG_ S01PID66_MAFSensor m102 : 31|8@0+ (1,0) [255|255] "" Vector__XXX
 SG_ S01PID65_AuxInputOutput m101 : 31|8@0+ (1,0) [255|255] "" Vector__XXX
 SG_ S01PID63_EngRefTorq m99 : 31|16@0+ (1,0) [65535|65535] "Nm" Vector__XXX
 SG_ S01PID62_ActualEngTorqPct m98 : 31|8@0+ (1,-125) [130|130] "%" Vector__XXX
 SG_ S01PID61_DemandEngTorqPct m97 : 31|8@0+ (1,-125) [130|130] "%" Vector__XXX
 SG_ S01PID5F_EmissionReq m95 : 31|8@0+ (1,0) [255|255] "" Vector__XXX
 SG_ S01PID5E_EngineFuelRate m94 : 31|16@0+ (0.05,0) [3276.75|3276.75] "L/h" Vector__XXX
 SG_ S01PID5D_FuelInjectionTiming m93 : 31|16@0+ (0.0078125,-210) [301.9921875|301.9921875] "deg" Vector__XXX
 SG_ S01PID5C_EngineOilTemp m92 : 31|8@0+ (1,-40) [215|215] "degC" Vector__XXX
 SG_ S01PID5B_HybrBatPackRemLife m91 : 31|8@0+ (0.392156862745098,0) [99.99999999999999|99.99999999999999] "%" Vector__XXX
 SG_ S01PID5A_RelAccelPedalPos m90 : 31|8@0+ (0.392156862745098,0) [99.99999999999999|99.99999999999999] "%" Vector__XXX
 SG_ S01PID59_FuelRailAbsPres m89 : 31|16@0+ (10,0) [655350|655350] "kPa" Vector__XXX
 SG_ S01PID58_LongSecOxyTrimBank2 m88 : 31|8@0+ (0.78125,-100) [99.21875|99.21875] "%" Vector__XXX
 SG_ S01PID57_ShortSecOxyTrimBank2 m87 : 31|8@0+ (0.78125,-100) [99.21875|99.21875] "%" Vector__XXX
 SG_ S01PID56_LongSecOxyTrimBank1 m86 : 31|8@0+ (0.78125,-100) [99.21875|99.21875] "%" Vector__XXX
 SG_ S01PID55_ShortSecOxyTrimBank1 m85 : 31|8@0+ (0.78125,-100) [99.21875|99.21875] "%" Vector__XXX
 SG_ S01PID54_EvapSysVapPres m84 : 31|16@0+ (1,-32767) [32768|32768] "Pa" Vector__XXX
 SG_ S01PID53_AbsEvapSysVapPres m83 : 31|16@0+ (0.005,0) [327.675|327.675] "kPa" Vector__XXX
 SG_ S01PID52_EthanolFuelPct m82 : 31|8@0+ (0.392156862745098,0) [99.99999999999999|99.99999999999999] "%" Vector__XXX
 SG_ S01PID51_FuelType m81 : 31|8@0+ (1,0) [255|255] "" Vector__XXX
 SG_ S01PID50_Max_AirFlowMAF m80 : 31|8@0+ (10,0) [2550|2550] "g/s" Vector__XXX
 SG_ S01PID4F_Max_FAER m79 : 31|8@0+ (1,0) [255|255] "ratio" Vector__XXX
 SG_ S01PID4E_TimeSinceCodeClear m78 : 31|16@0+ (1,0) [65535|65535] "minutes" Vector__XXX
 SG_ S01PID4D_TimeRunMILOn m77 : 31|16@0+ (1,0) [65535|65535] "minutes" Vector__XXX
 SG_ S01PID4C_CmdThrottleAct m76 : 31|8@0+ (0.392156862745098,0) [99.99999999999999|99.99999999999999] "%" Vector__XXX
 SG_ S01PID4B_AbsThrottlePosF m75 : 31|8@0+ (0.392156862745098,0) [99.99999999999999|99.99999999999999] "%" Vector__XXX
 SG_ S01PID4A_AbsThrottlePosE m74 : 31|8@0+ (0.392156862745098,0) [99.99999999999999|99.99999999999999] "%" Vector__XXX
 SG_ S01PID49_AbsThrottlePosD m73 : 31|8@0+ (0.392156862745098,0) [99.99999999999999|99.99999999999999] "%" Vector__XXX
 SG_ S01PID48_AbsThrottlePosC m72 : 31|8@0+ (0.392156862745098,0) [99.99999999999999|99.99999999999999] "%" Vector__XXX
 SG_ S01PID47_AbsThrottlePosB m71 : 31|8@0+ (0.392156862745098,0) [99.99999999999999|99.99999999999999] "%" Vector__XXX
 SG_ S01PID46_AmbientAirTemp m70 : 31|8@0+ (1,-40) [215|215] "degC" Vector__XXX
 SG_ S01PID45_RelThrottlePos m69 : 31|8@0+ (0.392156862745098,0) [99.99999999999999|99.99999999999999] "%" Vector__XXX
 SG_ S01PID44_FuelAirCmdEquiv m68 : 31|16@0+ (3.0517578125e-05,0) [1.999969482421875|1.999969482421875] "ratio" Vector__XXX
 SG_ S01PID43_AbsLoadValue m67 : 31|16@0+ (0.392156862745098,0) [25699.999999999996|25699.999999999996] "%" Vector__XXX
 SG_ S01PID42_ControlModuleVolt m66 : 31|16@0+ (0.001,0) [65.535|65.535] "V" Vector__XXX
 SG_ S01PID41_MonStatusDriveCycle m65 : 31|32@0+ (1,0) [4294967295|4294967295] "" Vector__XXX
 SG_ S01PID3F_CatTempBank2Sens2 m63 : 31|16@0+ (0.1,-40) [6513.5|6513.5] "degC" Vector__XXX
 SG_ S01PID3E_CatTempBank1Sens2 m62 : 31|16@0+ (0.1,-40) [6513.5|6513.5] "degC" Vector__XXX
 SG_ S01PID3D_CatTempBank2Sens1 m61 : 31|16@0+ (0.1,-40) [6513.5|6513.5] "degC" Vector__XXX
 SG_ S01PID3C_CatTempBank1Sens1 m60 : 31|16@0+ (0.1,-40) [6513.5|6513.5] "degC" Vector__XXX
 SG_ S01PID3B_OxySensor8_FAER m59 : 31|16@0+ (3.0517578125e-05,0) [1.999969482421875|1.999969482421875] "ratio" Vector__XXX
 SG_ S01PID3A_OxySensor7_FAER m58 : 31|16@0+ (3.0517578125e-05,0) [1.999969482421875|1.999969482421875] "ratio" Vector__XXX
 SG_ S01PID39_OxySensor6_FAER m57 : 31|16@0+ (3.0517578125e-05,0) [1.999969482421875|1.999969482421875] "ratio" Vector__XXX
 SG_ S01PID38_OxySensor5_FAER m56 : 31|16@0+ (3.0517578125e-05,0) [1.999969482421875|1.999969482421875] "ratio" Vector__XXX
 SG_ S01PID37_OxySensor4_FAER m55 : 31|16@0+ (3.0517578125e-05,0) [1.999969482421875|1.999969482421875] "ratio" Vector__XXX
 SG_ S01PID36_OxySensor3_FAER m54 : 31|16@0+ (3.0517578125e-05,0) [1.999969482421875|1.999969482421875] "ratio" Vector__XXX
 SG_ S01PID35_OxySensor2_FAER m53 : 31|16@0+ (3.0517578125e-05,0) [1.999969482421875|1.999969482421875] "ratio" Vector__XXX
 SG_ S01PID34_OxySensor1_FAER m52 : 31|16@0+ (3.0517578125e-05,0) [1.999969482421875|1.999969482421875] "ratio" Vector__XXX
 SG_ S01PID33_AbsBaroPres m51 : 31|8@0+ (1,0) [255|255] "kPa" Vector__XXX
 SG_ S01PID32_EvapSysVaporPres m50 : 31|16@0+ (0.25,0) [16383.75|16383.75] "Pa" Vector__XXX
 SG_ S01PID31_DistSinceCodeClear m49 : 31|16@0+ (1,0) [65535|65535] "km" Vector__XXX
 SG_ S01PID30_WaUpsSinceCodeClear m48 : 31|8@0+ (1,0) [255|255] "count" Vector__XXX
 SG_ S01PID2F_FuelTankLevel m47 : 31|8@0+ (0.392156862745098,0) [99.99999999999999|99.99999999999999] "%" Vector__XXX
 SG_ S01PID2E_CmdEvapPurge m46 : 31|8@0+ (0.392156862745098,0) [99.99999999999999|99.99999999999999] "%" Vector__XXX
 SG_ S01PID2D_EGRError m45 : 31|8@0+ (0.78125,-100) [99.21875|99.21875] "%" Vector__XXX
 SG_ S01PID2C_CmdEGR m44 : 31|8@0+ (0.392156862745098,0) [99.99999999999999|99.99999999999999] "%" Vector__XXX
 SG_ S01PID2B_OxySensor8_FAER m43 : 31|16@0+ (3.0517578125e-05,0) [1.999969482421875|1.999969482421875] "ratio" Vector__XXX
 SG_ S01PID2A_OxySensor7_FAER m42 : 31|16@0+ (3.0517578125e-05,0) [1.999969482421875|1.999969482421875] "ratio" Vector__XXX
 SG_ S01PID29_OxySensor6_FAER m41 : 31|16@0+ (3.0517578125e-05,0) [1.999969482421875|1.999969482421875] "ratio" Vector__XXX
 SG_ S01PID28_OxySensor5_FAER m40 : 31|16@0+ (3.0517578125e-05,0) [1.999969482421875|1.999969482421875] "ratio" Vector__XXX
 SG_ S01PID27_OxySensor4_FAER m39 : 31|16@0+ (3.0517578125e-05,0) [1.999969482421875|1.999969482421875] "ratio" Vector__XXX
 SG_ S01PID26_OxySensor3_FAER m38 : 31|16@0+ (3.0517578125e-05,0) [1.999969482421875|1.999969482421875] "ratio" Vector__XXX
 SG_ S01PID25_OxySensor2_FAER m37 : 31|16@0+ (3.0517578125e-05,0) [1.999969482421875|1.999969482421875] "ratio" Vector__XXX
 SG_ S01PID24_OxySensor1_FAER m36 : 31|16@0+ (3.0517578125e-05,0) [1.999969482421875|1.999969482421875] "ratio" Vector__XXX
 SG_ S01PID23_FuelRailGaug m35 : 31|16@0+ (10,0) [655350|655350] "kPa" Vector__XXX
 SG_ S01PID22_FuelRailPres m34 : 31|16@0+ (0.079,0) [5177.265|5177.265] "kPa" Vector__XXX
 SG_ S01PID21_DistanceMILOn m33 : 31|16@0+ (1,0) [65535|65535] "km" Vector__XXX
 SG_ S01PID1F_TimeSinceEngStart m31 : 31|16@0+ (1,0) [65535|65535] "seconds" Vector__XXX
 SG_ S01PID1C_OBDStandard m28 : 31|8@0+ (1,0) [255|255] "" Vector__XXX
 SG_ S01PID1B_OxySensor8_Volt m27 : 31|8@0+ (0.005,0) [1.2750000000000001|1.2750000000000001] "volts" Vector__XXX
 SG_ S01PID1A_OxySensor7_Volt m26 : 31|8@0+ (0.005,0) [1.2750000000000001|1.2750000000000001] "volts" Vector__XXX
 SG_ S01PID19_OxySensor6_Volt m25 : 31|8@0+ (0.005,0) [1.2750000000000001|1.2750000000000001] "volts" Vector__XXX
 SG_ S01PID18_OxySensor5_Volt m24 : 31|8@0+ (0.005,0) [1.2750000000000001|1.2750000000000001] "volts" Vector__XXX
 SG_ S01PID17_OxySensor4_Volt m23 : 31|8@0+ (0.005,0) [1.2750000000000001|1.2750000000000001] "volts" Vector__XXX
 SG_ S01PID16_OxySensor3_Volt m22 : 31|8@0+ (0.005,0) [1.2750000000000001|1.2750000000000001] "volts" Vector__XXX
 SG_ S01PID15_OxySensor2_Volt m21 : 31|8@0+ (0.005,0) [1.2750000000000001|1.2750000000000001] "volts" Vector__XXX
 SG_ S01PID14_OxySensor1_Volt m20 : 31|8@0+ (0.005,0) [1.2750000000000001|1.2750000000000001] "volts" Vector__XXX
 SG_ S01PID12_CmdSecAirStatus m18 : 31|8@0+ (1,0) [255|255] "" Vector__XXX
 SG_ S01PID11_ThrottlePosition m17 : 31|8@0+ (0.39216,0) [100.0008|100.0008] "%" Vector__XXX
 SG_ S01PID10_MAFAirFlowRate m16 : 31|16@0+ (0.01,0) [655.35|655.35] "grams/sec" Vector__XXX
 SG_ S01PID0F_IntakeAirTemperature m15 : 31|8@0+ (1,-40) [215|215] "degC" Vector__XXX
 SG_ S01PID0E_TimingAdvance m14 : 31|8@0+ (0.5,-64) [63.5|63.5] "deg before TDC" Vector__XXX
 SG_ S01PID0D_VehicleSpeed m13 : 31|8@0+ (1,0) [255|255] "km/h" Vector__XXX
 SG_ S01PID0C_EngineRPM m12 : 31|16@0+ (0.25,0) [16383.75|16383.75] "rpm" Vector__XXX
 SG_ S01PID0B_IntakeManiAbsPress m11 : 31|8@0+ (1,0) [255|255] "kPa" Vector__XXX
 SG_ S01PID0A_FuelPressure m10 : 31|8@0+ (3,0) [765|765] "kPa" Vector__XXX
 SG_ S01PID09_LongFuelTrimBank2 m9 : 31|8@0+ (0.78125,-100) [99.21875|99.21875] "%" Vector__XXX
 SG_ S01PID08_ShortFuelTrimBank2 m8 : 31|8@0+ (0.78125,-100) [99.21875|99.21875] "%" Vector__XXX
 SG_ S01PID07_LongFuelTrimBank1 m7 : 31|8@0+ (0.78125,-100) [99.21875|99.21875] "%" Vector__XXX
 SG_ S01PID06_ShortFuelTrimBank1 m6 : 31|8@0+ (0.78125,-100) [99.21875|99.21875] "%" Vector__XXX
 SG_ S01PID05_EngineCoolantTemp m5 : 31|8@0+ (1,-40) [215|215] "degC" Vector__XXX
 SG_ S01PID04_CalcEngineLoad m4 : 31|8@0+ (0.39216,0) [100.0008|100.0008] "%" Vector__XXX
 SG_ S01PID03_FuelSystemStatus m3 : 31|16@0+ (1,0) [65535|65535] "" Vector__XXX
 SG_ S01PID02_FreezeDTC m2 : 31|16@0+ (1,0) [65535|65535] "" Vector__XXX
 SG_ S01PID01_MonitorStatus m1 : 31|32@0+ (1,0) [4294967295|4294967295] "" Vector__XXX
 SG_ SubFct m34M : 23|8@0+ (1,0) [0|255] "" Vector__XXX
 SG_ S01PID m1M : 23|8@0+ (1,0) [0|255] "" Vector__XXX
 SG_ S M : 13|6@0+ (1,0) [1|63] "" Vector__XXX
 SG_ S_Flags : 15|2@0+ (1,0) [0|0] "" Vector__XXX
 SG_ Length : 7|8@0+ (1,0) [2|7] "" Vector__XXX

CM_ BO_ 2024 "OBD";
CM_ BO_ 2564485397 "OBD";
BA_DEF_  "BusType" STRING ;
BA_DEF_  "ProtocolType" STRING ;
BA_DEF_  "DatabaseCompiler" STRING ;
BA_DEF_ BO_  "VFrameFormat" ENUM  "StandardCAN","ExtendedCAN","StandardCAN_FD","ExtendedCAN_FD","J1939PG";
BA_DEF_ SG_  "SignalIgnore" INT 0 1;
BA_DEF_ SG_  "SystemSignalLongSymbol" STRING ;
BA_DEF_DEF_  "BusType" "";
BA_DEF_DEF_  "ProtocolType" "";
BA_DEF_DEF_  "DatabaseCompiler" "CSS Electronics (wwww.csselectronics.com)";
BA_DEF_DEF_  "VFrameFormat" "";
BA_DEF_DEF_  "SignalIgnore" 0;
BA_DEF_DEF_  "SystemSignalLongSymbol" "";
BA_ "BusType" "CAN";
BA_ "ProtocolType" "J1939";
BA_ "VFrameFormat" BO_ 2024 0;
BA_ "SystemSignalLongSymbol" SG_ 2024 SUP_S01PID57_ShortSecOxyTrimBank "SUP_S01PID57_ShortSecOxyTrimBank2";
BA_ "SystemSignalLongSymbol" SG_ 2024 SUP_S01PID55_ShortSecOxyTrimBank "SUP_S01PID55_ShortSecOxyTrimBank1";
BA_ "SystemSignalLongSymbol" SG_ 2024 SUP_S01PID0F_IntakeAirTemperatur "SUP_S01PID0F_IntakeAirTemperature";
BA_ "SignalIgnore" SG_ 2024 S02PID 1;
BA_ "SignalIgnore" SG_ 2024 S01PID 1;
BA_ "SignalIgnore" SG_ 2024 S 1;
BA_ "VFrameFormat" BO_ 2015 0;
BA_ "SignalIgnore" SG_ 2015 S01PID 1;
BA_ "SignalIgnore" SG_ 2015 S 1;
BA_ "VFrameFormat" BO_ 2564485397 4;
BA_ "SystemSignalLongSymbol" SG_ 2564485397 SUP_S01PID57_ShortSecOxyTrimBank "SUP_S01PID57_ShortSecOxyTrimBank2";
BA_ "SystemSignalLongSymbol" SG_ 2564485397 SUP_S01PID55_ShortSecOxyTrimBank "SUP_S01PID55_ShortSecOxyTrimBank1";
BA_ "SystemSignalLongSymbol" SG_ 2564485397 SUP_S01PID0F_IntakeAirTemperatur "SUP_S01PID0F_IntakeAirTemperature";
BA_ "SignalIgnore" SG_ 2564485397 S22F8PID 1;
BA_ "SignalIgnore" SG_ 2564485397 S22F4PID 1;
BA_ "SignalIgnore" SG_ 2564485397 SubFct 1;
BA_ "SignalIgnore" SG_ 2564485397 S02PID 1;
BA_ "SignalIgnore" SG_ 2564485397 S01PID 1;
BA_ "SignalIgnore" SG_ 2564485397 S 1;
BA_ "VFrameFormat" BO_ 2564502513 4;
BA_ "SignalIgnore" SG_ 2564502513 S22F4PID 1;
BA_ "SignalIgnore" SG_ 2564502513 SubFct 1;
BA_ "SignalIgnore" SG_ 2564502513 S01PID 1;
BA_ "SignalIgnore" SG_ 2564502513 S 1;

SG_MUL_VAL_ 2024 S01PID01_MonitorStatus S01PID 1-1;
SG_MUL_VAL_ 2024 S01PID02_FreezeDTC S01PID 2-2;
SG_MUL_VAL_ 2024 S01PID03_FuelSystemStatus S01PID 3-3;
SG_MUL_VAL_ 2024 S01PID04_CalcEngineLoad S01PID 4-4;
SG_MUL_VAL_ 2024 S01PID05_EngineCoolantTemp S01PID 5-5;
SG_MUL_VAL_ 2024 S01PID06_ShortFuelTrimBank1 S01PID 6-6;
SG_MUL_VAL_ 2024 S01PID07_LongFuelTrimBank1 S01PID 7-7;
SG_MUL_VAL_ 2024 S01PID08_ShortFuelTrimBank2 S01PID 8-8;
SG_MUL_VAL_ 2024 S01PID09_LongFuelTrimBank2 S01PID 9-9;
SG_MUL_VAL_ 2024 S01PID0A_FuelPressure S01PID 10-10;
SG_MUL_VAL_ 2024 S01PID0B_IntakeManiAbsPress S01PID 11-11;
SG_MUL_VAL_ 2024 S01PID0C_EngineRPM S01PID 12-12;
SG_MUL_VAL_ 2024 S01PID0D_VehicleSpeed S01PID 13-13;
SG_MUL_VAL_ 2024 S01PID0E_TimingAdvance S01PID 14-14;
SG_MUL_VAL_ 2024 S01PID0F_IntakeAirTemperature S01PID 15-15;
SG_MUL_VAL_ 2024 S01PID10_MAFAirFlowRate S01PID 16-16;
SG_MUL_VAL_ 2024 S01PID11_ThrottlePosition S01PID 17-17;
SG_MUL_VAL_ 2024 S01PID12_CmdSecAirStatus S01PID 18-18;
SG_MUL_VAL_ 2024 S01PID14_OxySensor1_Volt S01PID 20-20;
SG_MUL_VAL_ 2024 S01PID14_OxySensor1_STFT S01PID 20-20;
SG_MUL_VAL_ 2024 S01PID15_OxySensor2_Volt S01PID 21-21;
SG_MUL_VAL_ 2024 S01PID15_OxySensor2_STFT S01PID 21-21;
SG_MUL_VAL_ 2024 S01PID16_OxySensor3_Volt S01PID 22-22;
SG_MUL_VAL_ 2024 S01PID16_OxySensor3_STFT S01PID 22-22;
SG_MUL_VAL_ 2024 S01PID17_OxySensor4_Volt S01PID 23-23;
SG_MUL_VAL_ 2024 S01PID17_OxySensor4_STFT S01PID 23-23;
SG_MUL_VAL_ 2024 S01PID18_OxySensor5_Volt S01PID 24-24;
SG_MUL_VAL_ 2024 S01PID18_OxySensor5_STFT S01PID 24-24;
SG_MUL_VAL_ 2024 S01PID19_OxySensor6_Volt S01PID 25-25;
SG_MUL_VAL_ 2024 S01PID19_OxySensor6_STFT S01PID 25-25;
SG_MUL_VAL_ 2024 S01PID1A_OxySensor7_Volt S01PID 26-26;
SG_MUL_VAL_ 2024 S01PID1A_OxySensor7_STFT S01PID 26-26;
SG_MUL_VAL_ 2024 S01PID1B_OxySensor8_Volt S01PID 27-27;
SG_MUL_VAL_ 2024 S01PID1B_OxySensor8_STFT S01PID 27-27;
SG_MUL_VAL_ 2024 S01PID1C_OBDStandard S01PID 28-28;
SG_MUL_VAL_ 2024 S01PID1F_TimeSinceEngStart S01PID 31-31;
SG_MUL_VAL_ 2024 S01PID21_DistanceMILOn S01PID 33-33;
SG_MUL_VAL_ 2024 S01PID22_FuelRailPres S01PID 34-34;
SG_MUL_VAL_ 2024 S01PID23_FuelRailGaug S01PID 35-35;
SG_MUL_VAL_ 2024 S01PID24_OxySensor1_FAER S01PID 36-36;
SG_MUL_VAL_ 2024 S01PID24_OxySensor1_Volt S01PID 36-36;
SG_MUL_VAL_ 2024 S01PID25_OxySensor2_FAER S01PID 37-37;
SG_MUL_VAL_ 2024 S01PID25_OxySensor2_Volt S01PID 37-37;
SG_MUL_VAL_ 2024 S01PID26_OxySensor3_FAER S01PID 38-38;
SG_MUL_VAL_ 2024 S01PID26_OxySensor3_Volt S01PID 38-38;
SG_MUL_VAL_ 2024 S01PID27_OxySensor4_FAER S01PID 39-39;
SG_MUL_VAL_ 2024 S01PID27_OxySensor4_Volt S01PID 39-39;
SG_MUL_VAL_ 2024 S01PID28_OxySensor5_FAER S01PID 40-40;
SG_MUL_VAL_ 2024 S01PID28_OxySensor5_Volt S01PID 40-40;
SG_MUL_VAL_ 2024 S01PID29_OxySensor6_FAER S01PID 41-41;
SG_MUL_VAL_ 2024 S01PID29_OxySensor6_Volt S01PID 41-41;
SG_MUL_VAL_ 2024 S01PID2A_OxySensor7_FAER S01PID 42-42;
SG_MUL_VAL_ 2024 S01PID2A_OxySensor7_Volt S01PID 42-42;
SG_MUL_VAL_ 2024 S01PID2B_OxySensor8_FAER S01PID 43-43;
SG_MUL_VAL_ 2024 S01PID2B_OxySensor8_Volt S01PID 43-43;
SG_MUL_VAL_ 2024 S01PID2C_CmdEGR S01PID 44-44;
SG_MUL_VAL_ 2024 S01PID2D_EGRError S01PID 45-45;
SG_MUL_VAL_ 2024 S01PID2E_CmdEvapPurge S01PID 46-46;
SG_MUL_VAL_ 2024 S01PID2F_FuelTankLevel S01PID 47-47;
SG_MUL_VAL_ 2024 S01PID30_WaUpsSinceCodeClear S01PID 48-48;
SG_MUL_VAL_ 2024 S01PID31_DistSinceCodeClear S01PID 49-49;
SG_MUL_VAL_ 2024 S01PID32_EvapSysVaporPres S01PID 50-50;
SG_MUL_VAL_ 2024 S01PID33_AbsBaroPres S01PID 51-51;
SG_MUL_VAL_ 2024 S01PID34_OxySensor1_FAER S01PID 52-52;
SG_MUL_VAL_ 2024 S01PID34_OxySensor1_Crnt S01PID 52-52;
SG_MUL_VAL_ 2024 S01PID35_OxySensor2_FAER S01PID 53-53;
SG_MUL_VAL_ 2024 S01PID35_OxySensor2_Crnt S01PID 53-53;
SG_MUL_VAL_ 2024 S01PID36_OxySensor3_FAER S01PID 54-54;
SG_MUL_VAL_ 2024 S01PID36_OxySensor3_Crnt S01PID 54-54;
SG_MUL_VAL_ 2024 S01PID37_OxySensor4_FAER S01PID 55-55;
SG_MUL_VAL_ 2024 S01PID37_OxySensor4_Crnt S01PID 55-55;
SG_MUL_VAL_ 2024 S01PID38_OxySensor5_FAER S01PID 56-56;
SG_MUL_VAL_ 2024 S01PID38_OxySensor5_Crnt S01PID 56-56;
SG_MUL_VAL_ 2024 S01PID39_OxySensor6_FAER S01PID 57-57;
SG_MUL_VAL_ 2024 S01PID39_OxySensor6_Crnt S01PID 57-57;
SG_MUL_VAL_ 2024 S01PID3A_OxySensor7_FAER S01PID 58-58;
SG_MUL_VAL_ 2024 S01PID3A_OxySensor7_Crnt S01PID 58-58;
SG_MUL_VAL_ 2024 S01PID3B_OxySensor8_FAER S01PID 59-59;
SG_MUL_VAL_ 2024 S01PID3B_OxySensor8_Crnt S01PID 59-59;
SG_MUL_VAL_ 2024 S01PID3C_CatTempBank1Sens1 S01PID 60-60;
SG_MUL_VAL_ 2024 S01PID3D_CatTempBank2Sens1 S01PID 61-61;
SG_MUL_VAL_ 2024 S01PID3E_CatTempBank1Sens2 S01PID 62-62;
SG_MUL_VAL_ 2024 S01PID3F_CatTempBank2Sens2 S01PID 63-63;
SG_MUL_VAL_ 2024 S01PID41_MonStatusDriveCycle S01PID 65-65;
SG_MUL_VAL_ 2024 S01PID42_ControlModuleVolt S01PID 66-66;
SG_MUL_VAL_ 2024 S01PID43_AbsLoadValue S01PID 67-67;
SG_MUL_VAL_ 2024 S01PID44_FuelAirCmdEquiv S01PID 68-68;
SG_MUL_VAL_ 2024 S01PID45_RelThrottlePos S01PID 69-69;
SG_MUL_VAL_ 2024 S01PID46_AmbientAirTemp S01PID 70-70;
SG_MUL_VAL_ 2024 S01PID47_AbsThrottlePosB S01PID 71-71;
SG_MUL_VAL_ 2024 S01PID48_AbsThrottlePosC S01PID 72-72;
SG_MUL_VAL_ 2024 S01PID49_AbsThrottlePosD S01PID 73-73;
SG_MUL_VAL_ 2024 S01PID4A_AbsThrottlePosE S01PID 74-74;
SG_MUL_VAL_ 2024 S01PID4B_AbsThrottlePosF S01PID 75-75;
SG_MUL_VAL_ 2024 S01PID4C_CmdThrottleAct S01PID 76-76;
SG_MUL_VAL_ 2024 S01PID4D_TimeRunMILOn S01PID 77-77;
SG_MUL_VAL_ 2024 S01PID4E_TimeSinceCodeClear S01PID 78-78;
SG_MUL_VAL_ 2024 S01PID4F_Max_FAER S01PID 79-79;
SG_MUL_VAL_ 2024 S01PID4F_Max_OxySensVol S01PID 79-79;
SG_MUL_VAL_ 2024 S01PID4F_Max_OxySensCrnt S01PID 79-79;
SG_MUL_VAL_ 2024 S01PID4F_Max_IntManiAbsPres S01PID 79-79;
SG_MUL_VAL_ 2024 S01PID50_Max_AirFlowMAF S01PID 80-80;
SG_MUL_VAL_ 2024 S01PID51_FuelType S01PID 81-81;
SG_MUL_VAL_ 2024 S01PID52_EthanolFuelPct S01PID 82-82;
SG_MUL_VAL_ 2024 S01PID53_AbsEvapSysVapPres S01PID 83-83;
SG_MUL_VAL_ 2024 S01PID54_EvapSysVapPres S01PID 84-84;
SG_MUL_VAL_ 2024 S01PID55_ShortSecOxyTrimBank1 S01PID 85-85;
SG_MUL_VAL_ 2024 S01PID55_ShortSecOxyTrimBank3 S01PID 85-85;
SG_MUL_VAL_ 2024 S01PID56_LongSecOxyTrimBank1 S01PID 86-86;
SG_MUL_VAL_ 2024 S01PID56_LongSecOxyTrimBank3 S01PID 86-86;
SG_MUL_VAL_ 2024 S01PID57_ShortSecOxyTrimBank2 S01PID 87-87;
SG_MUL_VAL_ 2024 S01PID57_ShortSecOxyTrimBank4 S01PID 87-87;
SG_MUL_VAL_ 2024 S01PID58_LongSecOxyTrimBank2 S01PID 88-88;
SG_MUL_VAL_ 2024 S01PID58_LongSecOxyTrimBank4 S01PID 88-88;
SG_MUL_VAL_ 2024 S01PID59_FuelRailAbsPres S01PID 89-89;
SG_MUL_VAL_ 2024 S01PID5A_RelAccelPedalPos S01PID 90-90;
SG_MUL_VAL_ 2024 S01PID5B_HybrBatPackRemLife S01PID 91-91;
SG_MUL_VAL_ 2024 S01PID5C_EngineOilTemp S01PID 92-92;
SG_MUL_VAL_ 2024 S01PID5D_FuelInjectionTiming S01PID 93-93;
SG_MUL_VAL_ 2024 S01PID5E_EngineFuelRate S01PID 94-94;
SG_MUL_VAL_ 2024 S01PID5F_EmissionReq S01PID 95-95;
SG_MUL_VAL_ 2024 S01PID61_DemandEngTorqPct S01PID 97-97;
SG_MUL_VAL_ 2024 S01PID62_ActualEngTorqPct S01PID 98-98;
SG_MUL_VAL_ 2024 S01PID63_EngRefTorq S01PID 99-99;
SG_MUL_VAL_ 2024 S01PID65_AuxInputOutput S01PID 101-101;
SG_MUL_VAL_ 2024 S01PID66_MAFSensor S01PID 102-102;
SG_MUL_VAL_ 2024 S01PID67_EngineCoolantTemp S01PID 103-103;
SG_MUL_VAL_ 2024 S01PID68_IntakeAirTempSens S01PID 104-104;
SG_MUL_VAL_ 2024 S01PID69_CmdEGR_EGRError S01PID 105-105;
SG_MUL_VAL_ 2024 S01PID6A_CmdDieselIntAir S01PID 106-106;
SG_MUL_VAL_ 2024 S01PID6B_ExhaustGasTemp S01PID 107-107;
SG_MUL_VAL_ 2024 S01PID6C_CmdThrottleActRel S01PID 108-108;
SG_MUL_VAL_ 2024 S01PID6D_FuelPresContrSys S01PID 109-109;
SG_MUL_VAL_ 2024 S01PID6E_InjPresContrSys S01PID 110-110;
SG_MUL_VAL_ 2024 S01PID6F_TurboComprPres S01PID 111-111;
SG_MUL_VAL_ 2024 S01PID70_BoostPresCntrl S01PID 112-112;
SG_MUL_VAL_ 2024 S01PID8E_EngFrictionPctTorq S01PID 142-142;
SG_MUL_VAL_ 2024 S01PIDA6_Odometer S01PID 166-166;
SG_MUL_VAL_ 2024 S02PID02_FreezeDTC S02PID 2-2;
SG_MUL_VAL_ 2024 S01PID S 1-1;
SG_MUL_VAL_ 2024 S02PID S 2-2;
SG_MUL_VAL_ 2024 SUP_S01PID01_MonitorStatus S01PID 0-0;
SG_MUL_VAL_ 2024 SUP_S01PID02_FreezeDTC S01PID 0-0;
SG_MUL_VAL_ 2024 SUP_S01PID03_FuelSystemStatus S01PID 0-0;
SG_MUL_VAL_ 2024 SUP_S01PID04_CalcEngineLoad S01PID 0-0;
SG_MUL_VAL_ 2024 SUP_S01PID05_EngineCoolantTemp S01PID 0-0;
SG_MUL_VAL_ 2024 SUP_S01PID06_ShortFuelTrimBank1 S01PID 0-0;
SG_MUL_VAL_ 2024 SUP_S01PID07_LongFuelTrimBank1 S01PID 0-0;
SG_MUL_VAL_ 2024 SUP_S01PID08_ShortFuelTrimBank2 S01PID 0-0;
SG_MUL_VAL_ 2024 SUP_S01PID09_LongFuelTrimBank2 S01PID 0-0;
SG_MUL_VAL_ 2024 SUP_S01PID0A_FuelPressure S01PID 0-0;
SG_MUL_VAL_ 2024 SUP_S01PID0B_IntakeManiAbsPress S01PID 0-0;
SG_MUL_VAL_ 2024 SUP_S01PID0C_EngineRPM S01PID 0-0;
SG_MUL_VAL_ 2024 SUP_S01PID0D_VehicleSpeed S01PID 0-0;
SG_MUL_VAL_ 2024 SUP_S01PID0E_TimingAdvance S01PID 0-0;
SG_MUL_VAL_ 2024 SUP_S01PID0F_IntakeAirTemperatur S01PID 0-0;
SG_MUL_VAL_ 2024 SUP_S01PID10_MAFAirFlowRate S01PID 0-0;
SG_MUL_VAL_ 2024 SUP_S01PID11_ThrottlePosition S01PID 0-0;
SG_MUL_VAL_ 2024 SUP_S01PID12_CmdSecAirStatus S01PID 0-0;
SG_MUL_VAL_ 2024 SUP_S01PID14_OxySensor1_Volt S01PID 0-0;
SG_MUL_VAL_ 2024 SUP_S01PID15_OxySensor2_Volt S01PID 0-0;
SG_MUL_VAL_ 2024 SUP_S01PID16_OxySensor3_Volt S01PID 0-0;
SG_MUL_VAL_ 2024 SUP_S01PID17_OxySensor4_Volt S01PID 0-0;
SG_MUL_VAL_ 2024 SUP_S01PID18_OxySensor5_Volt S01PID 0-0;
SG_MUL_VAL_ 2024 SUP_S01PID19_OxySensor6_Volt S01PID 0-0;
SG_MUL_VAL_ 2024 SUP_S01PID1A_OxySensor7_Volt S01PID 0-0;
SG_MUL_VAL_ 2024 SUP_S01PID1B_OxySensor8_Volt S01PID 0-0;
SG_MUL_VAL_ 2024 SUP_S01PID1C_OBDStandard S01PID 0-0;
SG_MUL_VAL_ 2024 SUP_S01PID1F_TimeSinceEngStart S01PID 0-0;
SG_MUL_VAL_ 2024 SUP_S01PID21_DistanceMILOn S01PID 32-32;
SG_MUL_VAL_ 2024 SUP_S01PID22_FuelRailPres S01PID 32-32;
SG_MUL_VAL_ 2024 SUP_S01PID23_FuelRailGaug S01PID 32-32;
SG_MUL_VAL_ 2024 SUP_S01PID24_OxySensor1_FAER S01PID 32-32;
SG_MUL_VAL_ 2024 SUP_S01PID25_OxySensor2_FAER S01PID 32-32;
SG_MUL_VAL_ 2024 SUP_S01PID26_OxySensor3_FAER S01PID 32-32;
SG_MUL_VAL_ 2024 SUP_S01PID27_OxySensor4_FAER S01PID 32-32;
SG_MUL_VAL_ 2024 SUP_S01PID28_OxySensor5_FAER S01PID 32-32;
SG_MUL_VAL_ 2024 SUP_S01PID29_OxySensor6_FAER S01PID 32-32;
SG_MUL_VAL_ 2024 SUP_S01PID2A_OxySensor7_FAER S01PID 32-32;
SG_MUL_VAL_ 2024 SUP_S01PID2B_OxySensor8_FAER S01PID 32-32;
SG_MUL_VAL_ 2024 SUP_S01PID2C_CmdEGR S01PID 32-32;
SG_MUL_VAL_ 2024 SUP_S01PID2D_EGRError S01PID 32-32;
SG_MUL_VAL_ 2024 SUP_S01PID2E_CmdEvapPurge S01PID 32-32;
SG_MUL_VAL_ 2024 SUP_S01PID2F_FuelTankLevel S01PID 32-32;
SG_MUL_VAL_ 2024 SUP_S01PID30_WaUpsSinceCodeClear S01PID 32-32;
SG_MUL_VAL_ 2024 SUP_S01PID31_DistSinceCodeClear S01PID 32-32;
SG_MUL_VAL_ 2024 SUP_S01PID32_EvapSysVaporPres S01PID 32-32;
SG_MUL_VAL_ 2024 SUP_S01PID33_AbsBaroPres S01PID 32-32;
SG_MUL_VAL_ 2024 SUP_S01PID34_OxySensor1_FAER S01PID 32-32;
SG_MUL_VAL_ 2024 SUP_S01PID35_OxySensor2_FAER S01PID 32-32;
SG_MUL_VAL_ 2024 SUP_S01PID36_OxySensor3_FAER S01PID 32-32;
SG_MUL_VAL_ 2024 SUP_S01PID37_OxySensor4_FAER S01PID 32-32;
SG_MUL_VAL_ 2024 SUP_S01PID38_OxySensor5_FAER S01PID 32-32;
SG_MUL_VAL_ 2024 SUP_S01PID39_OxySensor6_FAER S01PID 32-32;
SG_MUL_VAL_ 2024 SUP_S01PID3A_OxySensor7_FAER S01PID 32-32;
SG_MUL_VAL_ 2024 SUP_S01PID3B_OxySensor8_FAER S01PID 32-32;
SG_MUL_VAL_ 2024 SUP_S01PID3C_CatTempBank1Sens1 S01PID 32-32;
SG_MUL_VAL_ 2024 SUP_S01PID3D_CatTempBank2Sens1 S01PID 32-32;
SG_MUL_VAL_ 2024 SUP_S01PID3E_CatTempBank1Sens2 S01PID 32-32;
SG_MUL_VAL_ 2024 SUP_S01PID3F_CatTempBank2Sens2 S01PID 32-32;
SG_MUL_VAL_ 2024 SUP_S01PID41_MonStatusDriveCycle S01PID 64-64;
SG_MUL_VAL_ 2024 SUP_S01PID42_ControlModuleVolt S01PID 64-64;
SG_MUL_VAL_ 2024 SUP_S01PID43_AbsLoadValue S01PID 64-64;
SG_MUL_VAL_ 2024 SUP_S01PID44_FuelAirCmdEquiv S01PID 64-64;
SG_MUL_VAL_ 2024 SUP_S01PID45_RelThrottlePos S01PID 64-64;
SG_MUL_VAL_ 2024 SUP_S01PID46_AmbientAirTemp S01PID 64-64;
SG_MUL_VAL_ 2024 SUP_S01PID47_AbsThrottlePosB S01PID 64-64;
SG_MUL_VAL_ 2024 SUP_S01PID48_AbsThrottlePosC S01PID 64-64;
SG_MUL_VAL_ 2024 SUP_S01PID49_AbsThrottlePosD S01PID 64-64;
SG_MUL_VAL_ 2024 SUP_S01PID4A_AbsThrottlePosE S01PID 64-64;
SG_MUL_VAL_ 2024 SUP_S01PID4B_AbsThrottlePosF S01PID 64-64;
SG_MUL_VAL_ 2024 SUP_S01PID4C_CmdThrottleAct S01PID 64-64;
SG_MUL_VAL_ 2024 SUP_S01PID4D_TimeRunMILOn S01PID 64-64;
SG_MUL_VAL_ 2024 SUP_S01PID4E_TimeSinceCodeClear S01PID 64-64;
SG_MUL_VAL_ 2024 SUP_S01PID4F_Max_FAER S01PID 64-64;
SG_MUL_VAL_ 2024 SUP_S01PID50_Max_AirFlowMAF S01PID 64-64;
SG_MUL_VAL_ 2024 SUP_S01PID51_FuelType S01PID 64-64;
SG_MUL_VAL_ 2024 SUP_S01PID52_EthanolFuelPct S01PID 64-64;
SG_MUL_VAL_ 2024 SUP_S01PID53_AbsEvapSysVapPres S01PID 64-64;
SG_MUL_VAL_ 2024 SUP_S01PID54_EvapSysVapPres S01PID 64-64;
SG_MUL_VAL_ 2024 SUP_S01PID55_ShortSecOxyTrimBank S01PID 64-64;
SG_MUL_VAL_ 2024 SUP_S01PID56_LongSecOxyTrimBank1 S01PID 64-64;
SG_MUL_VAL_ 2024 SUP_S01PID57_ShortSecOxyTrimBank S01PID 64-64;
SG_MUL_VAL_ 2024 SUP_S01PID58_LongSecOxyTrimBank2 S01PID 64-64;
SG_MUL_VAL_ 2024 SUP_S01PID59_FuelRailAbsPres S01PID 64-64;
SG_MUL_VAL_ 2024 SUP_S01PID5A_RelAccelPedalPos S01PID 64-64;
SG_MUL_VAL_ 2024 SUP_S01PID5B_HybrBatPackRemLife S01PID 64-64;
SG_MUL_VAL_ 2024 SUP_S01PID5C_EngineOilTemp S01PID 64-64;
SG_MUL_VAL_ 2024 SUP_S01PID5D_FuelInjectionTiming S01PID 64-64;
SG_MUL_VAL_ 2024 SUP_S01PID5E_EngineFuelRate S01PID 64-64;
SG_MUL_VAL_ 2024 SUP_S01PID5F_EmissionReq S01PID 64-64;
SG_MUL_VAL_ 2024 SUP_S01PID61_DemandEngTorqPct S01PID 96-96;
SG_MUL_VAL_ 2024 SUP_S01PID62_ActualEngTorqPct S01PID 96-96;
SG_MUL_VAL_ 2024 SUP_S01PID63_EngRefTorq S01PID 96-96;
SG_MUL_VAL_ 2024 SUP_S01PID64_EngPctTorq_Idle S01PID 96-96;
SG_MUL_VAL_ 2024 SUP_S01PID65_AuxInputOutput S01PID 96-96;
SG_MUL_VAL_ 2024 SUP_S01PID66_MAFSensor S01PID 96-96;
SG_MUL_VAL_ 2024 SUP_S01PID67_EngineCoolantTemp S01PID 96-96;
SG_MUL_VAL_ 2024 SUP_S01PID68_IntakeAirTempSens S01PID 96-96;
SG_MUL_VAL_ 2024 SUP_S01PID69_CmdEGR_EGRError S01PID 96-96;
SG_MUL_VAL_ 2024 SUP_S01PID6A_CmdDieselIntAir S01PID 96-96;
SG_MUL_VAL_ 2024 SUP_S01PID6B_ExhaustGasTemp S01PID 96-96;
SG_MUL_VAL_ 2024 SUP_S01PID6C_CmdThrottleActRel S01PID 96-96;
SG_MUL_VAL_ 2024 SUP_S01PID6D_FuelPresContrSys S01PID 96-96;
SG_MUL_VAL_ 2024 SUP_S01PID6E_InjPresContrSys S01PID 96-96;
SG_MUL_VAL_ 2024 SUP_S01PID6F_TurboComprPres S01PID 96-96;
SG_MUL_VAL_ 2024 SUP_S01PID70_BoostPresCntrl S01PID 96-96;
SG_MUL_VAL_ 2024 SUP_S01PID78_Bank1EGT1 S01PID 96-96;
SG_MUL_VAL_ 2024 SUP_S01PID79_Bank2EGT1 S01PID 96-96;
SG_MUL_VAL_ 2024 SUP_S01PID8E_EngFrictionPctTorq S01PID 128-128;
SG_MUL_VAL_ 2024 SUP_S01PIDA6_Odometer S01PID 160-160;
SG_MUL_VAL_ 2015 S01PID01_MonitorStatus S01PID 1-1;
SG_MUL_VAL_ 2015 S01PID02_FreezeDTC S01PID 2-2;
SG_MUL_VAL_ 2015 S01PID03_FuelSystemStatus S01PID 3-3;
SG_MUL_VAL_ 2015 S01PID04_CalcEngineLoad S01PID 4-4;
SG_MUL_VAL_ 2015 S01PID05_EngineCoolantTemp S01PID 5-5;
SG_MUL_VAL_ 2015 S01PID06_ShortFuelTrimBank1 S01PID 6-6;
SG_MUL_VAL_ 2015 S01PID07_LongFuelTrimBank1 S01PID 7-7;
SG_MUL_VAL_ 2015 S01PID08_ShortFuelTrimBank2 S01PID 8-8;
SG_MUL_VAL_ 2015 S01PID09_LongFuelTrimBank2 S01PID 9-9;
SG_MUL_VAL_ 2015 S01PID0A_FuelPressure S01PID 10-10;
SG_MUL_VAL_ 2015 S01PID0B_IntakeManiAbsPress S01PID 11-11;
SG_MUL_VAL_ 2015 S01PID0C_EngineRPM S01PID 12-12;
SG_MUL_VAL_ 2015 S01PID0D_VehicleSpeed S01PID 13-13;
SG_MUL_VAL_ 2015 S01PID0E_TimingAdvance S01PID 14-14;
SG_MUL_VAL_ 2015 S01PID0F_IntakeAirTemperature S01PID 15-15;
SG_MUL_VAL_ 2015 S01PID10_MAFAirFlowRate S01PID 16-16;
SG_MUL_VAL_ 2015 S01PID11_ThrottlePosition S01PID 17-17;
SG_MUL_VAL_ 2015 S01PID12_CmdSecAirStatus S01PID 18-18;
SG_MUL_VAL_ 2015 S01PID14_OxySensor1_Volt S01PID 20-20;
SG_MUL_VAL_ 2015 S01PID14_OxySensor1_STFT S01PID 20-20;
SG_MUL_VAL_ 2015 S01PID15_OxySensor2_Volt S01PID 21-21;
SG_MUL_VAL_ 2015 S01PID15_OxySensor2_STFT S01PID 21-21;
SG_MUL_VAL_ 2015 S01PID16_OxySensor3_Volt S01PID 22-22;
SG_MUL_VAL_ 2015 S01PID16_OxySensor3_STFT S01PID 22-22;
SG_MUL_VAL_ 2015 S01PID17_OxySensor4_Volt S01PID 23-23;
SG_MUL_VAL_ 2015 S01PID17_OxySensor4_STFT S01PID 23-23;
SG_MUL_VAL_ 2015 S01PID18_OxySensor5_Volt S01PID 24-24;
SG_MUL_VAL_ 2015 S01PID18_OxySensor5_STFT S01PID 24-24;
SG_MUL_VAL_ 2015 S01PID19_OxySensor6_Volt S01PID 25-25;
SG_MUL_VAL_ 2015 S01PID19_OxySensor6_STFT S01PID 25-25;
SG_MUL_VAL_ 2015 S01PID1A_OxySensor7_Volt S01PID 26-26;
SG_MUL_VAL_ 2015 S01PID1A_OxySensor7_STFT S01PID 26-26;
SG_MUL_VAL_ 2015 S01PID1B_OxySensor8_Volt S01PID 27-27;
SG_MUL_VAL_ 2015 S01PID1B_OxySensor8_STFT S01PID 27-27;
SG_MUL_VAL_ 2015 S01PID1C_OBDStandard S01PID 28-28;
SG_MUL_VAL_ 2015 S01PID1F_TimeSinceEngStart S01PID 31-31;
SG_MUL_VAL_ 2015 S01PID21_DistanceMILOn S01PID 33-33;
SG_MUL_VAL_ 2015 S01PID22_FuelRailPres S01PID 34-34;
SG_MUL_VAL_ 2015 S01PID23_FuelRailGaug S01PID 35-35;
SG_MUL_VAL_ 2015 S01PID24_OxySensor1_FAER S01PID 36-36;
SG_MUL_VAL_ 2015 S01PID24_OxySensor1_Volt S01PID 36-36;
SG_MUL_VAL_ 2015 S01PID25_OxySensor2_FAER S01PID 37-37;
SG_MUL_VAL_ 2015 S01PID25_OxySensor2_Volt S01PID 37-37;
SG_MUL_VAL_ 2015 S01PID26_OxySensor3_FAER S01PID 38-38;
SG_MUL_VAL_ 2015 S01PID26_OxySensor3_Volt S01PID 38-38;
SG_MUL_VAL_ 2015 S01PID27_OxySensor4_FAER S01PID 39-39;
SG_MUL_VAL_ 2015 S01PID27_OxySensor4_Volt S01PID 39-39;
SG_MUL_VAL_ 2015 S01PID28_OxySensor5_FAER S01PID 40-40;
SG_MUL_VAL_ 2015 S01PID28_OxySensor5_Volt S01PID 40-40;
SG_MUL_VAL_ 2015 S01PID29_OxySensor6_FAER S01PID 41-41;
SG_MUL_VAL_ 2015 S01PID29_OxySensor6_Volt S01PID 41-41;
SG_MUL_VAL_ 2015 S01PID2A_OxySensor7_FAER S01PID 42-42;
SG_MUL_VAL_ 2015 S01PID2A_OxySensor7_Volt S01PID 42-42;
SG_MUL_VAL_ 2015 S01PID2B_OxySensor8_FAER S01PID 43-43;
SG_MUL_VAL_ 2015 S01PID2B_OxySensor8_Volt S01PID 43-43;
SG_MUL_VAL_ 2015 S01PID2C_CmdEGR S01PID 44-44;
SG_MUL_VAL_ 2015 S01PID2D_EGRError S01PID 45-45;
SG_MUL_VAL_ 2015 S01PID2E_CmdEvapPurge S01PID 46-46;
SG_MUL_VAL_ 2015 S01PID2F_FuelTankLevel S01PID 47-47;
SG_MUL_VAL_ 2015 S01PID30_WaUpsSinceCodeClear S01PID 48-48;
SG_MUL_VAL_ 2015 S01PID31_DistSinceCodeClear S01PID 49-49;
SG_MUL_VAL_ 2015 S01PID32_EvapSysVaporPres S01PID 50-50;
SG_MUL_VAL_ 2015 S01PID33_AbsBaroPres S01PID 51-51;
SG_MUL_VAL_ 2015 S01PID34_OxySensor1_FAER S01PID 52-52;
SG_MUL_VAL_ 2015 S01PID34_OxySensor1_Crnt S01PID 52-52;
SG_MUL_VAL_ 2015 S01PID35_OxySensor2_FAER S01PID 53-53;
SG_MUL_VAL_ 2015 S01PID35_OxySensor2_Crnt S01PID 53-53;
SG_MUL_VAL_ 2015 S01PID36_OxySensor3_FAER S01PID 54-54;
SG_MUL_VAL_ 2015 S01PID36_OxySensor3_Crnt S01PID 54-54;
SG_MUL_VAL_ 2015 S01PID37_OxySensor4_FAER S01PID 55-55;
SG_MUL_VAL_ 2015 S01PID37_OxySensor4_Crnt S01PID 55-55;
SG_MUL_VAL_ 2015 S01PID38_OxySensor5_FAER S01PID 56-56;
SG_MUL_VAL_ 2015 S01PID38_OxySensor5_Crnt S01PID 56-56;
SG_MUL_VAL_ 2015 S01PID39_OxySensor6_FAER S01PID 57-57;
SG_MUL_VAL_ 2015 S01PID39_OxySensor6_Crnt S01PID 57-57;
SG_MUL_VAL_ 2015 S01PID3A_OxySensor7_FAER S01PID 58-58;
SG_MUL_VAL_ 2015 S01PID3A_OxySensor7_Crnt S01PID 58-58;
SG_MUL_VAL_ 2015 S01PID3B_OxySensor8_FAER S01PID 59-59;
SG_MUL_VAL_ 2015 S01PID3B_OxySensor8_Crnt S01PID 59-59;
SG_MUL_VAL_ 2015 S01PID3C_CatTempBank1Sens1 S01PID 60-60;
SG_MUL_VAL_ 2015 S01PID3D_CatTempBank2Sens1 S01PID 61-61;
SG_MUL_VAL_ 2015 S01PID3E_CatTempBank1Sens2 S01PID 62-62;
SG_MUL_VAL_ 2015 S01PID3F_CatTempBank2Sens2 S01PID 63-63;
SG_MUL_VAL_ 2015 S01PID41_MonStatusDriveCycle S01PID 65-65;
SG_MUL_VAL_ 2015 S01PID42_ControlModuleVolt S01PID 66-66;
SG_MUL_VAL_ 2015 S01PID43_AbsLoadValue S01PID 67-67;
SG_MUL_VAL_ 2015 S01PID44_FuelAirCmdEquiv S01PID 68-68;
SG_MUL_VAL_ 2015 S01PID45_RelThrottlePos S01PID 69-69;
SG_MUL_VAL_ 2015 S01PID46_AmbientAirTemp S01PID 70-70;
SG_MUL_VAL_ 2015 S01PID47_AbsThrottlePosB S01PID 71-71;
SG_MUL_VAL_ 2015 S01PID48_AbsThrottlePosC S01PID 72-72;
SG_MUL_VAL_ 2015 S01PID49_AbsThrottlePosD S01PID 73-73;
SG_MUL_VAL_ 2015 S01PID4A_AbsThrottlePosE S01PID 74-74;
SG_MUL_VAL_ 2015 S01PID4B_AbsThrottlePosF S01PID 75-75;
SG_MUL_VAL_ 2015 S01PID4C_CmdThrottleAct S01PID 76-76;
SG_MUL_VAL_ 2015 S01PID4D_TimeRunMILOn S01PID 77-77;
SG_MUL_VAL_ 2015 S01PID4E_TimeSinceCodeClear S01PID 78-78;
SG_MUL_VAL_ 2015 S01PID4F_Max_FAER S01PID 79-79;
SG_MUL_VAL_ 2015 S01PID4F_Max_OxySensVol S01PID 79-79;
SG_MUL_VAL_ 2015 S01PID4F_Max_OxySensCrnt S01PID 79-79;
SG_MUL_VAL_ 2015 S01PID4F_Max_IntManiAbsPres S01PID 79-79;
SG_MUL_VAL_ 2015 S01PID50_Max_AirFlowMAF S01PID 80-80;
SG_MUL_VAL_ 2015 S01PID51_FuelType S01PID 81-81;
SG_MUL_VAL_ 2015 S01PID52_EthanolFuelPct S01PID 82-82;
SG_MUL_VAL_ 2015 S01PID53_AbsEvapSysVapPres S01PID 83-83;
SG_MUL_VAL_ 2015 S01PID54_EvapSysVapPres S01PID 84-84;
SG_MUL_VAL_ 2015 S01PID55_ShortSecOxyTrimBank1 S01PID 85-85;
SG_MUL_VAL_ 2015 S01PID55_ShortSecOxyTrimBank3 S01PID 85-85;
SG_MUL_VAL_ 2015 S01PID56_LongSecOxyTrimBank1 S01PID 86-86;
SG_MUL_VAL_ 2015 S01PID56_LongSecOxyTrimBank3 S01PID 86-86;
SG_MUL_VAL_ 2015 S01PID57_ShortSecOxyTrimBank2 S01PID 87-87;
SG_MUL_VAL_ 2015 S01PID57_ShortSecOxyTrimBank4 S01PID 87-87;
SG_MUL_VAL_ 2015 S01PID58_LongSecOxyTrimBank2 S01PID 88-88;
SG_MUL_VAL_ 2015 S01PID58_LongSecOxyTrimBank4 S01PID 88-88;
SG_MUL_VAL_ 2015 S01PID59_FuelRailAbsPres S01PID 89-89;
SG_MUL_VAL_ 2015 S01PID5A_RelAccelPedalPos S01PID 90-90;
SG_MUL_VAL_ 2015 S01PID5B_HybrBatPackRemLife S01PID 91-91;
SG_MUL_VAL_ 2015 S01PID5C_EngineOilTemp S01PID 92-92;
SG_MUL_VAL_ 2015 S01PID5D_FuelInjectionTiming S01PID 93-93;
SG_MUL_VAL_ 2015 S01PID5E_EngineFuelRate S01PID 94-94;
SG_MUL_VAL_ 2015 S01PID5F_EmissionReq S01PID 95-95;
SG_MUL_VAL_ 2015 S01PID61_DemandEngTorqPct S01PID 97-97;
SG_MUL_VAL_ 2015 S01PID62_ActualEngTorqPct S01PID 98-98;
SG_MUL_VAL_ 2015 S01PID63_EngRefTorq S01PID 99-99;
SG_MUL_VAL_ 2015 S01PID65_AuxInputOutput S01PID 101-101;
SG_MUL_VAL_ 2015 S01PID66_MAFSensor S01PID 102-102;
SG_MUL_VAL_ 2015 S01PID67_EngineCoolantTemp S01PID 103-103;
SG_MUL_VAL_ 2015 S01PID68_IntakeAirTempSens S01PID 104-104;
SG_MUL_VAL_ 2015 S01PID69_CmdEGR_EGRError S01PID 105-105;
SG_MUL_VAL_ 2015 S01PID6A_CmdDieselIntAir S01PID 106-106;
SG_MUL_VAL_ 2015 S01PID6B_ExhaustGasTemp S01PID 107-107;
SG_MUL_VAL_ 2015 S01PID6C_CmdThrottleActRel S01PID 108-108;
SG_MUL_VAL_ 2015 S01PID6D_FuelPresContrSys S01PID 109-109;
SG_MUL_VAL_ 2015 S01PID6E_InjPresContrSys S01PID 110-110;
SG_MUL_VAL_ 2015 S01PID6F_TurboComprPres S01PID 111-111;
SG_MUL_VAL_ 2015 S01PID70_BoostPresCntrl S01PID 112-112;
SG_MUL_VAL_ 2015 S01PID8E_EngFrictionPctTorq S01PID 142-142;
SG_MUL_VAL_ 2015 S01PIDA6_Odometer S01PID 166-166;
SG_MUL_VAL_ 2015 S01PID S 1-1;
SG_MUL_VAL_ 2564485397 S01PID01_MonitorStatus S01PID 1-1;
SG_MUL_VAL_ 2564485397 S01PID02_FreezeDTC S01PID 2-2;
SG_MUL_VAL_ 2564485397 S01PID03_FuelSystemStatus S01PID 3-3;
SG_MUL_VAL_ 2564485397 S01PID04_CalcEngineLoad S01PID 4-4;
SG_MUL_VAL_ 2564485397 S01PID05_EngineCoolantTemp S01PID 5-5;
SG_MUL_VAL_ 2564485397 S01PID06_ShortFuelTrimBank1 S01PID 6-6;
SG_MUL_VAL_ 2564485397 S01PID07_LongFuelTrimBank1 S01PID 7-7;
SG_MUL_VAL_ 2564485397 S01PID08_ShortFuelTrimBank2 S01PID 8-8;
SG_MUL_VAL_ 2564485397 S01PID09_LongFuelTrimBank2 S01PID 9-9;
SG_MUL_VAL_ 2564485397 S01PID0A_FuelPressure S01PID 10-10;
SG_MUL_VAL_ 2564485397 S01PID0B_IntakeManiAbsPress S01PID 11-11;
SG_MUL_VAL_ 2564485397 S01PID0C_EngineRPM S01PID 12-12;
SG_MUL_VAL_ 2564485397 S01PID0D_VehicleSpeed S01PID 13-13;
SG_MUL_VAL_ 2564485397 S01PID0E_TimingAdvance S01PID 14-14;
SG_MUL_VAL_ 2564485397 S01PID0F_IntakeAirTemperature S01PID 15-15;
SG_MUL_VAL_ 2564485397 S01PID10_MAFAirFlowRate S01PID 16-16;
SG_MUL_VAL_ 2564485397 S01PID11_ThrottlePosition S01PID 17-17;
SG_MUL_VAL_ 2564485397 S01PID12_CmdSecAirStatus S01PID 18-18;
SG_MUL_VAL_ 2564485397 S01PID14_OxySensor1_Volt S01PID 20-20;
SG_MUL_VAL_ 2564485397 S01PID14_OxySensor1_STFT S01PID 20-20;
SG_MUL_VAL_ 2564485397 S01PID15_OxySensor2_Volt S01PID 21-21;
SG_MUL_VAL_ 2564485397 S01PID15_OxySensor2_STFT S01PID 21-21;
SG_MUL_VAL_ 2564485397 S01PID16_OxySensor3_Volt S01PID 22-22;
SG_MUL_VAL_ 2564485397 S01PID16_OxySensor3_STFT S01PID 22-22;
SG_MUL_VAL_ 2564485397 S01PID17_OxySensor4_Volt S01PID 23-23;
SG_MUL_VAL_ 2564485397 S01PID17_OxySensor4_STFT S01PID 23-23;
SG_MUL_VAL_ 2564485397 S01PID18_OxySensor5_Volt S01PID 24-24;
SG_MUL_VAL_ 2564485397 S01PID18_OxySensor5_STFT S01PID 24-24;
SG_MUL_VAL_ 2564485397 S01PID19_OxySensor6_Volt S01PID 25-25;
SG_MUL_VAL_ 2564485397 S01PID19_OxySensor6_STFT S01PID 25-25;
SG_MUL_VAL_ 2564485397 S01PID1A_OxySensor7_Volt S01PID 26-26;
SG_MUL_VAL_ 2564485397 S01PID1A_OxySensor7_STFT S01PID 26-26;
SG_MUL_VAL_ 2564485397 S01PID1B_OxySensor8_Volt S01PID 27-27;
SG_MUL_VAL_ 2564485397 S01PID1B_OxySensor8_STFT S01PID 27-27;
SG_MUL_VAL_ 2564485397 S01PID1C_OBDStandard S01PID 28-28;
SG_MUL_VAL_ 2564485397 S01PID1F_TimeSinceEngStart S01PID 31-31;
SG_MUL_VAL_ 2564485397 S01PID21_DistanceMILOn S01PID 33-33;
SG_MUL_VAL_ 2564485397 S01PID22_FuelRailPres S01PID 34-34;
SG_MUL_VAL_ 2564485397 S01PID23_FuelRailGaug S01PID 35-35;
SG_MUL_VAL_ 2564485397 S01PID24_OxySensor1_FAER S01PID 36-36;
SG_MUL_VAL_ 2564485397 S01PID24_OxySensor1_Volt S01PID 36-36;
SG_MUL_VAL_ 2564485397 S01PID25_OxySensor2_FAER S01PID 37-37;
SG_MUL_VAL_ 2564485397 S01PID25_OxySensor2_Volt S01PID 37-37;
SG_MUL_VAL_ 2564485397 S01PID26_OxySensor3_FAER S01PID 38-38;
SG_MUL_VAL_ 2564485397 S01PID26_OxySensor3_Volt S01PID 38-38;
SG_MUL_VAL_ 2564485397 S01PID27_OxySensor4_FAER S01PID 39-39;
SG_MUL_VAL_ 2564485397 S01PID27_OxySensor4_Volt S01PID 39-39;
SG_MUL_VAL_ 2564485397 S01PID28_OxySensor5_FAER S01PID 40-40;
SG_MUL_VAL_ 2564485397 S01PID28_OxySensor5_Volt S01PID 40-40;
SG_MUL_VAL_ 2564485397 S01PID29_OxySensor6_FAER S01PID 41-41;
SG_MUL_VAL_ 2564485397 S01PID29_OxySensor6_Volt S01PID 41-41;
SG_MUL_VAL_ 2564485397 S01PID2A_OxySensor7_FAER S01PID 42-42;
SG_MUL_VAL_ 2564485397 S01PID2A_OxySensor7_Volt S01PID 42-42;
SG_MUL_VAL_ 2564485397 S01PID2B_OxySensor8_FAER S01PID 43-43;
SG_MUL_VAL_ 2564485397 S01PID2B_OxySensor8_Volt S01PID 43-43;
SG_MUL_VAL_ 2564485397 S01PID2C_CmdEGR S01PID 44-44;
SG_MUL_VAL_ 2564485397 S01PID2D_EGRError S01PID 45-45;
SG_MUL_VAL_ 2564485397 S01PID2E_CmdEvapPurge S01PID 46-46;
SG_MUL_VAL_ 2564485397 S01PID2F_FuelTankLevel S01PID 47-47;
SG_MUL_VAL_ 2564485397 S01PID30_WaUpsSinceCodeClear S01PID 48-48;
SG_MUL_VAL_ 2564485397 S01PID31_DistSinceCodeClear S01PID 49-49;
SG_MUL_VAL_ 2564485397 S01PID32_EvapSysVaporPres S01PID 50-50;
SG_MUL_VAL_ 2564485397 S01PID33_AbsBaroPres S01PID 51-51;
SG_MUL_VAL_ 2564485397 S01PID34_OxySensor1_FAER S01PID 52-52;
SG_MUL_VAL_ 2564485397 S01PID34_OxySensor1_Crnt S01PID 52-52;
SG_MUL_VAL_ 2564485397 S01PID35_OxySensor2_FAER S01PID 53-53;
SG_MUL_VAL_ 2564485397 S01PID35_OxySensor2_Crnt S01PID 53-53;
SG_MUL_VAL_ 2564485397 S01PID36_OxySensor3_FAER S01PID 54-54;
SG_MUL_VAL_ 2564485397 S01PID36_OxySensor3_Crnt S01PID 54-54;
SG_MUL_VAL_ 2564485397 S01PID37_OxySensor4_FAER S01PID 55-55;
SG_MUL_VAL_ 2564485397 S01PID37_OxySensor4_Crnt S01PID 55-55;
SG_MUL_VAL_ 2564485397 S01PID38_OxySensor5_FAER S01PID 56-56;
SG_MUL_VAL_ 2564485397 S01PID38_OxySensor5_Crnt S01PID 56-56;
SG_MUL_VAL_ 2564485397 S01PID39_OxySensor6_FAER S01PID 57-57;
SG_MUL_VAL_ 2564485397 S01PID39_OxySensor6_Crnt S01PID 57-57;
SG_MUL_VAL_ 2564485397 S01PID3A_OxySensor7_FAER S01PID 58-58;
SG_MUL_VAL_ 2564485397 S01PID3A_OxySensor7_Crnt S01PID 58-58;
SG_MUL_VAL_ 2564485397 S01PID3B_OxySensor8_FAER S01PID 59-59;
SG_MUL_VAL_ 2564485397 S01PID3B_OxySensor8_Crnt S01PID 59-59;
SG_MUL_VAL_ 2564485397 S01PID3C_CatTempBank1Sens1 S01PID 60-60;
SG_MUL_VAL_ 2564485397 S01PID3D_CatTempBank2Sens1 S01PID 61-61;
SG_MUL_VAL_ 2564485397 S01PID3E_CatTempBank1Sens2 S01PID 62-62;
SG_MUL_VAL_ 2564485397 S01PID3F_CatTempBank2Sens2 S01PID 63-63;
SG_MUL_VAL_ 2564485397 S01PID41_MonStatusDriveCycle S01PID 65-65;
SG_MUL_VAL_ 2564485397 S01PID42_ControlModuleVolt S01PID 66-66;
SG_MUL_VAL_ 2564485397 S01PID43_AbsLoadValue S01PID 67-67;
SG_MUL_VAL_ 2564485397 S01PID44_FuelAirCmdEquiv S01PID 68-68;
SG_MUL_VAL_ 2564485397 S01PID45_RelThrottlePos S01PID 69-69;
SG_MUL_VAL_ 2564485397 S01PID46_AmbientAirTemp S01PID 70-70;
SG_MUL_VAL_ 2564485397 S01PID47_AbsThrottlePosB S01PID 71-71;
SG_MUL_VAL_ 2564485397 S01PID48_AbsThrottlePosC S01PID 72-72;
SG_MUL_VAL_ 2564485397 S01PID49_AbsThrottlePosD S01PID 73-73;
SG_MUL_VAL_ 2564485397 S01PID4A_AbsThrottlePosE S01PID 74-74;
SG_MUL_VAL_ 2564485397 S01PID4B_AbsThrottlePosF S01PID 75-75;
SG_MUL_VAL_ 2564485397 S01PID4C_CmdThrottleAct S01PID 76-76;
SG_MUL_VAL_ 2564485397 S01PID4D_TimeRunMILOn S01PID 77-77;
SG_MUL_VAL_ 2564485397 S01PID4E_TimeSinceCodeClear S01PID 78-78;
SG_MUL_VAL_ 2564485397 S01PID4F_Max_FAER S01PID 79-79;
SG_MUL_VAL_ 2564485397 S01PID4F_Max_OxySensVol S01PID 79-79;
SG_MUL_VAL_ 2564485397 S01PID4F_Max_OxySensCrnt S01PID 79-79;
SG_MUL_VAL_ 2564485397 S01PID4F_Max_IntManiAbsPres S01PID 79-79;
SG_MUL_VAL_ 2564485397 S01PID50_Max_AirFlowMAF S01PID 80-80;
SG_MUL_VAL_ 2564485397 S01PID51_FuelType S01PID 81-81;
SG_MUL_VAL_ 2564485397 S01PID52_EthanolFuelPct S01PID 82-82;
SG_MUL_VAL_ 2564485397 S01PID53_AbsEvapSysVapPres S01PID 83-83;
SG_MUL_VAL_ 2564485397 S01PID54_EvapSysVapPres S01PID 84-84;
SG_MUL_VAL_ 2564485397 S01PID55_ShortSecOxyTrimBank1 S01PID 85-85;
SG_MUL_VAL_ 2564485397 S01PID55_ShortSecOxyTrimBank3 S01PID 85-85;
SG_MUL_VAL_ 2564485397 S01PID56_LongSecOxyTrimBank1 S01PID 86-86;
SG_MUL_VAL_ 2564485397 S01PID56_LongSecOxyTrimBank3 S01PID 86-86;
SG_MUL_VAL_ 2564485397 S01PID57_ShortSecOxyTrimBank2 S01PID 87-87;
SG_MUL_VAL_ 2564485397 S01PID57_ShortSecOxyTrimBank4 S01PID 87-87;
SG_MUL_VAL_ 2564485397 S01PID58_LongSecOxyTrimBank2 S01PID 88-88;
SG_MUL_VAL_ 2564485397 S01PID58_LongSecOxyTrimBank4 S01PID 88-88;
SG_MUL_VAL_ 2564485397 S01PID59_FuelRailAbsPres S01PID 89-89;
SG_MUL_VAL_ 2564485397 S01PID5A_RelAccelPedalPos S01PID 90-90;
SG_MUL_VAL_ 2564485397 S01PID5B_HybrBatPackRemLife S01PID 91-91;
SG_MUL_VAL_ 2564485397 S01PID5C_EngineOilTemp S01PID 92-92;
SG_MUL_VAL_ 2564485397 S01PID5D_FuelInjectionTiming S01PID 93-93;
SG_MUL_VAL_ 2564485397 S01PID5E_EngineFuelRate S01PID 94-94;
SG_MUL_VAL_ 2564485397 S01PID5F_EmissionReq S01PID 95-95;
SG_MUL_VAL_ 2564485397 S01PID61_DemandEngTorqPct S01PID 97-97;
SG_MUL_VAL_ 2564485397 S01PID62_ActualEngTorqPct S01PID 98-98;
SG_MUL_VAL_ 2564485397 S01PID63_EngRefTorq S01PID 99-99;
SG_MUL_VAL_ 2564485397 S01PID65_AuxInputOutput S01PID 101-101;
SG_MUL_VAL_ 2564485397 S01PID66_MAFSensor S01PID 102-102;
SG_MUL_VAL_ 2564485397 S01PID67_EngineCoolantTemp S01PID 103-103;
SG_MUL_VAL_ 2564485397 S01PID68_IntakeAirTempSens S01PID 104-104;
SG_MUL_VAL_ 2564485397 S01PID69_CmdEGR_EGRError S01PID 105-105;
SG_MUL_VAL_ 2564485397 S01PID6A_CmdDieselIntAir S01PID 106-106;
SG_MUL_VAL_ 2564485397 S01PID6B_ExhaustGasTemp S01PID 107-107;
SG_MUL_VAL_ 2564485397 S01PID6C_CmdThrottleActRel S01PID 108-108;
SG_MUL_VAL_ 2564485397 S01PID6D_FuelPresContrSys S01PID 109-109;
SG_MUL_VAL_ 2564485397 S01PID6E_InjPresContrSys S01PID 110-110;
SG_MUL_VAL_ 2564485397 S01PID6F_TurboComprPres S01PID 111-111;
SG_MUL_VAL_ 2564485397 S01PID70_BoostPresCntrl S01PID 112-112;
SG_MUL_VAL_ 2564485397 S01PID8E_EngFrictionPctTorq S01PID 142-142;
SG_MUL_VAL_ 2564485397 S01PIDA6_Odometer S01PID 166-166;
SG_MUL_VAL_ 2564485397 S02PID02_FreezeDTC S02PID 2-2;
SG_MUL_VAL_ 2564485397 S01PID S 1-1;
SG_MUL_VAL_ 2564485397 S02PID S 2-2;
SG_MUL_VAL_ 2564485397 SUP_S01PID01_MonitorStatus S01PID 0-0;
SG_MUL_VAL_ 2564485397 SUP_S01PID02_FreezeDTC S01PID 0-0;
SG_MUL_VAL_ 2564485397 SUP_S01PID03_FuelSystemStatus S01PID 0-0;
SG_MUL_VAL_ 2564485397 SUP_S01PID04_CalcEngineLoad S01PID 0-0;
SG_MUL_VAL_ 2564485397 SUP_S01PID05_EngineCoolantTemp S01PID 0-0;
SG_MUL_VAL_ 2564485397 SUP_S01PID06_ShortFuelTrimBank1 S01PID 0-0;
SG_MUL_VAL_ 2564485397 SUP_S01PID07_LongFuelTrimBank1 S01PID 0-0;
SG_MUL_VAL_ 2564485397 SUP_S01PID08_ShortFuelTrimBank2 S01PID 0-0;
SG_MUL_VAL_ 2564485397 SUP_S01PID09_LongFuelTrimBank2 S01PID 0-0;
SG_MUL_VAL_ 2564485397 SUP_S01PID0A_FuelPressure S01PID 0-0;
SG_MUL_VAL_ 2564485397 SUP_S01PID0B_IntakeManiAbsPress S01PID 0-0;
SG_MUL_VAL_ 2564485397 SUP_S01PID0C_EngineRPM S01PID 0-0;
SG_MUL_VAL_ 2564485397 SUP_S01PID0D_VehicleSpeed S01PID 0-0;
SG_MUL_VAL_ 2564485397 SUP_S01PID0E_TimingAdvance S01PID 0-0;
SG_MUL_VAL_ 2564485397 SUP_S01PID0F_IntakeAirTemperatur S01PID 0-0;
SG_MUL_VAL_ 2564485397 SUP_S01PID10_MAFAirFlowRate S01PID 0-0;
SG_MUL_VAL_ 2564485397 SUP_S01PID11_ThrottlePosition S01PID 0-0;
SG_MUL_VAL_ 2564485397 SUP_S01PID12_CmdSecAirStatus S01PID 0-0;
SG_MUL_VAL_ 2564485397 SUP_S01PID14_OxySensor1_Volt S01PID 0-0;
SG_MUL_VAL_ 2564485397 SUP_S01PID15_OxySensor2_Volt S01PID 0-0;
SG_MUL_VAL_ 2564485397 SUP_S01PID16_OxySensor3_Volt S01PID 0-0;
SG_MUL_VAL_ 2564485397 SUP_S01PID17_OxySensor4_Volt S01PID 0-0;
SG_MUL_VAL_ 2564485397 SUP_S01PID18_OxySensor5_Volt S01PID 0-0;
SG_MUL_VAL_ 2564485397 SUP_S01PID19_OxySensor6_Volt S01PID 0-0;
SG_MUL_VAL_ 2564485397 SUP_S01PID1A_OxySensor7_Volt S01PID 0-0;
SG_MUL_VAL_ 2564485397 SUP_S01PID1B_OxySensor8_Volt S01PID 0-0;
SG_MUL_VAL_ 2564485397 SUP_S01PID1C_OBDStandard S01PID 0-0;
SG_MUL_VAL_ 2564485397 SUP_S01PID1F_TimeSinceEngStart S01PID 0-0;
SG_MUL_VAL_ 2564485397 SUP_S01PID21_DistanceMILOn S01PID 32-32;
SG_MUL_VAL_ 2564485397 SUP_S01PID22_FuelRailPres S01PID 32-32;
SG_MUL_VAL_ 2564485397 SUP_S01PID23_FuelRailGaug S01PID 32-32;
SG_MUL_VAL_ 2564485397 SUP_S01PID24_OxySensor1_FAER S01PID 32-32;
SG_MUL_VAL_ 2564485397 SUP_S01PID25_OxySensor2_FAER S01PID 32-32;
SG_MUL_VAL_ 2564485397 SUP_S01PID26_OxySensor3_FAER S01PID 32-32;
SG_MUL_VAL_ 2564485397 SUP_S01PID27_OxySensor4_FAER S01PID 32-32;
SG_MUL_VAL_ 2564485397 SUP_S01PID28_OxySensor5_FAER S01PID 32-32;
SG_MUL_VAL_ 2564485397 SUP_S01PID29_OxySensor6_FAER S01PID 32-32;
SG_MUL_VAL_ 2564485397 SUP_S01PID2A_OxySensor7_FAER S01PID 32-32;
SG_MUL_VAL_ 2564485397 SUP_S01PID2B_OxySensor8_FAER S01PID 32-32;
SG_MUL_VAL_ 2564485397 SUP_S01PID2C_CmdEGR S01PID 32-32;
SG_MUL_VAL_ 2564485397 SUP_S01PID2D_EGRError S01PID 32-32;
SG_MUL_VAL_ 2564485397 SUP_S01PID2E_CmdEvapPurge S01PID 32-32;
SG_MUL_VAL_ 2564485397 SUP_S01PID2F_FuelTankLevel S01PID 32-32;
SG_MUL_VAL_ 2564485397 SUP_S01PID30_WaUpsSinceCodeClear S01PID 32-32;
SG_MUL_VAL_ 2564485397 SUP_S01PID31_DistSinceCodeClear S01PID 32-32;
SG_MUL_VAL_ 2564485397 SUP_S01PID32_EvapSysVaporPres S01PID 32-32;
SG_MUL_VAL_ 2564485397 SUP_S01PID33_AbsBaroPres S01PID 32-32;
SG_MUL_VAL_ 2564485397 SUP_S01PID34_OxySensor1_FAER S01PID 32-32;
SG_MUL_VAL_ 2564485397 SUP_S01PID35_OxySensor2_FAER S01PID 32-32;
SG_MUL_VAL_ 2564485397 SUP_S01PID36_OxySensor3_FAER S01PID 32-32;
SG_MUL_VAL_ 2564485397 SUP_S01PID37_OxySensor4_FAER S01PID 32-32;
SG_MUL_VAL_ 2564485397 SUP_S01PID38_OxySensor5_FAER S01PID 32-32;
SG_MUL_VAL_ 2564485397 SUP_S01PID39_OxySensor6_FAER S01PID 32-32;
SG_MUL_VAL_ 2564485397 SUP_S01PID3A_OxySensor7_FAER S01PID 32-32;
SG_MUL_VAL_ 2564485397 SUP_S01PID3B_OxySensor8_FAER S01PID 32-32;
SG_MUL_VAL_ 2564485397 SUP_S01PID3C_CatTempBank1Sens1 S01PID 32-32;
SG_MUL_VAL_ 2564485397 SUP_S01PID3D_CatTempBank2Sens1 S01PID 32-32;
SG_MUL_VAL_ 2564485397 SUP_S01PID3E_CatTempBank1Sens2 S01PID 32-32;
SG_MUL_VAL_ 2564485397 SUP_S01PID3F_CatTempBank2Sens2 S01PID 32-32;
SG_MUL_VAL_ 2564485397 SUP_S01PID41_MonStatusDriveCycle S01PID 64-64;
SG_MUL_VAL_ 2564485397 SUP_S01PID42_ControlModuleVolt S01PID 64-64;
SG_MUL_VAL_ 2564485397 SUP_S01PID43_AbsLoadValue S01PID 64-64;
SG_MUL_VAL_ 2564485397 SUP_S01PID44_FuelAirCmdEquiv S01PID 64-64;
SG_MUL_VAL_ 2564485397 SUP_S01PID45_RelThrottlePos S01PID 64-64;
SG_MUL_VAL_ 2564485397 SUP_S01PID46_AmbientAirTemp S01PID 64-64;
SG_MUL_VAL_ 2564485397 SUP_S01PID47_AbsThrottlePosB S01PID 64-64;
SG_MUL_VAL_ 2564485397 SUP_S01PID48_AbsThrottlePosC S01PID 64-64;
SG_MUL_VAL_ 2564485397 SUP_S01PID49_AbsThrottlePosD S01PID 64-64;
SG_MUL_VAL_ 2564485397 SUP_S01PID4A_AbsThrottlePosE S01PID 64-64;
SG_MUL_VAL_ 2564485397 SUP_S01PID4B_AbsThrottlePosF S01PID 64-64;
SG_MUL_VAL_ 2564485397 SUP_S01PID4C_CmdThrottleAct S01PID 64-64;
SG_MUL_VAL_ 2564485397 SUP_S01PID4D_TimeRunMILOn S01PID 64-64;
SG_MUL_VAL_ 2564485397 SUP_S01PID4E_TimeSinceCodeClear S01PID 64-64;
SG_MUL_VAL_ 2564485397 SUP_S01PID4F_Max_FAER S01PID 64-64;
SG_MUL_VAL_ 2564485397 SUP_S01PID50_Max_AirFlowMAF S01PID 64-64;
SG_MUL_VAL_ 2564485397 SUP_S01PID51_FuelType S01PID 64-64;
SG_MUL_VAL_ 2564485397 SUP_S01PID52_EthanolFuelPct S01PID 64-64;
SG_MUL_VAL_ 2564485397 SUP_S01PID53_AbsEvapSysVapPres S01PID 64-64;
SG_MUL_VAL_ 2564485397 SUP_S01PID54_EvapSysVapPres S01PID 64-64;
SG_MUL_VAL_ 2564485397 SUP_S01PID55_ShortSecOxyTrimBank S01PID 64-64;
SG_MUL_VAL_ 2564485397 SUP_S01PID56_LongSecOxyTrimBank1 S01PID 64-64;
SG_MUL_VAL_ 2564485397 SUP_S01PID57_ShortSecOxyTrimBank S01PID 64-64;
SG_MUL_VAL_ 2564485397 SUP_S01PID58_LongSecOxyTrimBank2 S01PID 64-64;
SG_MUL_VAL_ 2564485397 SUP_S01PID59_FuelRailAbsPres S01PID 64-64;
SG_MUL_VAL_ 2564485397 SUP_S01PID5A_RelAccelPedalPos S01PID 64-64;
SG_MUL_VAL_ 2564485397 SUP_S01PID5B_HybrBatPackRemLife S01PID 64-64;
SG_MUL_VAL_ 2564485397 SUP_S01PID5C_EngineOilTemp S01PID 64-64;
SG_MUL_VAL_ 2564485397 SUP_S01PID5D_FuelInjectionTiming S01PID 64-64;
SG_MUL_VAL_ 2564485397 SUP_S01PID5E_EngineFuelRate S01PID 64-64;
SG_MUL_VAL_ 2564485397 SUP_S01PID5F_EmissionReq S01PID 64-64;
SG_MUL_VAL_ 2564485397 SUP_S01PID61_DemandEngTorqPct S01PID 96-96;
SG_MUL_VAL_ 2564485397 SUP_S01PID62_ActualEngTorqPct S01PID 96-96;
SG_MUL_VAL_ 2564485397 SUP_S01PID63_EngRefTorq S01PID 96-96;
SG_MUL_VAL_ 2564485397 SUP_S01PID64_EngPctTorq_Idle S01PID 96-96;
SG_MUL_VAL_ 2564485397 SUP_S01PID65_AuxInputOutput S01PID 96-96;
SG_MUL_VAL_ 2564485397 SUP_S01PID66_MAFSensor S01PID 96-96;
SG_MUL_VAL_ 2564485397 SUP_S01PID67_EngineCoolantTemp S01PID 96-96;
SG_MUL_VAL_ 2564485397 SUP_S01PID68_IntakeAirTempSens S01PID 96-96;
SG_MUL_VAL_ 2564485397 SUP_S01PID69_CmdEGR_EGRError S01PID 96-96;
SG_MUL_VAL_ 2564485397 SUP_S01PID6A_CmdDieselIntAir S01PID 96-96;
SG_MUL_VAL_ 2564485397 SUP_S01PID6B_ExhaustGasTemp S01PID 96-96;
SG_MUL_VAL_ 2564485397 SUP_S01PID6C_CmdThrottleActRel S01PID 96-96;
SG_MUL_VAL_ 2564485397 SUP_S01PID6D_FuelPresContrSys S01PID 96-96;
SG_MUL_VAL_ 2564485397 SUP_S01PID6E_InjPresContrSys S01PID 96-96;
SG_MUL_VAL_ 2564485397 SUP_S01PID6F_TurboComprPres S01PID 96-96;
SG_MUL_VAL_ 2564485397 SUP_S01PID70_BoostPresCntrl S01PID 96-96;
SG_MUL_VAL_ 2564485397 SUP_S01PID78_Bank1EGT1 S01PID 96-96;
SG_MUL_VAL_ 2564485397 SUP_S01PID79_Bank2EGT1 S01PID 96-96;
SG_MUL_VAL_ 2564485397 SUP_S01PID8E_EngFrictionPctTorq S01PID 128-128;
SG_MUL_VAL_ 2564485397 SUP_S01PIDA6_Odometer S01PID 160-160;
SG_MUL_VAL_ 2564485397 S22F4PID01_MonitorStatus S22F4PID 1-1;
SG_MUL_VAL_ 2564485397 S22F4PID03_FuelSystemStatus S22F4PID 3-3;
SG_MUL_VAL_ 2564485397 S22F4PID04_CalcEngineLoad S22F4PID 4-4;
SG_MUL_VAL_ 2564485397 S22F4PID05_EngineCoolantTemp S22F4PID 5-5;
SG_MUL_VAL_ 2564485397 S22F4PID06_ShortFuelTrimBank1 S22F4PID 6-6;
SG_MUL_VAL_ 2564485397 S22F4PID07_LongFuelTrimBank1 S22F4PID 7-7;
SG_MUL_VAL_ 2564485397 S22F4PID08_ShortFuelTrimBank2 S22F4PID 8-8;
SG_MUL_VAL_ 2564485397 S22F4PID09_LongFuelTrimBank2 S22F4PID 9-9;
SG_MUL_VAL_ 2564485397 S22F4PID0A_FuelPressure S22F4PID 10-10;
SG_MUL_VAL_ 2564485397 S22F4PID0B_IntakeManiAbsPress S22F4PID 11-11;
SG_MUL_VAL_ 2564485397 S22F4PID0C_EngineRPM S22F4PID 12-12;
SG_MUL_VAL_ 2564485397 S22F4PID0D_VehicleSpeed S22F4PID 13-13;
SG_MUL_VAL_ 2564485397 S22F4PID0E_TimingAdvance S22F4PID 14-14;
SG_MUL_VAL_ 2564485397 S22F4PID0F_IntakeAirTemperature S22F4PID 15-15;
SG_MUL_VAL_ 2564485397 S22F4PID10_MAFAirFlowRate S22F4PID 16-16;
SG_MUL_VAL_ 2564485397 S22F4PID11_ThrottlePosition S22F4PID 17-17;
SG_MUL_VAL_ 2564485397 S22F4PID12_CmdSecAirStatus S22F4PID 18-18;
SG_MUL_VAL_ 2564485397 S22F4PID14_OxySensor1_Volt S22F4PID 20-20;
SG_MUL_VAL_ 2564485397 S22F4PID14_OxySensor1_STFT S22F4PID 20-20;
SG_MUL_VAL_ 2564485397 S22F4PID15_OxySensor2_Volt S22F4PID 21-21;
SG_MUL_VAL_ 2564485397 S22F4PID15_OxySensor2_STFT S22F4PID 21-21;
SG_MUL_VAL_ 2564485397 S22F4PID16_OxySensor3_Volt S22F4PID 22-22;
SG_MUL_VAL_ 2564485397 S22F4PID16_OxySensor3_STFT S22F4PID 22-22;
SG_MUL_VAL_ 2564485397 S22F4PID17_OxySensor4_Volt S22F4PID 23-23;
SG_MUL_VAL_ 2564485397 S22F4PID17_OxySensor4_STFT S22F4PID 23-23;
SG_MUL_VAL_ 2564485397 S22F4PID18_OxySensor5_Volt S22F4PID 24-24;
SG_MUL_VAL_ 2564485397 S22F4PID18_OxySensor5_STFT S22F4PID 24-24;
SG_MUL_VAL_ 2564485397 S22F4PID19_OxySensor6_Volt S22F4PID 25-25;
SG_MUL_VAL_ 2564485397 S22F4PID19_OxySensor6_STFT S22F4PID 25-25;
SG_MUL_VAL_ 2564485397 S22F4PID1A_OxySensor7_Volt S22F4PID 26-26;
SG_MUL_VAL_ 2564485397 S22F4PID1A_OxySensor7_STFT S22F4PID 26-26;
SG_MUL_VAL_ 2564485397 S22F4PID1B_OxySensor8_Volt S22F4PID 27-27;
SG_MUL_VAL_ 2564485397 S22F4PID1B_OxySensor8_STFT S22F4PID 27-27;
SG_MUL_VAL_ 2564485397 S22F4PID1C_OBDStandard S22F4PID 28-28;
SG_MUL_VAL_ 2564485397 S22F4PID1F_TimeSinceEngStart S22F4PID 31-31;
SG_MUL_VAL_ 2564485397 S22F4PID21_DistanceMILOn S22F4PID 33-33;
SG_MUL_VAL_ 2564485397 S22F4PID22_FuelRailPres S22F4PID 34-34;
SG_MUL_VAL_ 2564485397 S22F4PID23_FuelRailGaug S22F4PID 35-35;
SG_MUL_VAL_ 2564485397 S22F4PID24_OxySensor1_FAER S22F4PID 36-36;
SG_MUL_VAL_ 2564485397 S22F4PID24_OxySensor1_Volt S22F4PID 36-36;
SG_MUL_VAL_ 2564485397 S22F4PID25_OxySensor2_FAER S22F4PID 37-37;
SG_MUL_VAL_ 2564485397 S22F4PID25_OxySensor2_Volt S22F4PID 37-37;
SG_MUL_VAL_ 2564485397 S22F4PID26_OxySensor3_FAER S22F4PID 38-38;
SG_MUL_VAL_ 2564485397 S22F4PID26_OxySensor3_Volt S22F4PID 38-38;
SG_MUL_VAL_ 2564485397 S22F4PID27_OxySensor4_FAER S22F4PID 39-39;
SG_MUL_VAL_ 2564485397 S22F4PID27_OxySensor4_Volt S22F4PID 39-39;
SG_MUL_VAL_ 2564485397 S22F4PID28_OxySensor5_FAER S22F4PID 40-40;
SG_MUL_VAL_ 2564485397 S22F4PID28_OxySensor5_Volt S22F4PID 40-40;
SG_MUL_VAL_ 2564485397 S22F4PID29_OxySensor6_FAER S22F4PID 41-41;
SG_MUL_VAL_ 2564485397 S22F4PID29_OxySensor6_Volt S22F4PID 41-41;
SG_MUL_VAL_ 2564485397 S22F4PID2A_OxySensor7_FAER S22F4PID 42-42;
SG_MUL_VAL_ 2564485397 S22F4PID2A_OxySensor7_Volt S22F4PID 42-42;
SG_MUL_VAL_ 2564485397 S22F4PID2B_OxySensor8_FAER S22F4PID 43-43;
SG_MUL_VAL_ 2564485397 S22F4PID2B_OxySensor8_Volt S22F4PID 43-43;
SG_MUL_VAL_ 2564485397 S22F4PID2C_CmdEGR S22F4PID 44-44;
SG_MUL_VAL_ 2564485397 S22F4PID2D_EGRError S22F4PID 45-45;
SG_MUL_VAL_ 2564485397 S22F4PID2E_CmdEvapPurge S22F4PID 46-46;
SG_MUL_VAL_ 2564485397 S22F4PID2F_FuelTankLevel S22F4PID 47-47;
SG_MUL_VAL_ 2564485397 S22F4PID30_WaUpsSinceCodeClear S22F4PID 48-48;
SG_MUL_VAL_ 2564485397 S22F4PID31_DistSinceCodeClear S22F4PID 49-49;
SG_MUL_VAL_ 2564485397 S22F4PID32_EvapSysVaporPres S22F4PID 50-50;
SG_MUL_VAL_ 2564485397 S22F4PID33_AbsBaroPres S22F4PID 51-51;
SG_MUL_VAL_ 2564485397 S22F4PID34_OxySensor1_FAER S22F4PID 52-52;
SG_MUL_VAL_ 2564485397 S22F4PID34_OxySensor1_Crnt S22F4PID 52-52;
SG_MUL_VAL_ 2564485397 S22F4PID35_OxySensor2_FAER S22F4PID 53-53;
SG_MUL_VAL_ 2564485397 S22F4PID35_OxySensor2_Crnt S22F4PID 53-53;
SG_MUL_VAL_ 2564485397 S22F4PID36_OxySensor3_FAER S22F4PID 54-54;
SG_MUL_VAL_ 2564485397 S22F4PID36_OxySensor3_Crnt S22F4PID 54-54;
SG_MUL_VAL_ 2564485397 S22F4PID37_OxySensor4_FAER S22F4PID 55-55;
SG_MUL_VAL_ 2564485397 S22F4PID37_OxySensor4_Crnt S22F4PID 55-55;
SG_MUL_VAL_ 2564485397 S22F4PID38_OxySensor5_FAER S22F4PID 56-56;
SG_MUL_VAL_ 2564485397 S22F4PID38_OxySensor5_Crnt S22F4PID 56-56;
SG_MUL_VAL_ 2564485397 S22F4PID39_OxySensor6_FAER S22F4PID 57-57;
SG_MUL_VAL_ 2564485397 S22F4PID39_OxySensor6_Crnt S22F4PID 57-57;
SG_MUL_VAL_ 2564485397 S22F4PID3A_OxySensor7_FAER S22F4PID 58-58;
SG_MUL_VAL_ 2564485397 S22F4PID3A_OxySensor7_Crnt S22F4PID 58-58;
SG_MUL_VAL_ 2564485397 S22F4PID3B_OxySensor8_FAER S22F4PID 59-59;
SG_MUL_VAL_ 2564485397 S22F4PID3B_OxySensor8_Crnt S22F4PID 59-59;
SG_MUL_VAL_ 2564485397 S22F4PID3C_CatTempBank1Sens1 S22F4PID 60-60;
SG_MUL_VAL_ 2564485397 S22F4PID3D_CatTempBank2Sens1 S22F4PID 61-61;
SG_MUL_VAL_ 2564485397 S22F4PID3E_CatTempBank1Sens2 S22F4PID 62-62;
SG_MUL_VAL_ 2564485397 S22F4PID3F_CatTempBank2Sens2 S22F4PID 63-63;
SG_MUL_VAL_ 2564485397 S22F4PID41_MonStatusDriveCycle S22F4PID 65-65;
SG_MUL_VAL_ 2564485397 S22F4PID42_ControlModuleVolt S22F4PID 66-66;
SG_MUL_VAL_ 2564485397 S22F4PID43_AbsLoadValue S22F4PID 67-67;
SG_MUL_VAL_ 2564485397 S22F4PID44_FuelAirCmdEquiv S22F4PID 68-68;
SG_MUL_VAL_ 2564485397 S22F4PID45_RelThrottlePos S22F4PID 69-69;
SG_MUL_VAL_ 2564485397 S22F4PID46_AmbientAirTemp S22F4PID 70-70;
SG_MUL_VAL_ 2564485397 S22F4PID47_AbsThrottlePosB S22F4PID 71-71;
SG_MUL_VAL_ 2564485397 S22F4PID48_AbsThrottlePosC S22F4PID 72-72;
SG_MUL_VAL_ 2564485397 S22F4PID49_AbsThrottlePosD S22F4PID 73-73;
SG_MUL_VAL_ 2564485397 S22F4PID4A_AbsThrottlePosE S22F4PID 74-74;
SG_MUL_VAL_ 2564485397 S22F4PID4B_AbsThrottlePosF S22F4PID 75-75;
SG_MUL_VAL_ 2564485397 S22F4PID4C_CmdThrottleAct S22F4PID 76-76;
SG_MUL_VAL_ 2564485397 S22F4PID4D_TimeRunMILOn S22F4PID 77-77;
SG_MUL_VAL_ 2564485397 S22F4PID4E_TimeSinceCodeClear S22F4PID 78-78;
SG_MUL_VAL_ 2564485397 S22F4PID4F_Max_FAER S22F4PID 79-79;
SG_MUL_VAL_ 2564485397 S22F4PID4F_Max_OxySensVol S22F4PID 79-79;
SG_MUL_VAL_ 2564485397 S22F4PID4F_Max_OxySensCrnt S22F4PID 79-79;
SG_MUL_VAL_ 2564485397 S22F4PID4F_Max_IntManiAbsPres S22F4PID 79-79;
SG_MUL_VAL_ 2564485397 S22F4PID50_Max_AirFlowMAF S22F4PID 80-80;
SG_MUL_VAL_ 2564485397 S22F4PID51_FuelType S22F4PID 81-81;
SG_MUL_VAL_ 2564485397 S22F4PID52_EthanolFuelPct S22F4PID 82-82;
SG_MUL_VAL_ 2564485397 S22F4PID53_AbsEvapSysVapPres S22F4PID 83-83;
SG_MUL_VAL_ 2564485397 S22F4PID54_EvapSysVapPres S22F4PID 84-84;
SG_MUL_VAL_ 2564485397 S22F4PID55_ShortSecOxyTrimBank1 S22F4PID 85-85;
SG_MUL_VAL_ 2564485397 S22F4PID55_ShortSecOxyTrimBank3 S22F4PID 85-85;
SG_MUL_VAL_ 2564485397 S22F4PID56_LongSecOxyTrimBank1 S22F4PID 86-86;
SG_MUL_VAL_ 2564485397 S22F4PID56_LongSecOxyTrimBank3 S22F4PID 86-86;
SG_MUL_VAL_ 2564485397 S22F4PID57_ShortSecOxyTrimBank2 S22F4PID 87-87;
SG_MUL_VAL_ 2564485397 S22F4PID57_ShortSecOxyTrimBank4 S22F4PID 87-87;
SG_MUL_VAL_ 2564485397 S22F4PID58_LongSecOxyTrimBank2 S22F4PID 88-88;
SG_MUL_VAL_ 2564485397 S22F4PID58_LongSecOxyTrimBank4 S22F4PID 88-88;
SG_MUL_VAL_ 2564485397 S22F4PID59_FuelRailAbsPres S22F4PID 89-89;
SG_MUL_VAL_ 2564485397 S22F4PID5A_RelAccelPedalPos S22F4PID 90-90;
SG_MUL_VAL_ 2564485397 S22F4PID5B_HybrBatPackRemLife S22F4PID 91-91;
SG_MUL_VAL_ 2564485397 S22F4PID5C_EngineOilTemp S22F4PID 92-92;
SG_MUL_VAL_ 2564485397 S22F4PID5D_FuelInjectionTiming S22F4PID 93-93;
SG_MUL_VAL_ 2564485397 S22F4PID5E_EngineFuelRate S22F4PID 94-94;
SG_MUL_VAL_ 2564485397 S22F4PID5F_EmissionReq S22F4PID 95-95;
SG_MUL_VAL_ 2564485397 S22F4PID61_DemandEngTorqPct S22F4PID 97-97;
SG_MUL_VAL_ 2564485397 S22F4PID62_ActualEngTorqPct S22F4PID 98-98;
SG_MUL_VAL_ 2564485397 S22F4PID63_EngRefTorq S22F4PID 99-99;
SG_MUL_VAL_ 2564485397 S22F4PID65_AuxInputOutput S22F4PID 101-101;
SG_MUL_VAL_ 2564485397 S22F4PID66_MAFSensor S22F4PID 102-102;
SG_MUL_VAL_ 2564485397 S22F4PID67_EngineCoolantTemp S22F4PID 103-103;
SG_MUL_VAL_ 2564485397 S22F4PID68_IntakeAirTempSens S22F4PID 104-104;
SG_MUL_VAL_ 2564485397 S22F4PID69_CmdEGR_EGRError S22F4PID 105-105;
SG_MUL_VAL_ 2564485397 S22F4PID6A_CmdDieselIntAir S22F4PID 106-106;
SG_MUL_VAL_ 2564485397 S22F4PID6B_ExhaustGasTemp S22F4PID 107-107;
SG_MUL_VAL_ 2564485397 S22F4PID6C_CmdThrottleActRel S22F4PID 108-108;
SG_MUL_VAL_ 2564485397 S22F4PID6D_FuelPresContrSys S22F4PID 109-109;
SG_MUL_VAL_ 2564485397 S22F4PID6E_InjPresContrSys S22F4PID 110-110;
SG_MUL_VAL_ 2564485397 S22F4PID6F_TurboComprPres S22F4PID 111-111;
SG_MUL_VAL_ 2564485397 S22F4PID70_BoostPresCntrl S22F4PID 112-112;
SG_MUL_VAL_ 2564485397 S22F4PID8E_EngFrictionPctTorq S22F4PID 142-142;
SG_MUL_VAL_ 2564485397 S22F4PIDA6_Odometer S22F4PID 166-166;
SG_MUL_VAL_ 2564485397 SubFct S 34-34;
SG_MUL_VAL_ 2564485397 S22F4PID SubFct 244-244;
SG_MUL_VAL_ 2564485397 S22F8PID SubFct 248-248;
SG_MUL_VAL_ 2564502513 S01PID01_MonitorStatus S01PID 1-1;
SG_MUL_VAL_ 2564502513 S01PID02_FreezeDTC S01PID 2-2;
SG_MUL_VAL_ 2564502513 S01PID03_FuelSystemStatus S01PID 3-3;
SG_MUL_VAL_ 2564502513 S01PID04_CalcEngineLoad S01PID 4-4;
SG_MUL_VAL_ 2564502513 S01PID05_EngineCoolantTemp S01PID 5-5;
SG_MUL_VAL_ 2564502513 S01PID06_ShortFuelTrimBank1 S01PID 6-6;
SG_MUL_VAL_ 2564502513 S01PID07_LongFuelTrimBank1 S01PID 7-7;
SG_MUL_VAL_ 2564502513 S01PID08_ShortFuelTrimBank2 S01PID 8-8;
SG_MUL_VAL_ 2564502513 S01PID09_LongFuelTrimBank2 S01PID 9-9;
SG_MUL_VAL_ 2564502513 S01PID0A_FuelPressure S01PID 10-10;
SG_MUL_VAL_ 2564502513 S01PID0B_IntakeManiAbsPress S01PID 11-11;
SG_MUL_VAL_ 2564502513 S01PID0C_EngineRPM S01PID 12-12;
SG_MUL_VAL_ 2564502513 S01PID0D_VehicleSpeed S01PID 13-13;
SG_MUL_VAL_ 2564502513 S01PID0E_TimingAdvance S01PID 14-14;
SG_MUL_VAL_ 2564502513 S01PID0F_IntakeAirTemperature S01PID 15-15;
SG_MUL_VAL_ 2564502513 S01PID10_MAFAirFlowRate S01PID 16-16;
SG_MUL_VAL_ 2564502513 S01PID11_ThrottlePosition S01PID 17-17;
SG_MUL_VAL_ 2564502513 S01PID12_CmdSecAirStatus S01PID 18-18;
SG_MUL_VAL_ 2564502513 S01PID14_OxySensor1_Volt S01PID 20-20;
SG_MUL_VAL_ 2564502513 S01PID14_OxySensor1_STFT S01PID 20-20;
SG_MUL_VAL_ 2564502513 S01PID15_OxySensor2_Volt S01PID 21-21;
SG_MUL_VAL_ 2564502513 S01PID15_OxySensor2_STFT S01PID 21-21;
SG_MUL_VAL_ 2564502513 S01PID16_OxySensor3_Volt S01PID 22-22;
SG_MUL_VAL_ 2564502513 S01PID16_OxySensor3_STFT S01PID 22-22;
SG_MUL_VAL_ 2564502513 S01PID17_OxySensor4_Volt S01PID 23-23;
SG_MUL_VAL_ 2564502513 S01PID17_OxySensor4_STFT S01PID 23-23;
SG_MUL_VAL_ 2564502513 S01PID18_OxySensor5_Volt S01PID 24-24;
SG_MUL_VAL_ 2564502513 S01PID18_OxySensor5_STFT S01PID 24-24;
SG_MUL_VAL_ 2564502513 S01PID19_OxySensor6_Volt S01PID 25-25;
SG_MUL_VAL_ 2564502513 S01PID19_OxySensor6_STFT S01PID 25-25;
SG_MUL_VAL_ 2564502513 S01PID1A_OxySensor7_Volt S01PID 26-26;
SG_MUL_VAL_ 2564502513 S01PID1A_OxySensor7_STFT S01PID 26-26;
SG_MUL_VAL_ 2564502513 S01PID1B_OxySensor8_Volt S01PID 27-27;
SG_MUL_VAL_ 2564502513 S01PID1B_OxySensor8_STFT S01PID 27-27;
SG_MUL_VAL_ 2564502513 S01PID1C_OBDStandard S01PID 28-28;
SG_MUL_VAL_ 2564502513 S01PID1F_TimeSinceEngStart S01PID 31-31;
SG_MUL_VAL_ 2564502513 S01PID21_DistanceMILOn S01PID 33-33;
SG_MUL_VAL_ 2564502513 S01PID22_FuelRailPres S01PID 34-34;
SG_MUL_VAL_ 2564502513 S01PID23_FuelRailGaug S01PID 35-35;
SG_MUL_VAL_ 2564502513 S01PID24_OxySensor1_FAER S01PID 36-36;
SG_MUL_VAL_ 2564502513 S01PID24_OxySensor1_Volt S01PID 36-36;
SG_MUL_VAL_ 2564502513 S01PID25_OxySensor2_FAER S01PID 37-37;
SG_MUL_VAL_ 2564502513 S01PID25_OxySensor2_Volt S01PID 37-37;
SG_MUL_VAL_ 2564502513 S01PID26_OxySensor3_FAER S01PID 38-38;
SG_MUL_VAL_ 2564502513 S01PID26_OxySensor3_Volt S01PID 38-38;
SG_MUL_VAL_ 2564502513 S01PID27_OxySensor4_FAER S01PID 39-39;
SG_MUL_VAL_ 2564502513 S01PID27_OxySensor4_Volt S01PID 39-39;
SG_MUL_VAL_ 2564502513 S01PID28_OxySensor5_FAER S01PID 40-40;
SG_MUL_VAL_ 2564502513 S01PID28_OxySensor5_Volt S01PID 40-40;
SG_MUL_VAL_ 2564502513 S01PID29_OxySensor6_FAER S01PID 41-41;
SG_MUL_VAL_ 2564502513 S01PID29_OxySensor6_Volt S01PID 41-41;
SG_MUL_VAL_ 2564502513 S01PID2A_OxySensor7_FAER S01PID 42-42;
SG_MUL_VAL_ 2564502513 S01PID2A_OxySensor7_Volt S01PID 42-42;
SG_MUL_VAL_ 2564502513 S01PID2B_OxySensor8_FAER S01PID 43-43;
SG_MUL_VAL_ 2564502513 S01PID2B_OxySensor8_Volt S01PID 43-43;
SG_MUL_VAL_ 2564502513 S01PID2C_CmdEGR S01PID 44-44;
SG_MUL_VAL_ 2564502513 S01PID2D_EGRError S01PID 45-45;
SG_MUL_VAL_ 2564502513 S01PID2E_CmdEvapPurge S01PID 46-46;
SG_MUL_VAL_ 2564502513 S01PID2F_FuelTankLevel S01PID 47-47;
SG_MUL_VAL_ 2564502513 S01PID30_WaUpsSinceCodeClear S01PID 48-48;
SG_MUL_VAL_ 2564502513 S01PID31_DistSinceCodeClear S01PID 49-49;
SG_MUL_VAL_ 2564502513 S01PID32_EvapSysVaporPres S01PID 50-50;
SG_MUL_VAL_ 2564502513 S01PID33_AbsBaroPres S01PID 51-51;
SG_MUL_VAL_ 2564502513 S01PID34_OxySensor1_FAER S01PID 52-52;
SG_MUL_VAL_ 2564502513 S01PID34_OxySensor1_Crnt S01PID 52-52;
SG_MUL_VAL_ 2564502513 S01PID35_OxySensor2_FAER S01PID 53-53;
SG_MUL_VAL_ 2564502513 S01PID35_OxySensor2_Crnt S01PID 53-53;
SG_MUL_VAL_ 2564502513 S01PID36_OxySensor3_FAER S01PID 54-54;
SG_MUL_VAL_ 2564502513 S01PID36_OxySensor3_Crnt S01PID 54-54;
SG_MUL_VAL_ 2564502513 S01PID37_OxySensor4_FAER S01PID 55-55;
SG_MUL_VAL_ 2564502513 S01PID37_OxySensor4_Crnt S01PID 55-55;
SG_MUL_VAL_ 2564502513 S01PID38_OxySensor5_FAER S01PID 56-56;
SG_MUL_VAL_ 2564502513 S01PID38_OxySensor5_Crnt S01PID 56-56;
SG_MUL_VAL_ 2564502513 S01PID39_OxySensor6_FAER S01PID 57-57;
SG_MUL_VAL_ 2564502513 S01PID39_OxySensor6_Crnt S01PID 57-57;
SG_MUL_VAL_ 2564502513 S01PID3A_OxySensor7_FAER S01PID 58-58;
SG_MUL_VAL_ 2564502513 S01PID3A_OxySensor7_Crnt S01PID 58-58;
SG_MUL_VAL_ 2564502513 S01PID3B_OxySensor8_FAER S01PID 59-59;
SG_MUL_VAL_ 2564502513 S01PID3B_OxySensor8_Crnt S01PID 59-59;
SG_MUL_VAL_ 2564502513 S01PID3C_CatTempBank1Sens1 S01PID 60-60;
SG_MUL_VAL_ 2564502513 S01PID3D_CatTempBank2Sens1 S01PID 61-61;
SG_MUL_VAL_ 2564502513 S01PID3E_CatTempBank1Sens2 S01PID 62-62;
SG_MUL_VAL_ 2564502513 S01PID3F_CatTempBank2Sens2 S01PID 63-63;
SG_MUL_VAL_ 2564502513 S01PID41_MonStatusDriveCycle S01PID 65-65;
SG_MUL_VAL_ 2564502513 S01PID42_ControlModuleVolt S01PID 66-66;
SG_MUL_VAL_ 2564502513 S01PID43_AbsLoadValue S01PID 67-67;
SG_MUL_VAL_ 2564502513 S01PID44_FuelAirCmdEquiv S01PID 68-68;
SG_MUL_VAL_ 2564502513 S01PID45_RelThrottlePos S01PID 69-69;
SG_MUL_VAL_ 2564502513 S01PID46_AmbientAirTemp S01PID 70-70;
SG_MUL_VAL_ 2564502513 S01PID47_AbsThrottlePosB S01PID 71-71;
SG_MUL_VAL_ 2564502513 S01PID48_AbsThrottlePosC S01PID 72-72;
SG_MUL_VAL_ 2564502513 S01PID49_AbsThrottlePosD S01PID 73-73;
SG_MUL_VAL_ 2564502513 S01PID4A_AbsThrottlePosE S01PID 74-74;
SG_MUL_VAL_ 2564502513 S01PID4B_AbsThrottlePosF S01PID 75-75;
SG_MUL_VAL_ 2564502513 S01PID4C_CmdThrottleAct S01PID 76-76;
SG_MUL_VAL_ 2564502513 S01PID4D_TimeRunMILOn S01PID 77-77;
SG_MUL_VAL_ 2564502513 S01PID4E_TimeSinceCodeClear S01PID 78-78;
SG_MUL_VAL_ 2564502513 S01PID4F_Max_FAER S01PID 79-79;
SG_MUL_VAL_ 2564502513 S01PID4F_Max_OxySensVol S01PID 79-79;
SG_MUL_VAL_ 2564502513 S01PID4F_Max_OxySensCrnt S01PID 79-79;
SG_MUL_VAL_ 2564502513 S01PID4F_Max_IntManiAbsPres S01PID 79-79;
SG_MUL_VAL_ 2564502513 S01PID50_Max_AirFlowMAF S01PID 80-80;
SG_MUL_VAL_ 2564502513 S01PID51_FuelType S01PID 81-81;
SG_MUL_VAL_ 2564502513 S01PID52_EthanolFuelPct S01PID 82-82;
SG_MUL_VAL_ 2564502513 S01PID53_AbsEvapSysVapPres S01PID 83-83;
SG_MUL_VAL_ 2564502513 S01PID54_EvapSysVapPres S01PID 84-84;
SG_MUL_VAL_ 2564502513 S01PID55_ShortSecOxyTrimBank1 S01PID 85-85;
SG_MUL_VAL_ 2564502513 S01PID55_ShortSecOxyTrimBank3 S01PID 85-85;
SG_MUL_VAL_ 2564502513 S01PID56_LongSecOxyTrimBank1 S01PID 86-86;
SG_MUL_VAL_ 2564502513 S01PID56_LongSecOxyTrimBank3 S01PID 86-86;
SG_MUL_VAL_ 2564502513 S01PID57_ShortSecOxyTrimBank2 S01PID 87-87;
SG_MUL_VAL_ 2564502513 S01PID57_ShortSecOxyTrimBank4 S01PID 87-87;
SG_MUL_VAL_ 2564502513 S01PID58_LongSecOxyTrimBank2 S01PID 88-88;
SG_MUL_VAL_ 2564502513 S01PID58_LongSecOxyTrimBank4 S01PID 88-88;
SG_MUL_VAL_ 2564502513 S01PID59_FuelRailAbsPres S01PID 89-89;
SG_MUL_VAL_ 2564502513 S01PID5A_RelAccelPedalPos S01PID 90-90;
SG_MUL_VAL_ 2564502513 S01PID5B_HybrBatPackRemLife S01PID 91-91;
SG_MUL_VAL_ 2564502513 S01PID5C_EngineOilTemp S01PID 92-92;
SG_MUL_VAL_ 2564502513 S01PID5D_FuelInjectionTiming S01PID 93-93;
SG_MUL_VAL_ 2564502513 S01PID5E_EngineFuelRate S01PID 94-94;
SG_MUL_VAL_ 2564502513 S01PID5F_EmissionReq S01PID 95-95;
SG_MUL_VAL_ 2564502513 S01PID61_DemandEngTorqPct S01PID 97-97;
SG_MUL_VAL_ 2564502513 S01PID62_ActualEngTorqPct S01PID 98-98;
SG_MUL_VAL_ 2564502513 S01PID63_EngRefTorq S01PID 99-99;
SG_MUL_VAL_ 2564502513 S01PID65_AuxInputOutput S01PID 101-101;
SG_MUL_VAL_ 2564502513 S01PID66_MAFSensor S01PID 102-102;
SG_MUL_VAL_ 2564502513 S01PID67_EngineCoolantTemp S01PID 103-103;
SG_MUL_VAL_ 2564502513 S01PID68_IntakeAirTempSens S01PID 104-104;
SG_MUL_VAL_ 2564502513 S01PID69_CmdEGR_EGRError S01PID 105-105;
SG_MUL_VAL_ 2564502513 S01PID6A_CmdDieselIntAir S01PID 106-106;
SG_MUL_VAL_ 2564502513 S01PID6B_ExhaustGasTemp S01PID 107-107;
SG_MUL_VAL_ 2564502513 S01PID6C_CmdThrottleActRel S01PID 108-108;
SG_MUL_VAL_ 2564502513 S01PID6D_FuelPresContrSys S01PID 109-109;
SG_MUL_VAL_ 2564502513 S01PID6E_InjPresContrSys S01PID 110-110;
SG_MUL_VAL_ 2564502513 S01PID6F_TurboComprPres S01PID 111-111;
SG_MUL_VAL_ 2564502513 S01PID70_BoostPresCntrl S01PID 112-112;
SG_MUL_VAL_ 2564502513 S01PID8E_EngFrictionPctTorq S01PID 142-142;
SG_MUL_VAL_ 2564502513 S01PIDA6_Odometer S01PID 166-166;
SG_MUL_VAL_ 2564502513 S01PID S 1-1;
SG_MUL_VAL_ 2564502513 S22F4PID01_MonitorStatus S22F4PID 1-1;
SG_MUL_VAL_ 2564502513 S22F4PID03_FuelSystemStatus S22F4PID 3-3;
SG_MUL_VAL_ 2564502513 S22F4PID04_CalcEngineLoad S22F4PID 4-4;
SG_MUL_VAL_ 2564502513 S22F4PID05_EngineCoolantTemp S22F4PID 5-5;
SG_MUL_VAL_ 2564502513 S22F4PID06_ShortFuelTrimBank1 S22F4PID 6-6;
SG_MUL_VAL_ 2564502513 S22F4PID07_LongFuelTrimBank1 S22F4PID 7-7;
SG_MUL_VAL_ 2564502513 S22F4PID08_ShortFuelTrimBank2 S22F4PID 8-8;
SG_MUL_VAL_ 2564502513 S22F4PID09_LongFuelTrimBank2 S22F4PID 9-9;
SG_MUL_VAL_ 2564502513 S22F4PID0A_FuelPressure S22F4PID 10-10;
SG_MUL_VAL_ 2564502513 S22F4PID0B_IntakeManiAbsPress S22F4PID 11-11;
SG_MUL_VAL_ 2564502513 S22F4PID0C_EngineRPM S22F4PID 12-12;
SG_MUL_VAL_ 2564502513 S22F4PID0D_VehicleSpeed S22F4PID 13-13;
SG_MUL_VAL_ 2564502513 S22F4PID0E_TimingAdvance S22F4PID 14-14;
SG_MUL_VAL_ 2564502513 S22F4PID0F_IntakeAirTemperature S22F4PID 15-15;
SG_MUL_VAL_ 2564502513 S22F4PID10_MAFAirFlowRate S22F4PID 16-16;
SG_MUL_VAL_ 2564502513 S22F4PID11_ThrottlePosition S22F4PID 17-17;
SG_MUL_VAL_ 2564502513 S22F4PID12_CmdSecAirStatus S22F4PID 18-18;
SG_MUL_VAL_ 2564502513 S22F4PID14_OxySensor1_Volt S22F4PID 20-20;
SG_MUL_VAL_ 2564502513 S22F4PID14_OxySensor1_STFT S22F4PID 20-20;
SG_MUL_VAL_ 2564502513 S22F4PID15_OxySensor2_Volt S22F4PID 21-21;
SG_MUL_VAL_ 2564502513 S22F4PID15_OxySensor2_STFT S22F4PID 21-21;
SG_MUL_VAL_ 2564502513 S22F4PID16_OxySensor3_Volt S22F4PID 22-22;
SG_MUL_VAL_ 2564502513 S22F4PID16_OxySensor3_STFT S22F4PID 22-22;
SG_MUL_VAL_ 2564502513 S22F4PID17_OxySensor4_Volt S22F4PID 23-23;
SG_MUL_VAL_ 2564502513 S22F4PID17_OxySensor4_STFT S22F4PID 23-23;
SG_MUL_VAL_ 2564502513 S22F4PID18_OxySensor5_Volt S22F4PID 24-24;
SG_MUL_VAL_ 2564502513 S22F4PID18_OxySensor5_STFT S22F4PID 24-24;
SG_MUL_VAL_ 2564502513 S22F4PID19_OxySensor6_Volt S22F4PID 25-25;
SG_MUL_VAL_ 2564502513 S22F4PID19_OxySensor6_STFT S22F4PID 25-25;
SG_MUL_VAL_ 2564502513 S22F4PID1A_OxySensor7_Volt S22F4PID 26-26;
SG_MUL_VAL_ 2564502513 S22F4PID1A_OxySensor7_STFT S22F4PID 26-26;
SG_MUL_VAL_ 2564502513 S22F4PID1B_OxySensor8_Volt S22F4PID 27-27;
SG_MUL_VAL_ 2564502513 S22F4PID1B_OxySensor8_STFT S22F4PID 27-27;
SG_MUL_VAL_ 2564502513 S22F4PID1C_OBDStandard S22F4PID 28-28;
SG_MUL_VAL_ 2564502513 S22F4PID1F_TimeSinceEngStart S22F4PID 31-31;
SG_MUL_VAL_ 2564502513 S22F4PID21_DistanceMILOn S22F4PID 33-33;
SG_MUL_VAL_ 2564502513 S22F4PID22_FuelRailPres S22F4PID 34-34;
SG_MUL_VAL_ 2564502513 S22F4PID23_FuelRailGaug S22F4PID 35-35;
SG_MUL_VAL_ 2564502513 S22F4PID24_OxySensor1_FAER S22F4PID 36-36;
SG_MUL_VAL_ 2564502513 S22F4PID24_OxySensor1_Volt S22F4PID 36-36;
SG_MUL_VAL_ 2564502513 S22F4PID25_OxySensor2_FAER S22F4PID 37-37;
SG_MUL_VAL_ 2564502513 S22F4PID25_OxySensor2_Volt S22F4PID 37-37;
SG_MUL_VAL_ 2564502513 S22F4PID26_OxySensor3_FAER S22F4PID 38-38;
SG_MUL_VAL_ 2564502513 S22F4PID26_OxySensor3_Volt S22F4PID 38-38;
SG_MUL_VAL_ 2564502513 S22F4PID27_OxySensor4_FAER S22F4PID 39-39;
SG_MUL_VAL_ 2564502513 S22F4PID27_OxySensor4_Volt S22F4PID 39-39;
SG_MUL_VAL_ 2564502513 S22F4PID28_OxySensor5_FAER S22F4PID 40-40;
SG_MUL_VAL_ 2564502513 S22F4PID28_OxySensor5_Volt S22F4PID 40-40;
SG_MUL_VAL_ 2564502513 S22F4PID29_OxySensor6_FAER S22F4PID 41-41;
SG_MUL_VAL_ 2564502513 S22F4PID29_OxySensor6_Volt S22F4PID 41-41;
SG_MUL_VAL_ 2564502513 S22F4PID2A_OxySensor7_FAER S22F4PID 42-42;
SG_MUL_VAL_ 2564502513 S22F4PID2A_OxySensor7_Volt S22F4PID 42-42;
SG_MUL_VAL_ 2564502513 S22F4PID2B_OxySensor8_FAER S22F4PID 43-43;
SG_MUL_VAL_ 2564502513 S22F4PID2B_OxySensor8_Volt S22F4PID 43-43;
SG_MUL_VAL_ 2564502513 S22F4PID2C_CmdEGR S22F4PID 44-44;
SG_MUL_VAL_ 2564502513 S22F4PID2D_EGRError S22F4PID 45-45;
SG_MUL_VAL_ 2564502513 S22F4PID2E_CmdEvapPurge S22F4PID 46-46;
SG_MUL_VAL_ 2564502513 S22F4PID2F_FuelTankLevel S22F4PID 47-47;
SG_MUL_VAL_ 2564502513 S22F4PID30_WaUpsSinceCodeClear S22F4PID 48-48;
SG_MUL_VAL_ 2564502513 S22F4PID31_DistSinceCodeClear S22F4PID 49-49;
SG_MUL_VAL_ 2564502513 S22F4PID32_EvapSysVaporPres S22F4PID 50-50;
SG_MUL_VAL_ 2564502513 S22F4PID33_AbsBaroPres S22F4PID 51-51;
SG_MUL_VAL_ 2564502513 S22F4PID34_OxySensor1_FAER S22F4PID 52-52;
SG_MUL_VAL_ 2564502513 S22F4PID34_OxySensor1_Crnt S22F4PID 52-52;
SG_MUL_VAL_ 2564502513 S22F4PID35_OxySensor2_FAER S22F4PID 53-53;
SG_MUL_VAL_ 2564502513 S22F4PID35_OxySensor2_Crnt S22F4PID 53-53;
SG_MUL_VAL_ 2564502513 S22F4PID36_OxySensor3_FAER S22F4PID 54-54;
SG_MUL_VAL_ 2564502513 S22F4PID36_OxySensor3_Crnt S22F4PID 54-54;
SG_MUL_VAL_ 2564502513 S22F4PID37_OxySensor4_FAER S22F4PID 55-55;
SG_MUL_VAL_ 2564502513 S22F4PID37_OxySensor4_Crnt S22F4PID 55-55;
SG_MUL_VAL_ 2564502513 S22F4PID38_OxySensor5_FAER S22F4PID 56-56;
SG_MUL_VAL_ 2564502513 S22F4PID38_OxySensor5_Crnt S22F4PID 56-56;
SG_MUL_VAL_ 2564502513 S22F4PID39_OxySensor6_FAER S22F4PID 57-57;
SG_MUL_VAL_ 2564502513 S22F4PID39_OxySensor6_Crnt S22F4PID 57-57;
SG_MUL_VAL_ 2564502513 S22F4PID3A_OxySensor7_FAER S22F4PID 58-58;
SG_MUL_VAL_ 2564502513 S22F4PID3A_OxySensor7_Crnt S22F4PID 58-58;
SG_MUL_VAL_ 2564502513 S22F4PID3B_OxySensor8_FAER S22F4PID 59-59;
SG_MUL_VAL_ 2564502513 S22F4PID3B_OxySensor8_Crnt S22F4PID 59-59;
SG_MUL_VAL_ 2564502513 S22F4PID3C_CatTempBank1Sens1 S22F4PID 60-60;
SG_MUL_VAL_ 2564502513 S22F4PID3D_CatTempBank2Sens1 S22F4PID 61-61;
SG_MUL_VAL_ 2564502513 S22F4PID3E_CatTempBank1Sens2 S22F4PID 62-62;
SG_MUL_VAL_ 2564502513 S22F4PID3F_CatTempBank2Sens2 S22F4PID 63-63;
SG_MUL_VAL_ 2564502513 S22F4PID41_MonStatusDriveCycle S22F4PID 65-65;
SG_MUL_VAL_ 2564502513 S22F4PID42_ControlModuleVolt S22F4PID 66-66;
SG_MUL_VAL_ 2564502513 S22F4PID43_AbsLoadValue S22F4PID 67-67;
SG_MUL_VAL_ 2564502513 S22F4PID44_FuelAirCmdEquiv S22F4PID 68-68;
SG_MUL_VAL_ 2564502513 S22F4PID45_RelThrottlePos S22F4PID 69-69;
SG_MUL_VAL_ 2564502513 S22F4PID46_AmbientAirTemp S22F4PID 70-70;
SG_MUL_VAL_ 2564502513 S22F4PID47_AbsThrottlePosB S22F4PID 71-71;
SG_MUL_VAL_ 2564502513 S22F4PID48_AbsThrottlePosC S22F4PID 72-72;
SG_MUL_VAL_ 2564502513 S22F4PID49_AbsThrottlePosD S22F4PID 73-73;
SG_MUL_VAL_ 2564502513 S22F4PID4A_AbsThrottlePosE S22F4PID 74-74;
SG_MUL_VAL_ 2564502513 S22F4PID4B_AbsThrottlePosF S22F4PID 75-75;
SG_MUL_VAL_ 2564502513 S22F4PID4C_CmdThrottleAct S22F4PID 76-76;
SG_MUL_VAL_ 2564502513 S22F4PID4D_TimeRunMILOn S22F4PID 77-77;
SG_MUL_VAL_ 2564502513 S22F4PID4E_TimeSinceCodeClear S22F4PID 78-78;
SG_MUL_VAL_ 2564502513 S22F4PID4F_Max_FAER S22F4PID 79-79;
SG_MUL_VAL_ 2564502513 S22F4PID4F_Max_OxySensVol S22F4PID 79-79;
SG_MUL_VAL_ 2564502513 S22F4PID4F_Max_OxySensCrnt S22F4PID 79-79;
SG_MUL_VAL_ 2564502513 S22F4PID4F_Max_IntManiAbsPres S22F4PID 79-79;
SG_MUL_VAL_ 2564502513 S22F4PID50_Max_AirFlowMAF S22F4PID 80-80;
SG_MUL_VAL_ 2564502513 S22F4PID51_FuelType S22F4PID 81-81;
SG_MUL_VAL_ 2564502513 S22F4PID52_EthanolFuelPct S22F4PID 82-82;
SG_MUL_VAL_ 2564502513 S22F4PID53_AbsEvapSysVapPres S22F4PID 83-83;
SG_MUL_VAL_ 2564502513 S22F4PID54_EvapSysVapPres S22F4PID 84-84;
SG_MUL_VAL_ 2564502513 S22F4PID55_ShortSecOxyTrimBank1 S22F4PID 85-85;
SG_MUL_VAL_ 2564502513 S22F4PID55_ShortSecOxyTrimBank3 S22F4PID 85-85;
SG_MUL_VAL_ 2564502513 S22F4PID56_LongSecOxyTrimBank1 S22F4PID 86-86;
SG_MUL_VAL_ 2564502513 S22F4PID56_LongSecOxyTrimBank3 S22F4PID 86-86;
SG_MUL_VAL_ 2564502513 S22F4PID57_ShortSecOxyTrimBank2 S22F4PID 87-87;
SG_MUL_VAL_ 2564502513 S22F4PID57_ShortSecOxyTrimBank4 S22F4PID 87-87;
SG_MUL_VAL_ 2564502513 S22F4PID58_LongSecOxyTrimBank2 S22F4PID 88-88;
SG_MUL_VAL_ 2564502513 S22F4PID58_LongSecOxyTrimBank4 S22F4PID 88-88;
SG_MUL_VAL_ 2564502513 S22F4PID59_FuelRailAbsPres S22F4PID 89-89;
SG_MUL_VAL_ 2564502513 S22F4PID5A_RelAccelPedalPos S22F4PID 90-90;
SG_MUL_VAL_ 2564502513 S22F4PID5B_HybrBatPackRemLife S22F4PID 91-91;
SG_MUL_VAL_ 2564502513 S22F4PID5C_EngineOilTemp S22F4PID 92-92;
SG_MUL_VAL_ 2564502513 S22F4PID5D_FuelInjectionTiming S22F4PID 93-93;
SG_MUL_VAL_ 2564502513 S22F4PID5E_EngineFuelRate S22F4PID 94-94;
SG_MUL_VAL_ 2564502513 S22F4PID5F_EmissionReq S22F4PID 95-95;
SG_MUL_VAL_ 2564502513 S22F4PID61_DemandEngTorqPct S22F4PID 97-97;
SG_MUL_VAL_ 2564502513 S22F4PID62_ActualEngTorqPct S22F4PID 98-98;
SG_MUL_VAL_ 2564502513 S22F4PID63_EngRefTorq S22F4PID 99-99;
SG_MUL_VAL_ 2564502513 S22F4PID65_AuxInputOutput S22F4PID 101-101;
SG_MUL_VAL_ 2564502513 S22F4PID66_MAFSensor S22F4PID 102-102;
SG_MUL_VAL_ 2564502513 S22F4PID67_EngineCoolantTemp S22F4PID 103-103;
SG_MUL_VAL_ 2564502513 S22F4PID68_IntakeAirTempSens S22F4PID 104-104;
SG_MUL_VAL_ 2564502513 S22F4PID69_CmdEGR_EGRError S22F4PID 105-105;
SG_MUL_VAL_ 2564502513 S22F4PID6A_CmdDieselIntAir S22F4PID 106-106;
SG_MUL_VAL_ 2564502513 S22F4PID6B_ExhaustGasTemp S22F4PID 107-107;
SG_MUL_VAL_ 2564502513 S22F4PID6C_CmdThrottleActRel S22F4PID 108-108;
SG_MUL_VAL_ 2564502513 S22F4PID6D_FuelPresContrSys S22F4PID 109-109;
SG_MUL_VAL_ 2564502513 S22F4PID6E_InjPresContrSys S22F4PID 110-110;
SG_MUL_VAL_ 2564502513 S22F4PID6F_TurboComprPres S22F4PID 111-111;
SG_MUL_VAL_ 2564502513 S22F4PID70_BoostPresCntrl S22F4PID 112-112;
SG_MUL_VAL_ 2564502513 S22F4PID8E_EngFrictionPctTorq S22F4PID 142-142;
SG_MUL_VAL_ 2564502513 S22F4PIDA6_Odometer S22F4PID 166-166;
SG_MUL_VAL_ 2564502513 SubFct S 34-34;
SG_MUL_VAL_ 2564502513 S22F4PID SubFct 244-244;
